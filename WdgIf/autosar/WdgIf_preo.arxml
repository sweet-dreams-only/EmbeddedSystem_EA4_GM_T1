AUTOSAR XML (schema 4-0-3)
# COPYRIGHT
# Copyright (c) 2013 by Vctr Informatik GmbH. All rights reserved.
# This software is copyright protected and proprietary to Vctr Informatik GmbH.
# Vctr Informatik GmbH grants to you only those rights as set out in the license conditions.
package /MICROSAR  # WdgIf Preconfiguration
  module config WdgIf_Pre: definition=WdgIf, implementation-config-variant=VARIANT-PRE-COMPILE
  module config WdgIf_Rec: definition=WdgIf
