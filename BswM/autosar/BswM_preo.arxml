AUTOSAR XML (schema 4-0-3)
# COPYRIGHT
# Copyright (c) 2013 by Vctr Informatik GmbH. All rights reserved.
# This software is copyright protected and proprietary to Vctr Informatik GmbH.
# Vctr Informatik GmbH grants to you only those rights as set out in the license conditions.
package /MICROSAR  # BswM Preconfiguration
  module config BswM_Pre: definition=BswM, implementation-config-variant=VARIANT-PRE-COMPILE
  module config BswM_Rec: definition=BswM
    BswMGeneral: BswMMainFunctionPeriod=0.01, BswMVersionInfoApi=0, BswMDevErrorDetect=1
