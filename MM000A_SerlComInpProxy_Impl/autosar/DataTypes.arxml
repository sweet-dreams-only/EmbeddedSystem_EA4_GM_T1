AUTOSAR XML (schema 4-0-3)
standard types defined: uint16_DataConstr, uint32_DataConstr, uint8_DataConstr, boolean, uint16, uint32, uint8
package /DataTypes
  impl type Ary1D_u8_12: category=ARRAY, sw-calibration-access=READ-ONLY, type-emitter=RTE
    element Element: array-size=12, array-size-semantics=FIXED-SIZE, implementation-data-type=uint8
