AUTOSAR XML (schema 4-0-3)
package /ActiveEcuC
  ecuc value collection ActiveEcuC: ecuc-values=[Rte, Os, VrfyCritReg]
  module config Rte: implementation-config-variant=VARIANT-PRE-COMPILE, module-description=Rte_Impl
    RteBswGeneral: RteSchMVersionInfoApi=false, RteUseComShadowSignalApi=false
    RteGeneration:
      RteCalibrationSupport = NONE
      RteCodeVendorId = 30
      RteDevErrorDetect = false
      RteDevErrorDetectUninit = false
      RteGenerationMode = COMPATIBILITY_MODE
      RteIocInteractionReturnValue = RTE_IOC
      RteMeasurementSupport = false
      RteOptimizationMode = MEMORY
      RteValueRangeCheckEnabled = false
      RteVfbTraceEnabled = false
      RteEnforceIoc = false
      RteXcpEventSupport = false
    RteInitializationBehavior: RteInitializationStrategy=RTE_INITIALIZATION_STRATEGY_AT_RTE_START_AND_PARTITION_RESTART, RteSectionInitializationPolicy=
    RteOsInteraction
    Rte (RteBswModuleInstance): RteBswImplementationRef=Rte_Impl, RteBswModuleConfigurationRef=Rte
  module config VrfyCritReg: implementation-config-variant=VARIANT-PRE-COMPILE
    13 x VrfyCritReg8bitInitSignallist:
      ECMDTMCTL: Address=4292223036, Value=0, Mask=2
      FRTEINT: Address=4288741532, Value=3, Mask=255
      IPGPMTUM2: Address=4294893602, Value=17, Mask=255
      IPGPMTUM3: Address=4294893603, Value=16, Mask=255
      IPGPMTUM4: Address=4294893604, Value=1, Mask=255
      MODER: Address=4291630068, Value=3, Mask=255
      CLMA1CTL0: Address=4294476832, Value=1, Mask=255
      CLMA3CTL0: Address=4294476896, Value=1, Mask=255
      CLMA2CTL0: Address=4294476864, Value=1, Mask=255
      IPGPMTUM0: Address=4294893600, Value=51, Mask=255
      CLMA0CTL0: Address=4294476800, Value=1, Mask=255
      ECMEPCFG: Address=4292222976, Value=0, Mask=1
      IPGENUM: Address=4294893581, Value=3, Mask=255
    20 x VrfyCritReg16bitInitSignallist:
      CLMA3CMPL: Address=4294476904, Value=312, Mask=65535
      ECCRCAN0TMC: Address=4291235844, Value=0, Mask=49311
      ECCCSIH2TMC: Address=4291231876, Value=0, Mask=49311
      SEGCONT: Address=4294896000, Value=880, Mask=65535
      CLMA0CMPH: Address=4294476812, Value=145, Mask=65535
      PEGSP: Address=4294895116, Value=1, Mask=65535
      ECCFLX0TMC: Address=4291239940, Value=0, Mask=49311
      CLMA1CMPL: Address=4294476840, Value=155, Mask=65535
      CLMA0CMPL: Address=4294476808, Value=114, Mask=65535
      ECCCSIH3TMC: Address=4291231940, Value=0, Mask=49311
      ECMDTMCMP: Address=4292223044, Value=65535, Mask=65535
      CLMA1CMPH: Address=4294476844, Value=165, Mask=65535
      ECMDTMR: Address=4292223040, Value=0, Mask=65535
      CLMA3CMPH: Address=4294476908, Value=328, Mask=65535
      ECCCSIH1TMC: Address=4291231812, Value=0, Mask=49311
      ECCFLX0T0TMC: Address=4291240068, Value=0, Mask=49311
      CLMA2CMPL: Address=4294476872, Value=114, Mask=65535
      ECCCSIH0TMC: Address=4291231748, Value=0, Mask=49311
      ECCFLX0T1TMC: Address=4291240004, Value=0, Mask=49311
      CLMA2CMPH: Address=4294476876, Value=145, Mask=65535
    85 x VrfyCritReg32bitInitSignallist:
      PEGG0MK: Address=4294895232, Value=0, Mask=4294967295
      FSGD3ADPROT11: Address=4291035180, Value=2248539999, Mask=4294967295
      PEGG0BA: Address=4294895236, Value=4273991829, Mask=4294967295
      CFSTSTCTL_PE1: Address=4291175504, Value=0, Mask=4294967295
      FSGD2ADPROT6: Address=4294524952, Value=2214985311, Mask=4294967295
      ECMIRCFG1: Address=4292223000, Value=0, Mask=536872951
      FSGD1BDPROT5: Address=4292726932, Value=2248539743, Mask=4294967295
      FSGD1ADPROT9: Address=4292726820, Value=2248539743, Mask=4294967295
      ECMDTMCFG3: Address=4292223060, Value=0, Mask=2039
      FSGD1ADPROT0: Address=4292726784, Value=2248539743, Mask=4294967295
      CFERRINT_PE1: Address=4291175428, Value=7, Mask=4294967295
      FSGD2ADPROT14: Address=4294524984, Value=2248539743, Mask=4294967295
      ECMDTMCFG2: Address=4292223056, Value=0, Mask=4261404659
      FSGD1ADPROT1: Address=4292726788, Value=2248539743, Mask=4294967295
      CFECCCTL_PE1: Address=4291175424, Value=0, Mask=4294967295
      FSGD3ADPROT3: Address=4291035148, Value=2248539743, Mask=4294967295
      ECMNMICFG1: Address=4292222992, Value=3, Mask=2039
      FSGD1ADPROT2: Address=4292726792, Value=2248539743, Mask=4294967295
      FSGD3ADPROT1: Address=4291035140, Value=2214985311, Mask=4294967295
      FSGD1ADPROT10: Address=4292726824, Value=2248539743, Mask=4294967295
      FSGD2ADPROT4: Address=4294524944, Value=2214985311, Mask=4294967295
      FSGD2ADPROT5: Address=4294524948, Value=2214985311, Mask=4294967295
      FSGD2ADPROT11: Address=4294524972, Value=2248540127, Mask=4294967295
      FSGD1BDPROT8: Address=4292726944, Value=2248539743, Mask=4294967295
      FSGD1ADPROT7: Address=4292726812, Value=2248539743, Mask=4294967295
      ECMDTMCFG1: Address=4292223052, Value=0, Mask=2039
      PEGG1BA: Address=4294895252, Value=4273864915, Mask=4294967295
      FSGD2ADPROT12: Address=4294524976, Value=2248539743, Mask=4294967295
      FSGD2ADPROT3: Address=4294524940, Value=2214985311, Mask=4294967295
      PEGG2BA: Address=4294895268, Value=0, Mask=4294967295
      FSGD1BDPROT1: Address=4292726916, Value=2248539743, Mask=4294967295
      PEGG2MK: Address=4294895264, Value=0, Mask=4294967295
      FSGD3ADPROT5: Address=4291035156, Value=2214985311, Mask=4294967295
      FSGD3ADPROT4: Address=4291035152, Value=2248539743, Mask=4294967295
      ECMDTMCFG0: Address=4292223048, Value=0, Mask=4261404659
      FSGD3ADPROT6: Address=4291035160, Value=2214985311, Mask=4294967295
      LVICNT: Address=4294454272, Value=0, Mask=7
      FSGD1BDPROT3: Address=4292726924, Value=2248539743, Mask=4294967295
      FSGD1BDPROT6: Address=4292726936, Value=2248539743, Mask=4294967295
      ECMEMK0: Address=4292223004, Value=3357360128, Mask=4261404659
      FSGD1ADPROT14: Address=4292726840, Value=2248539743, Mask=4294967295
      CVMREN: Address=4294453312, Value=3, Mask=3
      PEGG1MK: Address=4294895248, Value=126976, Mask=4294967295
      ECMNMICFG0: Address=4292222988, Value=568332273, Mask=4261404659
      FSGD1ADPROT12: Address=4292726832, Value=2248539743, Mask=4294967295
      FSGD1BDPROT2: Address=4292726920, Value=2214985311, Mask=4294967295
      FSGD1ADPROT13: Address=4292726836, Value=2248539743, Mask=4294967295
      FSGD1ADPROT4: Address=4292726800, Value=2248539743, Mask=4294967295
      ECMMICFG1: Address=4292222984, Value=4, Mask=2039
      FSGD2ADPROT8: Address=4294524960, Value=2248539743, Mask=4294967295
      FSGD1ADPROT5: Address=4292726804, Value=2248539743, Mask=4294967295
      FSGD2ADPROT9: Address=4294524964, Value=2248539743, Mask=4294967295
      FSGD1ADPROT6: Address=4292726808, Value=2248539743, Mask=4294967295
      FSGD2ADPROT10: Address=4294524968, Value=2248539743, Mask=4294967295
      FSGD3ADPROT10: Address=4291035176, Value=2248539999, Mask=4294967295
      FSGD2ADPROT1: Address=4294524932, Value=2248539743, Mask=4294967295
      ECMMICFG0: Address=4292222980, Value=134479872, Mask=4261404659
      FSGD1BDPROT9: Address=4292726948, Value=2248539743, Mask=4294967295
      FSGD1BDPROT13: Address=4292726964, Value=2248539743, Mask=4294967295
      FSGD1ADPROT3: Address=4292726796, Value=2248539743, Mask=4294967295
      FSGD2ADPROT13: Address=4294524980, Value=2248539743, Mask=4294967295
      FSGD3ADPROT2: Address=4291035144, Value=2214985311, Mask=4294967295
      FSGD1BDPROT12: Address=4292726960, Value=2248539743, Mask=4294967295
      FSGD1ADPROT11: Address=4292726828, Value=2248539743, Mask=4294967295
      ECMEMK1: Address=4292223008, Value=536872420, Mask=536872951
      FSGD2ADPROT7: Address=4294524956, Value=2248539743, Mask=4294967295
      FSGD1BDPROT7: Address=4292726940, Value=2248539743, Mask=4294967295
      FSGD3ADPROT0: Address=4291035136, Value=2214985311, Mask=4294967295
      FSGD1BDPROT14: Address=4292726968, Value=2248539743, Mask=4294967295
      FSGD1BDPROT11: Address=4292726956, Value=2248539743, Mask=4294967295
      FSGD2ADPROT0: Address=4294524928, Value=2248539743, Mask=4294967295
      FSGD2ADPROT15: Address=4294524988, Value=2248540127, Mask=4294967295
      FSGD3ADPROT8: Address=4291035168, Value=2214985311, Mask=4294967295
      PEGG3BA: Address=4294895284, Value=0, Mask=4294967295
      CFSTSTCTL_VCI: Address=4291175248, Value=0, Mask=4294967295
      ECMIRCFG0: Address=4292222996, Value=2, Mask=4261404659
      FSGD3ADPROT9: Address=4291035172, Value=2214985311, Mask=4294967295
      PEGG3MK: Address=4294895280, Value=0, Mask=4294967295
      FSGD1BDPROT10: Address=4292726952, Value=2248539743, Mask=4294967295
      FSGD1BDPROT4: Address=4292726928, Value=2248539743, Mask=4294967295
      FSGD1ADPROT8: Address=4292726816, Value=2248539871, Mask=4294967295
      FSGD3ADPROT7: Address=4291035164, Value=2214985311, Mask=4294967295
      FSGD1BDPROT0: Address=4292726912, Value=2248539743, Mask=4294967295
      FSGD2ADPROT2: Address=4294524936, Value=2214985311, Mask=4294967295
      FSGD5ADPROT0: Address=4294508544, Value=2248539743, Mask=4294967295
    23 x VrfyCritReg8bitPerSignallist:
      SCI32SCR: Address=4292812808, Value=0, Mask=255
      DNFA4ENL: Address=4290970636, Value=0, Mask=255
      ADCD0SFTCR: Address=4294050752, Value=16, Mask=16
      DNFA2ENL: Address=4290970124, Value=0, Mask=255
      FCLA1CTL7: Address=4290986044, Value=0, Mask=255
      TPBA1TE: Address=4293529896, Value=0, Mask=1
      RLN30LCUC: Address=4292837390, Value=0, Mask=255
      WDTA0MD: Address=4292296716, Value=120, Mask=255
      SCI30SCR: Address=4292804616, Value=0, Mask=255
      ADCD0THER: Address=4294050864, Value=0, Mask=255
      WDTA0EVAC: Address=4292296708, Value=44, Mask=255
      DNFA1ENL: Address=4290969868, Value=0, Mask=255
      ENCA1TE: Address=4293398548, Value=0, Mask=255
      DNFA0ENL: Address=4290969612, Value=0, Mask=255
      SCI31SCR: Address=4292808712, Value=0, Mask=255
      RLN31LCUC: Address=4292841486, Value=0, Mask=255
      TPBA0TE: Address=4293525800, Value=0, Mask=1
      TSG30STR0: Address=4293328912, Value=0, Mask=1
      ADCD1THER: Address=4294054960, Value=0, Mask=255
      ENCA0TE: Address=4293394452, Value=0, Mask=255
      ADCD1SFTCR: Address=4294054848, Value=16, Mask=16
      CVMDE: Address=4294453284, Value=3, Mask=3
      FCLA2CTL0: Address=4290986048, Value=0, Mask=255
    9 x VrfyCritReg16bitPerSignallist:
      TAUD0TOE: Address=4293001308, Value=0, Mask=65535
      TAUD0TE: Address=4293001664, Value=0, Mask=65535
      EIC16: Address=4294896160, Value=65, Mask=65
      EIC8: Address=4294896144, Value=67, Mask=67
      EIC9: Address=4294896146, Value=66, Mask=66
      TAUD2TE: Address=4293009856, Value=0, Mask=65535
      TAUD1TE: Address=4293005760, Value=0, Mask=65535
      TAUD1TOE: Address=4293005404, Value=0, Mask=65535
      TAUD2TOE: Address=4293009500, Value=0, Mask=65535
    17 x VrfyCritReg32bitPerSignallist:
      TSN0STAT: Address=4294082564, Value=0, Mask=65535
      CFECCCTL_VCI: Address=4291174912, Value=0, Mask=4294967295
      ITERRINT_PE1: Address=4291171332, Value=3, Mask=4294967295
      CFERRINT_VCI: Address=4291174916, Value=6, Mask=4294967295
      ITECCCTL_PE1: Address=4291171328, Value=0, Mask=4294967295
      IDERRINT_PE1: Address=4291167236, Value=3, Mask=4294967295
      OPBT2: Address=4291625016, Value=3221225471, Mask=4294967295
      OPBT0: Address=4291625008, Value=2140143611, Mask=4294967295
      FSGD0ADPROT1: Address=4291084292, Value=101056095, Mask=4294967295
      IDECCCTL_PE1: Address=4291167232, Value=0, Mask=4294967295
      IMR0: Address=4294896368, Value=0, Mask=66304
      PSI51CHCTRL: Address=4292874240, Value=0, Mask=1
      CFAPCTL: Address=4291174400, Value=0, Mask=4294967295
      PSI50CHCTRL: Address=4292870144, Value=0, Mask=1
      LRECCCTL_PE1: Address=4291187712, Value=0, Mask=4294967295
      FSGD0ADPROT0: Address=4291084288, Value=67501663, Mask=4294967295
      LRERRINT_PE1: Address=4291187716, Value=3, Mask=4294967295
    icctrl (VrfySysCritRegPerSignallist): RegisterID=24, SelectionID=4, Value=196611, Mask=4294967295
    3 x VrfySysCritRegInitSignallist, all with Mask=4294967295:
      fpcfg: RegisterID=10, SelectionID=0, Value=28
      mpm: RegisterID=0, SelectionID=5, Value=3
      iccfg: RegisterID=26, SelectionID=4, Value=67652
