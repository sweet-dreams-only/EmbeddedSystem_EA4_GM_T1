AUTOSAR XML (schema 4-0-3)
package /ActiveEcuC
  ecuc value collection ActiveEcuC: ecuc-values=[Rte, StHlthSigStc, Os]
  module config Rte: implementation-config-variant=VARIANT-PRE-COMPILE, module-description=Rte_Impl
    RteBswGeneral: RteSchMVersionInfoApi=false, RteUseComShadowSignalApi=false
    RteGeneration:
      RteCalibrationSupport = NONE
      RteCodeVendorId = 30
      RteDevErrorDetect = false
      RteDevErrorDetectUninit = false
      RteGenerationMode = COMPATIBILITY_MODE
      RteIocInteractionReturnValue = RTE_IOC
      RteMeasurementSupport = false
      RteOptimizationMode = MEMORY
      RteValueRangeCheckEnabled = false
      RteVfbTraceEnabled = false
      RteEnforceIoc = false
      RteXcpEventSupport = false
    RteInitializationBehavior: RteInitializationStrategy=RTE_INITIALIZATION_STRATEGY_AT_RTE_START_AND_PARTITION_RESTART, RteSectionInitializationPolicy=
    RteOsInteraction
    Rte (RteBswModuleInstance): RteBswImplementationRef=Rte_Impl, RteBswModuleConfigurationRef=Rte
  module config StHlthSigStc: implementation-config-variant=VARIANT-PRE-COMPILE, module-description=StHlthSigStc_Impl
    CCT_Range_01_Address (StHlthSigStcCrConfigList): StHlthSigStcCrcStartSymbol=CCT_Range_01_Address
    StHlthSigStcApplicationConfig: StHlthSigStcOsApplicationReference=Appl10
    22 x StHlthSigStcSignalList:
      CtrlrTStHlth
        StHlthSigStcSignalSettings:
          StHlthSigStcSignalName = CtrlrTStHlth
          StHlthSigStcLoopTime = 100000
          StHlthSigStcUpdatedInMotorIsr = false
          StHlthSigStcSignalTaskReference = Task_100ms_Appl10
      OutpAssiStHlth
        StHlthSigStcSignalSettings:
          StHlthSigStcSignalName = OutpAssiStHlth
          StHlthSigStcLoopTime = 2000
          StHlthSigStcUpdatedInMotorIsr = false
          StHlthSigStcSignalTaskReference = Task_2ms_Appl10
      AbsltMotPosABDifStHlth
        StHlthSigStcSignalSettings:
          StHlthSigStcSignalName = AbsltMotPosABDifStHlth
          StHlthSigStcLoopTime = 2000
          StHlthSigStcUpdatedInMotorIsr = false
          StHlthSigStcSignalTaskReference = Task_2ms_Appl10
      AbsltMotPosBCDifStHlth
        StHlthSigStcSignalSettings:
          StHlthSigStcSignalName = AbsltMotPosBCDifStHlth
          StHlthSigStcLoopTime = 2000
          StHlthSigStcUpdatedInMotorIsr = false
          StHlthSigStcSignalTaskReference = Task_2ms_Appl10
      AbsltMotPosACDifStHlth
        StHlthSigStcSignalSettings:
          StHlthSigStcSignalName = AbsltMotPosACDifStHlth
          StHlthSigStcLoopTime = 2000
          StHlthSigStcUpdatedInMotorIsr = false
          StHlthSigStcSignalTaskReference = Task_2ms_Appl10
      DigTqSnsrAStHlth
        StHlthSigStcSignalSettings:
          StHlthSigStcSignalName = DigTqSnsrAStHlth
          StHlthSigStcLoopTime = 4000
          StHlthSigStcUpdatedInMotorIsr = false
          StHlthSigStcSignalTaskReference = Task_4ms_Appl10
      DutyCycStHlth
        StHlthSigStcSignalSettings:
          StHlthSigStcSignalName = DutyCycStHlth
          StHlthSigStcLoopTime = 100000
          StHlthSigStcUpdatedInMotorIsr = false
          StHlthSigStcSignalTaskReference = Task_100ms_Appl10
      DigTqSnsrBStHlth
        StHlthSigStcSignalSettings:
          StHlthSigStcSignalName = DigTqSnsrBStHlth
          StHlthSigStcLoopTime = 4000
          StHlthSigStcUpdatedInMotorIsr = false
          StHlthSigStcSignalTaskReference = Task_4ms_Appl10
      PhaAStHlth
        StHlthSigStcSignalSettings: StHlthSigStcSignalName=PhaAStHlth, StHlthSigStcLoopTime=2000, StHlthSigStcUpdatedInMotorIsr=false, StHlthSigStcSignalTaskReference=Task_2ms_Appl10
      RamEccSngBitCorrnStHlth
        StHlthSigStcSignalSettings:
          StHlthSigStcSignalName = RamEccSngBitCorrnStHlth
          StHlthSigStcLoopTime = 2000
          StHlthSigStcUpdatedInMotorIsr = false
          StHlthSigStcSignalTaskReference = Task_2ms_Appl10
      MotPosStHlth
        StHlthSigStcSignalSettings:
          StHlthSigStcSignalName = MotPosStHlth
          StHlthSigStcLoopTime = 2000
          StHlthSigStcUpdatedInMotorIsr = false
          StHlthSigStcSignalTaskReference = Task_2ms_Appl10
      EotImpctStHlth
        StHlthSigStcSignalSettings:
          StHlthSigStcSignalName = EotImpctStHlth
          StHlthSigStcLoopTime = 10000
          StHlthSigStcUpdatedInMotorIsr = false
          StHlthSigStcSignalTaskReference = Task_10ms_Appl10
      PhaBStHlth
        StHlthSigStcSignalSettings: StHlthSigStcSignalName=PhaBStHlth, StHlthSigStcLoopTime=2000, StHlthSigStcUpdatedInMotorIsr=false, StHlthSigStcSignalTaskReference=Task_2ms_Appl10
      PhaCStHlth
        StHlthSigStcSignalSettings: StHlthSigStcSignalName=PhaCStHlth, StHlthSigStcLoopTime=2000, StHlthSigStcUpdatedInMotorIsr=false, StHlthSigStcSignalTaskReference=Task_2ms_Appl10
      PhaDStHlth
        StHlthSigStcSignalSettings: StHlthSigStcSignalName=PhaDStHlth, StHlthSigStcLoopTime=2000, StHlthSigStcUpdatedInMotorIsr=false, StHlthSigStcSignalTaskReference=Task_2ms_Appl10
      PhaEStHlth
        StHlthSigStcSignalSettings: StHlthSigStcSignalName=PhaEStHlth, StHlthSigStcLoopTime=2000, StHlthSigStcUpdatedInMotorIsr=false, StHlthSigStcSignalTaskReference=Task_2ms_Appl10
      PhaFStHlth
        StHlthSigStcSignalSettings: StHlthSigStcSignalName=PhaFStHlth, StHlthSigStcLoopTime=2000, StHlthSigStcUpdatedInMotorIsr=false, StHlthSigStcSignalTaskReference=Task_2ms_Appl10
      DigTqIdptSigStHlth
        StHlthSigStcSignalSettings:
          StHlthSigStcSignalName = DigTqIdptSigStHlth
          StHlthSigStcLoopTime = 4000
          StHlthSigStcUpdatedInMotorIsr = false
          StHlthSigStcSignalTaskReference = Task_4ms_Appl10
      CurrMotSumABCStHlth
        StHlthSigStcSignalSettings:
          StHlthSigStcSignalName = CurrMotSumABCStHlth
          StHlthSigStcLoopTime = 2000
          StHlthSigStcUpdatedInMotorIsr = false
          StHlthSigStcSignalTaskReference = Task_2ms_Appl10
      CurrMotSumDEFStHlth
        StHlthSigStcSignalSettings:
          StHlthSigStcSignalName = CurrMotSumDEFStHlth
          StHlthSigStcLoopTime = 2000
          StHlthSigStcUpdatedInMotorIsr = false
          StHlthSigStcSignalTaskReference = Task_2ms_Appl10
      FricEstimnStHlth
        FricEstimnStHlth (StHlthSigStcSignalSettings):
          StHlthSigStcSignalName = FricEstimnStHlth
          StHlthSigStcLoopTime = 10000
          StHlthSigStcUpdatedInMotorIsr = false
          StHlthSigStcSignalTaskReference = Task_10ms_Appl10
      WhlImbMaxCmpStHlth
        StHlthSigStcSignalSettings:
          StHlthSigStcSignalName = WhlImbMaxCmpStHlth
          StHlthSigStcLoopTime = 2000
          StHlthSigStcUpdatedInMotorIsr = false
          StHlthSigStcSignalTaskReference = Task_2ms_Appl10
  module config Os: implementation-config-variant=VARIANT-PRE-COMPILE, module-description=Os_Impl
    OsOS:
      OsStackMonitoring = true
      OsOSStackUsageMeasurement = AUTO
      OsStatus = EXTENDED
      OsUseGetServiceId = true
      OsUseParameterAccess = false
      OsUseResScheduler = false
      OsOSCallISRHooks = false
      OsOSSystemTimerNestable = true
      OsOSMemoryProtection = true
      OsOSEnumeratedUnhandledISRs = true
      OsOSORTIDebugSupport = true
      OsOSTypeHeaderInclude = true
      OsOSCpuFrequency = 160
      OsOSTimerClockDivider = 2
      OsOSUserConfigurationVersion = 1
      OsOSSystemStackSize = 1024
      OsOSSystemTimerPriority = 3
      OsOSSystemTimerStackSize = 512
      OsOSTickTime = 2000
      OsOSSystemTimer = OSTM0
      OsOSOSInternalChecks = Additional
      OsOSCompiler = GHS
      OsOSORTIDebugLevel = ORTI_22_Additional
      OsScalabilityClass = SC3
      OsOSSCHEDULE
        NON_AUTO: OsOSSCHEDULE=MIXED
      OsOSCC
        NON_AUTO: OsOSCC=ECC2
      OsOSProtectionHookReaction
        Selected: OsOSSHUTDOWN=true
      OsOSTimingMeasurement
        FALSE
      OsHooks: OsErrorHook=true, OsPostTaskHook=false, OsPreTaskHook=false, OsShutdownHook=true, OsStartupHook=true, OsProtectionHook=true
      4 x OsOSMpuRegion:
        CodeFlash
          Enable: OsOSAccessRights=237, OsOSStartAddr=0x0, OsOSEndAddr=0xFFFFF
        GeneralRAM
          Enable: OsOSAccessRights=217, OsOSStartAddr=0xFEBE0000, OsOSEndAddr=0xFEBFFFFF
        GlobalSharedRAM
          Enable: OsOSAccessRights=219, OsOSStartAddr=osGlobalShared_StartAddr, OsOSEndAddr=osGlobalShared_EndAddr
        Registers
          Enable: OsOSAccessRights=219, OsOSStartAddr=0xFF000000, OsOSEndAddr=0xFFFFFFFF
    VectorCommonData: BswmdVersion=6.05.00
    OsImplementationInformation: OsVectorOilVersion=4.0, OsVectorImplementationName=RenesasRH850_P1M.i40, OsBswmdStyleVersion=2
    OSDEFAULTAPPMODE (OsAppMode)
    SystemTimer (OsCounter): OsCounterMaxAllowedValue=2147483647, OsCounterTicksPerBase=1, OsCounterMinCycle=1, OsSecondsPerTick=1234567890, OsCounterType=SOFTWARE
    RES_SCHEDULER (OsResource): OsResourceProperty=STANDARD
    Task_10msBsw_Appl10 (OsTask): OsTaskActivation=1, OsTaskPriority=2, OsTaskSchedule=FULL, OsTaskTYPE=BASIC, OsTaskStackSize=512
    Appl10 (OsApplication):
      OsTrusted = false
      OsAppGenerateStub = false
      OsApplicationNonTrusted_Function = NtWrapS_NvM_EraseNvBlock
      OsApplicationNonTrusted_Function = NtWrapS_NvM_InvalidateNvBlock
      OsApplicationNonTrusted_Function = NtWrapS_NvM_SetBlockProtection
      OsApplicationNonTrusted_Function = NtWrapS_NvM_SetRamBlockStatus
      OsApplicationNonTrusted_Function = NtWrapS_NvM_SetDataIndex
      OsApplicationNonTrusted_Function = NtWrapS_NvM_GetDataIndex
      OsApplicationNonTrusted_Function = NtWrapS_NvM_GetErrorStatus
      OsApplicationNonTrusted_Function = NtWrapS_CmnMfgSrv_CallSvc10
      OsApplicationNonTrusted_Function = NtWrapS_NvM_ReadBlock
      OsApplicationNonTrusted_Function = NtWrapS_NvM_WriteBlock
      OsApplicationNonTrusted_Function = NtWrapS_Rte_Call_SetCalPageReq_Oper
      OsApplicationNonTrusted_Function = NtWrapS_Rte_Call_CopyCalPageReq_Oper
      OsApplicationNonTrusted_Function = NtWrapS_SyncCrc_GetAvlCrcHwUnit
      OsApplicationNonTrusted_Function = NtWrapS_SyncCrc_RelsCrcHwUnit
      OsApplicationNonTrusted_Function = NtWrapS_StHlthSigStc_ClrDataSample
      OsApplicationNonTrusted_Function = NtWrapS_StHlthSigStc_UpdNvmPim
      OsApplicationNonTrusted_Function = NtWrapS_StHlthSigStc_UpdDataSample
      OsAppTaskRef = Task_10msBsw_Appl10
      OsAppAlarmRef = Rte_Al_TE2_Task_10msBsw_Appl10_0_10ms
      OsAppTaskRef = Task_4msBsw_Appl10
      OsAppTaskRef = Task_InitBsw_Appl10
      OsAppAlarmRef = Rte_Al_TE2_Task_4msBsw_Appl10_0_4ms
      OsAppTaskRef = Task_2ms_Appl10
      OsAppTaskRef = Task_Init_Appl10
      OsAppAlarmRef = Rte_Al_TE_Task_2ms_Appl10_0_2ms
      OsAppTaskRef = Task_100ms_Appl10
      OsAppAlarmRef = Rte_Al_TE_Task_100ms_Appl10_0_100ms
      OsAppTaskRef = Task_4ms_Appl10
      OsAppAlarmRef = Rte_Al_TE_Task_4ms_Appl10_0_4ms
      OsAppAlarmRef = Rte_Al_TE_Task_10ms_Appl10_0_10ms
      OsAppTaskRef = Task_10ms_Appl10
      OsAppIsrRef = SnsrMeasStrtIrq
      OsAppIsrRef = MCU_ECM_EIC_CAT2_ISR
      OsApplicationHooks: OsAppStartupHook=false, OsAppShutdownHook=false, OsAppErrorHook=false
      ApplicationRAM (OsApplicationMpuRegion)
        Enable: OsApplicationStartAddr=Appl10_StartAddr, OsApplicationEndAddr=Appl10_EndAddr
    Rte_Al_TE2_Task_10msBsw_Appl10_0_10ms (OsAlarm): OsAlarmCounterRef=SystemTimer
      OsAlarmAction
        OsAlarmActivateTask: OsAlarmActivateTaskRef=Task_10msBsw_Appl10
    Appl0 (OsApplication):
      OsTrusted = true
      OsAppGenerateStub = true
      OsAppIsrRef = WDG_59_DRIVERA_TRIGGERFUNCTION_ISR
      OsAppIsrRef = SPI_CSIH0_TIC_CAT2_ISR
      OsAppIsrRef = SPI_CSIH0_TIRE_CAT2_ISR
      OsAppIsrRef = SPI_CSIH0_TIR_CAT2_ISR
      OsAppIsrRef = SPI_CSIH2_TIC_CAT2_ISR
      OsAppIsrRef = SPI_CSIH2_TIRE_CAT2_ISR
      OsAppIsrRef = SPI_CSIH2_TIR_CAT2_ISR
      OsAppIsrRef = MotCtrlMgrIrq
      OsAppIsrRef = SPI_CSIG0_TIC_CAT2_ISR
      OsAppIsrRef = SPI_CSIG0_TIRE_CAT2_ISR
      OsAppIsrRef = SPI_CSIG0_TIR_CAT2_ISR
      OsAppIsrRef = FEINT
      OsAppIsrRef = FpuErrIrq
      OsAppIsrRef = SysErrIrq
      OsAppIsrRef = EIINT0
      OsAppIsrRef = EIINT1
      OsAppIsrRef = EIINT{10..15}
      OsAppIsrRef = EIINT{2..9}
      OsAppIsrRef = MCU_FEINT_ISR
      OsAppIsrRef = AlgnErrIrq
      OsAppIsrRef = ResdOperIrq
      OsApplicationHooks: OsAppStartupHook=false, OsAppShutdownHook=false, OsAppErrorHook=false
      8 x OsApplicationTrustedFunction:
        Spi_AsyncTransmit: OsTrustedFunctionName=Spi_AsyncTransmit, OsApplicationParams=Spi_SequenceType Sequence, OsApplicationReturnType=Std_ReturnType
        Fls_MainFunction: OsTrustedFunctionName=Fls_MainFunction, OsApplicationParams=, OsApplicationReturnType=
        WdgM_Init: OsTrustedFunctionName=WdgM_Init, OsApplicationParams=const WdgM_ConfigType* WdgMConfigPtr, OsApplicationReturnType=
        DmaRegInin: OsTrustedFunctionName=DmaRegInin, OsApplicationParams=, OsApplicationReturnType=
        ApplXcpWrCmn: OsTrustedFunctionName=ApplXcpWrCmn, OsApplicationParams=MTABYTEPTR addr, vuint8 size, const BYTEPTR data, OsApplicationReturnType=
        NvM_MainFunction: OsTrustedFunctionName=NvM_MainFunction, OsApplicationParams=void, OsApplicationReturnType=void
        IpgInin: OsTrustedFunctionName=IpgInin, OsApplicationParams=void, OsApplicationReturnType=void
        Adc0OutpInin: OsTrustedFunctionName=Adc0OutpInin, OsApplicationParams=void, OsApplicationReturnType=void
    WDG_59_DRIVERA_TRIGGERFUNCTION_ISR (OsIsr): OsIsrCategory=CATEGORY_1, OsIsrEnableNesting=false
      OsIsrExceptionType
        EIINT: OsIsrIntChannel=9, OsIsrInterruptPriority=2, OsIsrInterruptStackSize=0
      OsIsrUseSpecialFunctionName
        FALSE
    Task_4msBsw_Appl10 (OsTask): OsTaskActivation=1, OsTaskPriority=90, OsTaskSchedule=FULL, OsTaskTYPE=BASIC, OsTaskStackSize=512
    Task_InitBsw_Appl10 (OsTask): OsTaskActivation=1, OsTaskPriority=99, OsTaskSchedule=FULL, OsTaskTYPE=BASIC, OsTaskStackSize=512
      OsTaskAutostart: OsTaskAppModeRef=OSDEFAULTAPPMODE
    Rte_Al_TE2_Task_4msBsw_Appl10_0_4ms (OsAlarm): OsAlarmCounterRef=SystemTimer
      OsAlarmAction
        OsAlarmActivateTask: OsAlarmActivateTaskRef=Task_4msBsw_Appl10
    Task_2ms_Appl10 (OsTask): OsTaskActivation=1, OsTaskPriority=81, OsTaskSchedule=FULL, OsTaskTYPE=BASIC, OsTaskStackSize=768, OsTaskAccessingApplication=Appl6
    Task_Init_Appl10 (OsTask): OsTaskActivation=1, OsTaskPriority=98, OsTaskSchedule=FULL, OsTaskTYPE=BASIC, OsTaskStackSize=1024, OsTaskAccessingApplication=Appl6
    Rte_Al_TE_Task_2ms_Appl10_0_2ms (OsAlarm): OsAlarmCounterRef=SystemTimer
      OsAlarmAction
        OsAlarmActivateTask: OsAlarmActivateTaskRef=Task_2ms_Appl10
    Appl6 (OsApplication):
      OsTrusted = false
      OsAppGenerateStub = false
      OsApplicationNonTrusted_Function = NtWrapS_GMLANInit
      OsApplicationNonTrusted_Function = NtWrapS_CanStop
      OsAppTaskRef = Task_2ms_Appl6
      OsAppIsrRef = CanIsrGlobalStatus
      OsAppIsrRef = CanIsrRxFifo
      OsAppIsrRef = CanIsrStatus_0
      OsAppIsrRef = CanIsrStatus_1
      OsAppIsrRef = CanIsrTx_0
      OsAppIsrRef = CanIsrTx_1
      OsAppTaskRef = Task_10ms_Appl6
      OsAppTaskRef = Task_Init_Appl6
      OsAppAlarmRef = Rte_Al_TE_Task_10ms_Appl6_0_10ms
      OsAppAlarmRef = Rte_Al_TE_Task_2ms_Appl6_0_2ms
      OsApplicationHooks: OsAppStartupHook=false, OsAppShutdownHook=false, OsAppErrorHook=false
      ApplicationRAM (OsApplicationMpuRegion)
        Enable: OsApplicationStartAddr=Appl6_StartAddr, OsApplicationEndAddr=Appl6_EndAddr
    Task_2ms_Appl6 (OsTask): OsTaskActivation=1, OsTaskPriority=80, OsTaskSchedule=FULL, OsTaskTYPE=BASIC, OsTaskStackSize=512, OsTaskAccessingApplication=Appl10
    6 x OsIsr, all with OsIsrCategory=CATEGORY_2, OsIsrEnableNesting=true:
      CanIsrGlobalStatus
        OsIsrExceptionType
          EIINT: OsIsrIntChannel=189, OsIsrInterruptPriority=15, OsIsrInterruptStackSize=1024
        OsIsrUseSpecialFunctionName
          FALSE
      CanIsrRxFifo
        OsIsrExceptionType
          EIINT: OsIsrIntChannel=190, OsIsrInterruptPriority=15, OsIsrInterruptStackSize=1024
        OsIsrUseSpecialFunctionName
          FALSE
      CanIsrStatus_0
        OsIsrExceptionType
          EIINT: OsIsrIntChannel=183, OsIsrInterruptPriority=15, OsIsrInterruptStackSize=1024
        OsIsrUseSpecialFunctionName
          FALSE
      CanIsrStatus_1
        OsIsrExceptionType
          EIINT: OsIsrIntChannel=186, OsIsrInterruptPriority=15, OsIsrInterruptStackSize=1024
        OsIsrUseSpecialFunctionName
          FALSE
      CanIsrTx_0
        OsIsrExceptionType
          EIINT: OsIsrIntChannel=185, OsIsrInterruptPriority=15, OsIsrInterruptStackSize=1024
        OsIsrUseSpecialFunctionName
          FALSE
      CanIsrTx_1
        OsIsrExceptionType
          EIINT: OsIsrIntChannel=188, OsIsrInterruptPriority=15, OsIsrInterruptStackSize=1024
        OsIsrUseSpecialFunctionName
          FALSE
    Task_10ms_Appl6 (OsTask): OsTaskActivation=1, OsTaskPriority=60, OsTaskSchedule=FULL, OsTaskTYPE=BASIC, OsTaskStackSize=1024, OsTaskAccessingApplication=Appl10
    6 x OsIsr, all with OsIsrCategory=CATEGORY_2, OsIsrEnableNesting=true:
      SPI_CSIH2_TIC_CAT2_ISR
        OsIsrExceptionType
          EIINT: OsIsrIntChannel=100, OsIsrInterruptPriority=14, OsIsrInterruptStackSize=512
        OsIsrUseSpecialFunctionName
          FALSE
      SPI_CSIH2_TIRE_CAT2_ISR
        OsIsrExceptionType
          EIINT: OsIsrIntChannel=98, OsIsrInterruptPriority=14, OsIsrInterruptStackSize=512
        OsIsrUseSpecialFunctionName
          FALSE
      SPI_CSIH2_TIR_CAT2_ISR
        OsIsrExceptionType
          EIINT: OsIsrIntChannel=99, OsIsrInterruptPriority=14, OsIsrInterruptStackSize=512
        OsIsrUseSpecialFunctionName
          FALSE
      SPI_CSIH0_TIC_CAT2_ISR
        OsIsrExceptionType
          EIINT: OsIsrIntChannel=84, OsIsrInterruptPriority=14, OsIsrInterruptStackSize=512
        OsIsrUseSpecialFunctionName
          FALSE
      SPI_CSIH0_TIR_CAT2_ISR
        OsIsrExceptionType
          EIINT: OsIsrIntChannel=83, OsIsrInterruptPriority=14, OsIsrInterruptStackSize=512
        OsIsrUseSpecialFunctionName
          FALSE
      SPI_CSIH0_TIRE_CAT2_ISR
        OsIsrExceptionType
          EIINT: OsIsrIntChannel=82, OsIsrInterruptPriority=14, OsIsrInterruptStackSize=512
        OsIsrUseSpecialFunctionName
          FALSE
    Task_100ms_Appl10 (OsTask): OsTaskActivation=1, OsTaskPriority=51, OsTaskSchedule=FULL, OsTaskTYPE=BASIC, OsTaskStackSize=512, OsTaskAccessingApplication=Appl6
    Rte_Al_TE_Task_100ms_Appl10_0_100ms (OsAlarm): OsAlarmCounterRef=SystemTimer
      OsAlarmAction
        OsAlarmActivateTask: OsAlarmActivateTaskRef=Task_100ms_Appl10
    Task_Init_Appl6 (OsTask): OsTaskActivation=1, OsTaskPriority=97, OsTaskSchedule=FULL, OsTaskTYPE=BASIC, OsTaskStackSize=512, OsTaskAccessingApplication=Appl10
    Rte_Al_TE_Task_10ms_Appl6_0_10ms (OsAlarm): OsAlarmCounterRef=SystemTimer, OsAlarmAccessingApplication=Appl10
      OsAlarmAction
        OsAlarmActivateTask: OsAlarmActivateTaskRef=Task_10ms_Appl6
    Rte_Al_TE_Task_2ms_Appl6_0_2ms (OsAlarm): OsAlarmCounterRef=SystemTimer, OsAlarmAccessingApplication=Appl10
      OsAlarmAction
        OsAlarmActivateTask: OsAlarmActivateTaskRef=Task_2ms_Appl6
    MotCtrlMgrIrq (OsIsr): OsIsrCategory=CATEGORY_1, OsIsrEnableNesting=false
      OsIsrExceptionType
        EIINT: OsIsrIntChannel=16, OsIsrInterruptPriority=1, OsIsrInterruptStackSize=0
      OsIsrUseSpecialFunctionName
        FALSE
    Task_4ms_Appl10 (OsTask): OsTaskActivation=1, OsTaskPriority=70, OsTaskSchedule=FULL, OsTaskTYPE=BASIC, OsTaskStackSize=512, OsTaskAccessingApplication=Appl6
    Rte_Al_TE_Task_4ms_Appl10_0_4ms (OsAlarm): OsAlarmCounterRef=SystemTimer
      OsAlarmAction
        OsAlarmActivateTask: OsAlarmActivateTaskRef=Task_4ms_Appl10
    3 x OsIsr, all with OsIsrCategory=CATEGORY_2, OsIsrEnableNesting=true:
      SPI_CSIG0_TIC_CAT2_ISR
        OsIsrExceptionType
          EIINT: OsIsrIntChannel=175, OsIsrInterruptPriority=14, OsIsrInterruptStackSize=512
        OsIsrUseSpecialFunctionName
          FALSE
      SPI_CSIG0_TIRE_CAT2_ISR
        OsIsrExceptionType
          EIINT: OsIsrIntChannel=174, OsIsrInterruptPriority=14, OsIsrInterruptStackSize=512
        OsIsrUseSpecialFunctionName
          FALSE
      SPI_CSIG0_TIR_CAT2_ISR
        OsIsrExceptionType
          EIINT: OsIsrIntChannel=176, OsIsrInterruptPriority=14, OsIsrInterruptStackSize=512
        OsIsrUseSpecialFunctionName
          FALSE
    Task_10ms_Appl10 (OsTask):
      OsTaskActivation = 1
      OsTaskPriority = 61
      OsTaskSchedule = FULL
      OsTaskTYPE = BASIC
      OsTaskStackSize = 512
      OsTaskAccessingApplication = Appl10
      OsTaskAccessingApplication = Appl6
    Rte_Al_TE_Task_10ms_Appl10_0_10ms (OsAlarm): OsAlarmCounterRef=SystemTimer
      OsAlarmAction
        OsAlarmActivateTask: OsAlarmActivateTaskRef=Task_10ms_Appl10
    24 x OsIsr, all with OsIsrEnableNesting=false:
      SnsrMeasStrtIrq: OsIsrCategory=CATEGORY_2
        OsIsrExceptionType
          EIINT: OsIsrIntChannel=75, OsIsrInterruptPriority=15, OsIsrInterruptStackSize=200
        OsIsrUseSpecialFunctionName
          FALSE
      SysErrIrq: OsIsrCategory=CATEGORY_1
        OsIsrExceptionType
          GENERAL_EXCEPTION: OsIsrExceptionAddress=16
        OsIsrUseSpecialFunctionName
          TRUE: OsIsrFunctionName=Patched_SysErrIrq
      FpuErrIrq: OsIsrCategory=CATEGORY_1
        OsIsrExceptionType
          GENERAL_EXCEPTION: OsIsrExceptionAddress=112
        OsIsrUseSpecialFunctionName
          TRUE: OsIsrFunctionName=Patched_FpuErrIrq
      AlgnErrIrq: OsIsrCategory=CATEGORY_1
        OsIsrExceptionType
          GENERAL_EXCEPTION: OsIsrExceptionAddress=192
        OsIsrUseSpecialFunctionName
          FALSE
      ResdOperIrq: OsIsrCategory=CATEGORY_1
        OsIsrExceptionType
          GENERAL_EXCEPTION: OsIsrExceptionAddress=96
        OsIsrUseSpecialFunctionName
          FALSE
      FEINT: OsIsrCategory=CATEGORY_1
        OsIsrExceptionType
          GENERAL_EXCEPTION: OsIsrExceptionAddress=240
        OsIsrUseSpecialFunctionName
          TRUE: OsIsrFunctionName=Patched_osUnhandledCoreException
      MCU_FEINT_ISR: OsIsrCategory=CATEGORY_1
        OsIsrExceptionType
          GENERAL_EXCEPTION: OsIsrExceptionAddress=224
        OsIsrUseSpecialFunctionName
          TRUE: OsIsrFunctionName=Patched_MCU_FEINT_ISR
      EIINT0: OsIsrCategory=CATEGORY_1
        OsIsrExceptionType
          GENERAL_EXCEPTION: OsIsrExceptionAddress=256
        OsIsrUseSpecialFunctionName
          TRUE: OsIsrFunctionName=Patched_osUnhandledEIINTException
      EIINT1: OsIsrCategory=CATEGORY_1
        OsIsrExceptionType
          GENERAL_EXCEPTION: OsIsrExceptionAddress=272
        OsIsrUseSpecialFunctionName
          TRUE: OsIsrFunctionName=Patched_osUnhandledEIINTException
      EIINT2: OsIsrCategory=CATEGORY_1
        OsIsrExceptionType
          GENERAL_EXCEPTION: OsIsrExceptionAddress=288
        OsIsrUseSpecialFunctionName
          TRUE: OsIsrFunctionName=Patched_osUnhandledEIINTException
      EIINT3: OsIsrCategory=CATEGORY_1
        OsIsrExceptionType
          GENERAL_EXCEPTION: OsIsrExceptionAddress=304
        OsIsrUseSpecialFunctionName
          TRUE: OsIsrFunctionName=Patched_osUnhandledEIINTException
      EIINT4: OsIsrCategory=CATEGORY_1
        OsIsrExceptionType
          GENERAL_EXCEPTION: OsIsrExceptionAddress=320
        OsIsrUseSpecialFunctionName
          TRUE: OsIsrFunctionName=Patched_osUnhandledEIINTException
      EIINT5: OsIsrCategory=CATEGORY_1
        OsIsrExceptionType
          GENERAL_EXCEPTION: OsIsrExceptionAddress=336
        OsIsrUseSpecialFunctionName
          TRUE: OsIsrFunctionName=Patched_osUnhandledEIINTException
      EIINT6: OsIsrCategory=CATEGORY_1
        OsIsrExceptionType
          GENERAL_EXCEPTION: OsIsrExceptionAddress=352
        OsIsrUseSpecialFunctionName
          TRUE: OsIsrFunctionName=Patched_osUnhandledEIINTException
      EIINT7: OsIsrCategory=CATEGORY_1
        OsIsrExceptionType
          GENERAL_EXCEPTION: OsIsrExceptionAddress=368
        OsIsrUseSpecialFunctionName
          TRUE: OsIsrFunctionName=Patched_osUnhandledEIINTException
      EIINT8: OsIsrCategory=CATEGORY_1
        OsIsrExceptionType
          GENERAL_EXCEPTION: OsIsrExceptionAddress=384
        OsIsrUseSpecialFunctionName
          TRUE: OsIsrFunctionName=Patched_osUnhandledEIINTException
      EIINT9: OsIsrCategory=CATEGORY_1
        OsIsrExceptionType
          GENERAL_EXCEPTION: OsIsrExceptionAddress=400
        OsIsrUseSpecialFunctionName
          TRUE: OsIsrFunctionName=Patched_osUnhandledEIINTException
      EIINT10: OsIsrCategory=CATEGORY_1
        OsIsrExceptionType
          GENERAL_EXCEPTION: OsIsrExceptionAddress=416
        OsIsrUseSpecialFunctionName
          TRUE: OsIsrFunctionName=Patched_osUnhandledEIINTException
      EIINT11: OsIsrCategory=CATEGORY_1
        OsIsrExceptionType
          GENERAL_EXCEPTION: OsIsrExceptionAddress=432
        OsIsrUseSpecialFunctionName
          TRUE: OsIsrFunctionName=Patched_osUnhandledEIINTException
      EIINT12: OsIsrCategory=CATEGORY_1
        OsIsrExceptionType
          GENERAL_EXCEPTION: OsIsrExceptionAddress=448
        OsIsrUseSpecialFunctionName
          TRUE: OsIsrFunctionName=Patched_osUnhandledEIINTException
      EIINT13: OsIsrCategory=CATEGORY_1
        OsIsrExceptionType
          GENERAL_EXCEPTION: OsIsrExceptionAddress=464
        OsIsrUseSpecialFunctionName
          TRUE: OsIsrFunctionName=Patched_osUnhandledEIINTException
      EIINT14: OsIsrCategory=CATEGORY_1
        OsIsrExceptionType
          GENERAL_EXCEPTION: OsIsrExceptionAddress=480
        OsIsrUseSpecialFunctionName
          TRUE: OsIsrFunctionName=Patched_osUnhandledEIINTException
      EIINT15: OsIsrCategory=CATEGORY_1
        OsIsrExceptionType
          GENERAL_EXCEPTION: OsIsrExceptionAddress=496
        OsIsrUseSpecialFunctionName
          TRUE: OsIsrFunctionName=Patched_osUnhandledEIINTException
      MCU_ECM_EIC_CAT2_ISR: OsIsrCategory=CATEGORY_2
        OsIsrExceptionType
          EIINT: OsIsrIntChannel=8, OsIsrInterruptPriority=3, OsIsrInterruptStackSize=512
        OsIsrUseSpecialFunctionName
          FALSE
