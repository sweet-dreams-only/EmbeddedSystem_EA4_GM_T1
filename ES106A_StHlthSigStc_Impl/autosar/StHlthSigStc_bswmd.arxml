AUTOSAR XML (schema 4-0-3)
package /Nxtr
  module definition StHlthSigStc [0..1]: variants pre-compile
    container StHlthSigStcSignalList [0..65536]  # List of signals to be monitored by State of Health Software
      container StHlthSigStcSignalSettings  # Signal Basic Settings
        string StHlthSigStcSignalName: set at pre-compile in variant pre-compile / link in variant link-time / post-build in variant post-build, origin=Nxtr  # Monitored Signal Name
        integer StHlthSigStcLoopTime: 1..100000, set at pre-compile in variant pre-compile / link in variant link-time / post-build in variant post-build, origin=Nxtr, default-value=1  # Time interval by which the signal gets updated
        boolean StHlthSigStcUpdatedInMotorIsr: set at pre-compile in variant pre-compile / link in variant link-time / post-build in variant post-build, origin=Nxtr, default-value=false  # Signal updated in Motor ISR
        reference StHlthSigStcSignalTaskReference [0..1]: set at pre-compile, origin=Nxtr, destination=OsTask  # Reference to the OS task in which this signal is updated. This need not be updated if the signal is updated in Motor ISR
    container StHlthSigStcCrConfigList [1..10]  # EN
      string StHlthSigStcCrcStartSymbol [1..10]: set at pre-compile in variant pre-compile / link in variant link-time / post-build in variant post-build, origin=Nxtr  # Start area of CRC
    container StHlthSigStcApplicationConfig [1..10]  # EN
      reference StHlthSigStcOsApplicationReference [0..1]: set at pre-compile, origin=Nxtr, destination=OsApplication  # Application in which StHlthSigStc component is running
