AUTOSAR XML (schema 4-0-3)
package /Nxtr
  module definition FlsMem [0..1]: variants pre-compile  # Configuration of the Flash CRC Blocks.
    container FlashCRCRegnConfig [0..255]  # This is the container for the Flash Block Configuration
      integer StartAddress: 0x00000000..0xFFFFFFFF, origin=NXTR  # Start Address of the Flash Block.
      integer Length: 0x00000000..0xFFFFFFFF, origin=NXTR  # Length of the Flash Block.
      integer PredefinedCrcAddress: 0x00000000..0xFFFFFFFF, origin=NXTR  # Start Address of the Flash Block.
