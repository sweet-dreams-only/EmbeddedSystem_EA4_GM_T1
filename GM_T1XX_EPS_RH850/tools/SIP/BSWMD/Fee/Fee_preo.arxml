AUTOSAR XML (schema 4-0-3)
# COPYRIGHT
# Copyright (c) 2013 by Vctr Informatik GmbH. All rights reserved.
# This software is copyright protected and proprietary to Vctr Informatik GmbH.
# Vctr Informatik GmbH grants to you only those rights as set out in the license conditions.
package /MICROSAR  # Fee Preconfiguration
  module config Fee_Pre: definition=Fee, implementation-config-variant=VARIANT-PRE-COMPILE
  module config Fee_Rec: definition=Fee
    FeeGeneral: FeeDevErrorDetect=1, FeeCfgChkParamBlockNumber=1, FeeVersionInfoApi=0, FeePollingMode=1, FeeSetModeSupported=1
      FeeDevErrorChecks: FeeDebugReporting=1, FeeDetErrorhook=Det_ReportError, FeeDetIncludeFile=Det.h
    FeeSpecificFeatures: FeeApplErrorCallbackFunction=Appl_FeeCriticalErrorCallback, FeeApplErrorCallbackIncludeFile=ApplMain.h
  module config Fee_Rec_Class1: definition=Fee
    FeeBlockConfiguration: FeeBlockIdFixed=0, FeeBlockIsCritical=0, FeeImmediateData=0, FeeNumberOfChunkInstances=1
