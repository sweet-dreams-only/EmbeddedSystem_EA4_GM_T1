AUTOSAR XML (schema 4-0-3)
package /ActiveEcuC
  module config DiagcMgr: implementation-config-variant=VARIANT-PRE-COMPILE, module-description=DiagcMgr_Impl
    172 x NTCNR:
      NTCNR_0X{001..004}: Debounce=false, NTCOsApplicationRef=Appl10
      NTCNR_0X{006..008}: Debounce=false, NTCOsApplicationRef=Appl10
      NTCNR_0X00A: Debounce=false, NTCOsApplicationRef=Appl10
      NTCNR_0X010: Debounce=false, NTCOsApplicationRef=Appl10
      NTCNR_0X012: Debounce=false, NTCOsApplicationRef=Appl10
      NTCNR_0X013: Debounce=false, NTCOsApplicationRef=Appl10
      NTCNR_0X{016..019}: Debounce=false, NTCOsApplicationRef=Appl10
      NTCNR_0X01A: Debounce=false, NTCOsApplicationRef=Appl10
      NTCNR_0X01B: Debounce=false, NTCOsApplicationRef=Appl10
      NTCNR_0X{020..023}: Debounce=false, NTCOsApplicationRef=Appl10
      NTCNR_0X{025..029}: Debounce=false, NTCOsApplicationRef=Appl10
      NTCNR_0X02A: Debounce=false, NTCOsApplicationRef=Appl10
      NTCNR_0X02C: Debounce=false, NTCOsApplicationRef=Appl10
      NTCNR_0X02D: Debounce=false, NTCOsApplicationRef=Appl10
      NTCNR_0X030: Debounce=false, NTCOsApplicationRef=Appl10
      NTCNR_0X031: Debounce=false, NTCOsApplicationRef=Appl10
      NTCNR_0X032: Debounce=true, NTCOsApplicationRef=Appl10
      NTCNR_0X033: Debounce=true, NTCOsApplicationRef=Appl10
      NTCNR_0X036: Debounce=false, NTCOsApplicationRef=Appl10
      NTCNR_0X037: Debounce=false, NTCOsApplicationRef=Appl10
      NTCNR_0X039: Debounce=false, NTCOsApplicationRef=Appl10
      NTCNR_0X03C: Debounce=true, NTCOsApplicationRef=Appl10
      NTCNR_0X040: Debounce=false, NTCOsApplicationRef=Appl10
      NTCNR_0X041: Debounce=false, NTCOsApplicationRef=Appl10
      NTCNR_0X042: Debounce=true, NTCOsApplicationRef=Appl10
      NTCNR_0X044: Debounce=true, NTCOsApplicationRef=Appl10
      NTCNR_0X045: Debounce=true, NTCOsApplicationRef=Appl10
      NTCNR_0X048: Debounce=false, NTCOsApplicationRef=Appl10
      NTCNR_0X049: Debounce=false, NTCOsApplicationRef=Appl10
      NTCNR_0X04A: Debounce=true, NTCOsApplicationRef=Appl10
      NTCNR_0X04C: Debounce=true, NTCOsApplicationRef=Appl10
      NTCNR_0X04D: Debounce=true, NTCOsApplicationRef=Appl10
      NTCNR_0X04E: Debounce=true, NTCOsApplicationRef=Appl10
      NTCNR_0X050: Debounce=true, NTCOsApplicationRef=Appl10
      NTCNR_0X051: Debounce=true, NTCOsApplicationRef=Appl10
      NTCNR_0X053: Debounce=false, NTCOsApplicationRef=Appl10
      NTCNR_0X054: Debounce=false, NTCOsApplicationRef=Appl10
      NTCNR_0X055: Debounce=true, NTCOsApplicationRef=Appl10
      NTCNR_0X05D: Debounce=true, NTCOsApplicationRef=Appl10
      NTCNR_0X060: Debounce=true, NTCOsApplicationRef=Appl10
      NTCNR_0X061: Debounce=true, NTCOsApplicationRef=Appl10
      NTCNR_0X063: Debounce=false, NTCOsApplicationRef=Appl10
      NTCNR_0X064: Debounce=false, NTCOsApplicationRef=Appl10
      NTCNR_0X065: Debounce=true, NTCOsApplicationRef=Appl10
      NTCNR_0X06D: Debounce=true, NTCOsApplicationRef=Appl10
      NTCNR_0X070: Debounce=false, NTCOsApplicationRef=Appl10
      NTCNR_0X071: Debounce=false, NTCOsApplicationRef=Appl10
      NTCNR_0X07B: Debounce=true, NTCOsApplicationRef=Appl10
      NTCNR_0X07C: Debounce=true, NTCOsApplicationRef=Appl10
      NTCNR_0X07D: Debounce=true, NTCOsApplicationRef=Appl10
      NTCNR_0X{080..082}: Debounce=true, NTCOsApplicationRef=Appl10
      NTCNR_0X092: Debounce=true, NTCOsApplicationRef=Appl10
      NTCNR_0X0A3: Debounce=false, NTCOsApplicationRef=Appl10
      NTCNR_0X0A4: Debounce=false, NTCOsApplicationRef=Appl10
      NTCNR_0X0AA: Debounce=false, NTCOsApplicationRef=Appl10
      NTCNR_0X0AB: Debounce=false, NTCOsApplicationRef=Appl10
      NTCNR_0X0AC: Debounce=false, NTCOsApplicationRef=Appl10
      NTCNR_0X0AD: Debounce=false, NTCOsApplicationRef=Appl10
      NTCNR_0X0AE: Debounce=false, NTCOsApplicationRef=Appl10
      NTCNR_0X0AF: Debounce=false, NTCOsApplicationRef=Appl10
      NTCNR_0X0B0: Debounce=true, NTCOsApplicationRef=Appl10
      NTCNR_0X0B1: Debounce=true, NTCOsApplicationRef=Appl10
      NTCNR_0X0B2: Debounce=false, NTCOsApplicationRef=Appl10
      NTCNR_0X0B5: Debounce=true, NTCOsApplicationRef=Appl10
      NTCNR_0X0BF: Debounce=false, NTCOsApplicationRef=Appl10
      NTCNR_0X0C4: Debounce=true, NTCOsApplicationRef=Appl10
      NTCNR_0X0C{5..7}: Debounce=false, NTCOsApplicationRef=Appl10
      NTCNR_0X0C9: Debounce=false, NTCOsApplicationRef=Appl10
      NTCNR_0X0D{2..5}: Debounce=true, NTCOsApplicationRef=Appl10
      NTCNR_0X0E0: Debounce=false, NTCOsApplicationRef=Appl10
      NTCNR_0X0E1: Debounce=true, NTCOsApplicationRef=Appl10
      NTCNR_0X0E2: Debounce=false, NTCOsApplicationRef=Appl10
      NTCNR_0X100: Debounce=false, NTCOsApplicationRef=Appl6
      NTCNR_0X110: Debounce=false, NTCOsApplicationRef=Appl6
      NTCNR_0X120: Debounce=false, NTCOsApplicationRef=Appl6
      NTCNR_0X121: Debounce=false, NTCOsApplicationRef=Appl6
      NTCNR_0X123: Debounce=false, NTCOsApplicationRef=Appl6
      NTCNR_0X128: Debounce=false, NTCOsApplicationRef=Appl6
      NTCNR_0X129: Debounce=false, NTCOsApplicationRef=Appl6
      NTCNR_0X131: Debounce=false, NTCOsApplicationRef=Appl6
      NTCNR_0X138: Debounce=false, NTCOsApplicationRef=Appl6
      NTCNR_0X139: Debounce=false, NTCOsApplicationRef=Appl6
      NTCNR_0X141: Debounce=false, NTCOsApplicationRef=Appl6
      NTCNR_0X151: Debounce=false, NTCOsApplicationRef=Appl6
      NTCNR_0X160: Debounce=false, NTCOsApplicationRef=Appl6
      NTCNR_0X161: Debounce=false, NTCOsApplicationRef=Appl6
      NTCNR_0X{168..171}: Debounce=false, NTCOsApplicationRef=Appl6
      NTCNR_0X178: Debounce=false, NTCOsApplicationRef=Appl6
      NTCNR_0X179: Debounce=false, NTCOsApplicationRef=Appl6
      NTCNR_0X17A: Debounce=false, NTCOsApplicationRef=Appl6
      NTCNR_0X17B: Debounce=false, NTCOsApplicationRef=Appl6
      NTCNR_0X188: Debounce=false, NTCOsApplicationRef=Appl6
      NTCNR_0X189: Debounce=false, NTCOsApplicationRef=Appl6
      NTCNR_0X18A: Debounce=false, NTCOsApplicationRef=Appl6
      NTCNR_0X18B: Debounce=false, NTCOsApplicationRef=Appl6
      NTCNR_0X{191..193}: Debounce=false, NTCOsApplicationRef=Appl6
      NTCNR_0X198: Debounce=false, NTCOsApplicationRef=Appl6
      NTCNR_0X199: Debounce=false, NTCOsApplicationRef=Appl6
      NTCNR_0X1A0: Debounce=false, NTCOsApplicationRef=Appl6
      NTCNR_0X1A1: Debounce=false, NTCOsApplicationRef=Appl6
      NTCNR_0X1A9: Debounce=false, NTCOsApplicationRef=Appl6
      NTCNR_0X1B0: Debounce=false, NTCOsApplicationRef=Appl6
      NTCNR_0X1B1: Debounce=false, NTCOsApplicationRef=Appl6
      NTCNR_0X1B8: Debounce=false, NTCOsApplicationRef=Appl6
      NTCNR_0X1B9: Debounce=false, NTCOsApplicationRef=Appl6
      NTCNR_0X1C{1..3}: Debounce=false, NTCOsApplicationRef=Appl6
      NTCNR_0X1C8: Debounce=false, NTCOsApplicationRef=Appl6
      NTCNR_0X1C9: Debounce=false, NTCOsApplicationRef=Appl6
      NTCNR_0X1EC: Debounce=false, NTCOsApplicationRef=Appl10
      NTCNR_0X1ED: Debounce=false, NTCOsApplicationRef=Appl10
      NTCNR_0X1F2: Debounce=false, NTCOsApplicationRef=Appl6
      NTCNR_0X1F{6..8}: Debounce=false, NTCOsApplicationRef=Appl10
      NTCNR_0X1FF: Debounce=false, NTCOsApplicationRef=Appl10
      NTCNR_0X073: Debounce=true, NTCOsApplicationRef=Appl10
      NTCNR_0X075: Debounce=true, NTCOsApplicationRef=Appl10
      NTCNR_0X077: Debounce=true, NTCOsApplicationRef=Appl10
      NTCNR_0X079: Debounce=true, NTCOsApplicationRef=Appl10
      NTCNR_0X083: Debounce=true, NTCOsApplicationRef=Appl10
      NTCNR_0X085: Debounce=true, NTCOsApplicationRef=Appl10
      NTCNR_0X{093..095}: Debounce=true, NTCOsApplicationRef=Appl10
      NTCNR_0X098: Debounce=true, NTCOsApplicationRef=Appl10
      NTCNR_0X099: Debounce=true, NTCOsApplicationRef=Appl10
      NTCNR_0X087: Debounce=true, NTCOsApplicationRef=Appl10
      NTCNR_0X1E{0..3}: Debounce=false, NTCOsApplicationRef=Appl10
      NTCNR_0X1F9: Debounce=false, NTCOsApplicationRef=Appl10
      NTCNR_0x1F9: Debounce=false, NTCOsApplicationRef=Appl10
      NTCNR_0X1FA: Debounce=false, NTCOsApplicationRef=Appl10
      NTCNR_0X0E3: Debounce=false, NTCOsApplicationRef=Appl10
      NTCNR_0X0A5: Debounce=false, NTCOsApplicationRef=Appl10
      NTCNR_0X07E: Debounce=false, NTCOsApplicationRef=Appl10
      NTCNR_0X07F: Debounce=false, NTCOsApplicationRef=Appl10
      NTCNR_0X01D: Debounce=false, NTCOsApplicationRef=Appl10
      NTCNR_0X097: Debounce=true, NTCOsApplicationRef=Appl10
      NTCNR_0X024: Debounce=false, NTCOsApplicationRef=Appl10
      NTCNR_0X02F: Debounce=false, NTCOsApplicationRef=Appl10
      NTCNR_0X0A2: Debounce=false, NTCOsApplicationRef=Appl10
    DiagcMgrGeneral: DIAGCMGR_DEMCHK=STD_ON, DEMTOTNROFDTC=DEM_CFG_GLOBAL_DTC_COUNT
    SysThermErrTHiClassEna (DTCEnaCndn):
      Bit_15 = false
      Bit_14 = false
      Bit_13 = false
      Bit_12 = false
      Bit_11 = false
      Bit_10 = false
      Bit__9 = false
      Bit__8 = true
      Bit__7 = false
      Bit__6 = false
      Bit__5 = false
      Bit__4 = true
      Bit__3 = false
      Bit__2 = true
      Bit__1 = true
      Bit__0 = true
      DiagcMgrDTCIdx = 1
      DTC = SysThermErrTHiClass
    7 x NTCNR, all with NTCOsApplicationRef=Appl10:
      NTCNR_0X1F1: Debounce=false
      NTCNR_0X02B: Debounce=true
      NTCNR_0X1D{0..4}: Debounce=false
    31 x DTCEnaCndn, all with Bit_15=false, Bit_14=false, Bit_13=false, Bit_12=false, Bit_11=false:
      SteerWheelAgSnsrCalNorPrfmdClassEna: Bit_10=false, Bit__9=false, Bit__8=true, Bit__7=false, Bit__6=false, Bit__5=false, Bit__4=true, Bit__3=false, Bit__2=true, Bit__1=true, Bit__0=true, DiagcMgrDTCIdx=2, DTC=SteerWheelAgSnsrCalNorPrfmdClass
      SteerWheelAgSnsrHwFltClassEna: Bit_10=false, Bit__9=false, Bit__8=false, Bit__7=false, Bit__6=false, Bit__5=false, Bit__4=true, Bit__3=false, Bit__2=true, Bit__1=true, Bit__0=true, DiagcMgrDTCIdx=3, DTC=SteerWheelAgSnsrHwFltClass
      SteerWheelAgSnsrPlauslyClassEna: Bit_10=false, Bit__9=false, Bit__8=true, Bit__7=false, Bit__6=false, Bit__5=false, Bit__4=true, Bit__3=false, Bit__2=true, Bit__1=true, Bit__0=true, DiagcMgrDTCIdx=4, DTC=SteerWheelAgSnsrPlauslyClass
      ElecSteerMotCircClassEna: Bit_10=false, Bit__9=false, Bit__8=false, Bit__7=false, Bit__6=false, Bit__5=false, Bit__4=true, Bit__3=false, Bit__2=true, Bit__1=true, Bit__0=false, DiagcMgrDTCIdx=5, DTC=ElecSteerMotCircClass
      ElecSteerMotPosSnsrCirClassEna: Bit_10=false, Bit__9=false, Bit__8=false, Bit__7=false, Bit__6=false, Bit__5=false, Bit__4=true, Bit__3=false, Bit__2=true, Bit__1=false, Bit__0=false, DiagcMgrDTCIdx=6, DTC=ElecSteerMotPosSnsrCirClass
      SteerWhlTqInpSnsrClassEna: Bit_10=false, Bit__9=false, Bit__8=true, Bit__7=false, Bit__6=false, Bit__5=false, Bit__4=true, Bit__3=false, Bit__2=true, Bit__1=false, Bit__0=false, DiagcMgrDTCIdx=7, DTC=SteerWhlTqInpSnsrClass
      SteerWhlTqInpSnsrCalNoLrndClassEna: Bit_10=false, Bit__9=false, Bit__8=true, Bit__7=false, Bit__6=false, Bit__5=false, Bit__4=true, Bit__3=false, Bit__2=true, Bit__1=true, Bit__0=true, DiagcMgrDTCIdx=8, DTC=SteerWhlTqInpSnsrCalNoLrndClass
      EcuHwPrfmcClassEna: Bit_10=false, Bit__9=false, Bit__8=false, Bit__7=false, Bit__6=false, Bit__5=false, Bit__4=true, Bit__3=false, Bit__2=true, Bit__1=false, Bit__0=false, DiagcMgrDTCIdx=9, DTC=EcuHwPrfmcClass
      EcuSwPrfmcCalDataSetNotProgdClassEna: Bit_10=false, Bit__9=false, Bit__8=true, Bit__7=false, Bit__6=false, Bit__5=false, Bit__4=true, Bit__3=false, Bit__2=true, Bit__1=true, Bit__0=true, DiagcMgrDTCIdx=10, DTC=EcuSwPrfmcCalDataSetNotProgdClass
      DevPwrVltgUnderThdClassEna: Bit_10=false, Bit__9=false, Bit__8=true, Bit__7=false, Bit__6=false, Bit__5=false, Bit__4=false, Bit__3=false, Bit__2=false, Bit__1=true, Bit__0=true, DiagcMgrDTCIdx=11, DTC=DevPwrVltgUnderThdClass
      DevPwrVltgOverMaxThdClassEna: Bit_10=false, Bit__9=false, Bit__8=true, Bit__7=false, Bit__6=false, Bit__5=false, Bit__4=false, Bit__3=false, Bit__2=false, Bit__1=true, Bit__0=true, DiagcMgrDTCIdx=12, DTC=DevPwrVltgOverMaxThdClass
      DevPwrVltgUnderMinThdClassEna: Bit_10=false, Bit__9=false, Bit__8=true, Bit__7=false, Bit__6=false, Bit__5=false, Bit__4=false, Bit__3=false, Bit__2=false, Bit__1=true, Bit__0=true, DiagcMgrDTCIdx=13, DTC=DevPwrVltgUnderMinThdClass
      SteerFailrMtgtnLvl1LimpHomeModClassEna: Bit_10=false, Bit__9=false, Bit__8=false, Bit__7=false, Bit__6=false, Bit__5=false, Bit__4=true, Bit__3=true, Bit__2=false, Bit__1=true, Bit__0=true, DiagcMgrDTCIdx=14, DTC=SteerFailrMtgtnLvl1LimpHomeModClass
      SteerFailrMtgtnLvl2LimpOverClassEna: Bit_10=false, Bit__9=false, Bit__8=false, Bit__7=false, Bit__6=false, Bit__5=false, Bit__4=true, Bit__3=true, Bit__2=false, Bit__1=true, Bit__0=true, DiagcMgrDTCIdx=15, DTC=SteerFailrMtgtnLvl2LimpOverClass
      SteerFailrMtgtnLvl3FadeOutClassEna: Bit_10=false, Bit__9=false, Bit__8=false, Bit__7=false, Bit__6=false, Bit__5=false, Bit__4=true, Bit__3=true, Bit__2=false, Bit__1=true, Bit__0=true, DiagcMgrDTCIdx=16, DTC=SteerFailrMtgtnLvl3FadeOutClass
      CtrlrComChassisExpBusOffClassEna: Bit_10=false, Bit__9=false, Bit__8=false, Bit__7=false, Bit__6=false, Bit__5=false, Bit__4=true, Bit__3=true, Bit__2=false, Bit__1=true, Bit__0=true, DiagcMgrDTCIdx=18, DTC=CtrlrComChassisExpBusOffClass
      CtrlrComHiSpdBusOffClassEna: Bit_10=true, Bit__9=false, Bit__8=false, Bit__7=false, Bit__6=false, Bit__5=false, Bit__4=true, Bit__3=true, Bit__2=false, Bit__1=false, Bit__0=false, DiagcMgrDTCIdx=17, DTC=CtrlrComHiSpdBusOffClass
      LostComWithEngCtrlModClassEna: Bit_10=false, Bit__9=true, Bit__8=true, Bit__7=false, Bit__6=true, Bit__5=true, Bit__4=true, Bit__3=true, Bit__2=false, Bit__1=true, Bit__0=true, DiagcMgrDTCIdx=19, DTC=LostComWithEngCtrlModClass
      LostComWithTrsmCtrlModClassEna: Bit_10=false, Bit__9=true, Bit__8=true, Bit__7=false, Bit__6=true, Bit__5=true, Bit__4=true, Bit__3=true, Bit__2=false, Bit__1=true, Bit__0=true, DiagcMgrDTCIdx=20, DTC=LostComWithTrsmCtrlModClass
      LostComWithElecBrkCtrlModChassisExpClassEna: Bit_10=false, Bit__9=true, Bit__8=true, Bit__7=true, Bit__6=false, Bit__5=true, Bit__4=true, Bit__3=true, Bit__2=false, Bit__1=true, Bit__0=true, DiagcMgrDTCIdx=31, DTC=LostComWithElecBrkCtrlModChassisExpClass
      LostComWithElecBrkCtrlModClassEna: Bit_10=false, Bit__9=true, Bit__8=true, Bit__7=false, Bit__6=true, Bit__5=true, Bit__4=true, Bit__3=true, Bit__2=false, Bit__1=true, Bit__0=true, DiagcMgrDTCIdx=21, DTC=LostComWithElecBrkCtrlModClass
      LostComWithBodyCtrlModClassEna: Bit_10=false, Bit__9=true, Bit__8=true, Bit__7=false, Bit__6=true, Bit__5=true, Bit__4=true, Bit__3=true, Bit__2=false, Bit__1=true, Bit__0=true, DiagcMgrDTCIdx=22, DTC=LostComWithBodyCtrlModClass
      LostComWithParkAssiCtrlModClassEna: Bit_10=false, Bit__9=true, Bit__8=true, Bit__7=false, Bit__6=true, Bit__5=true, Bit__4=true, Bit__3=true, Bit__2=false, Bit__1=true, Bit__0=true, DiagcMgrDTCIdx=23, DTC=LostComWithParkAssiCtrlModClass
      LostComWithFrntCameraCtrlModClassEna: Bit_10=false, Bit__9=true, Bit__8=true, Bit__7=false, Bit__6=true, Bit__5=true, Bit__4=true, Bit__3=true, Bit__2=false, Bit__1=true, Bit__0=true, DiagcMgrDTCIdx=24, DTC=LostComWithFrntCameraCtrlModClass
      InvldDataRxdFromBodtCtrlModClassEna: Bit_10=false, Bit__9=true, Bit__8=true, Bit__7=false, Bit__6=false, Bit__5=true, Bit__4=true, Bit__3=true, Bit__2=false, Bit__1=true, Bit__0=true, DiagcMgrDTCIdx=28, DTC=InvldDataRxdFromBodtCtrlModClass
      InvldDataRxdFromElecBrkCtrlModChassisExpClassEna: Bit_10=false, Bit__9=true, Bit__8=true, Bit__7=false, Bit__6=false, Bit__5=true, Bit__4=true, Bit__3=true, Bit__2=false, Bit__1=true, Bit__0=true, DiagcMgrDTCIdx=32, DTC=InvldDataRxdFromElecBrkCtrlModChassisExpClass
      InvldDataRxdFromElecBrkCtrlModClassEna: Bit_10=false, Bit__9=true, Bit__8=true, Bit__7=false, Bit__6=false, Bit__5=true, Bit__4=true, Bit__3=true, Bit__2=false, Bit__1=true, Bit__0=true, DiagcMgrDTCIdx=27, DTC=InvldDataRxdFromElecBrkCtrlModClass
      InvldDataRxdFromEngCtrlModClassEna: Bit_10=false, Bit__9=true, Bit__8=true, Bit__7=false, Bit__6=false, Bit__5=true, Bit__4=true, Bit__3=true, Bit__2=false, Bit__1=true, Bit__0=true, DiagcMgrDTCIdx=25, DTC=InvldDataRxdFromEngCtrlModClass
      InvldDataRxdFromFrntCameraModClassEna: Bit_10=false, Bit__9=true, Bit__8=true, Bit__7=false, Bit__6=false, Bit__5=true, Bit__4=true, Bit__3=true, Bit__2=false, Bit__1=true, Bit__0=true, DiagcMgrDTCIdx=30, DTC=InvldDataRxdFromFrntCameraModClass
      InvldDataRxdFromParkAssiCtrlModClassEna: Bit_10=false, Bit__9=true, Bit__8=true, Bit__7=false, Bit__6=false, Bit__5=true, Bit__4=true, Bit__3=true, Bit__2=false, Bit__1=true, Bit__0=true, DiagcMgrDTCIdx=29, DTC=InvldDataRxdFromParkAssiCtrlModClass
      InvldDataRxdFromTrsmCtrlModClassEna: Bit_10=false, Bit__9=true, Bit__8=true, Bit__7=false, Bit__6=false, Bit__5=true, Bit__4=true, Bit__3=true, Bit__2=false, Bit__1=true, Bit__0=true, DiagcMgrDTCIdx=26, DTC=InvldDataRxdFromTrsmCtrlModClass
    5 x NTCNR, all with NTCOsApplicationRef=Appl10:
      NTCNR_0X03D: Debounce=true
      NTCNR_0X0A1: Debounce=false
      NTCNR_0X0A6: Debounce=true
      NTCNR_0X0A7: Debounce=false
      NTCNR_0X1E4: Debounce=false
