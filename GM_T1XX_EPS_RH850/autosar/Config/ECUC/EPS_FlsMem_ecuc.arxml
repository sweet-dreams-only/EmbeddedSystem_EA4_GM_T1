AUTOSAR XML (schema 4-0-3)
package /ActiveEcuC
  module config FlsMem: implementation-config-variant=VARIANT-PRE-COMPILE
    5 x FlashCRCRegnConfig:
      Application: StartAddress=98816, Length=654320, PredefinedCrcAddress=753136
      Bootloader: StartAddress=0, Length=98288, PredefinedCrcAddress=98288
      CalRegn01: StartAddress=786464, Length=130512, PredefinedCrcAddress=916976
      CalRegn02: StartAddress=753696, Length=32208, PredefinedCrcAddress=785904
      CalRegn03: StartAddress=917536, Length=130512, PredefinedCrcAddress=1048048
