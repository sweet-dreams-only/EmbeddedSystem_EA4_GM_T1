AUTOSAR XML (schema 4-0-3)
package /ActiveEcuC
  module config Adc1CfgAndUse: implementation-config-variant=VARIANT-PRE-COMPILE
    Adc1CfgAndUseGeneral:
      ADCD1VCR00 = 24580
      ADCD1VCR01 = 0
      ADCD1VCR02 = 2
      ADCD1VCR03 = 4
      ADCD1VCR04 = 5
      ADCD1VCR05 = 9
      ADCD1VCR06 = 11
      ADCD1VCR07 = 24588
      ADCD1VCR08 = 24580
      ADCD1VCR09 = 1
      ADCD1VCR10 = 24588
      ADCD1VCR{11..20} = 24584
      ADCD1SGVCSP2 = 8
      ADCD1SGVCSP3 = 0
      ADCD1SGVCEP2 = 10
      ADCD1SGVCEP3 = 7
