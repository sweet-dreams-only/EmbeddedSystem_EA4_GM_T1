AUTOSAR XML (schema 4-0-3)
package /ActiveEcuC
  module config HwAg0Meas: implementation-config-variant=VARIANT-PRE-COMPILE
    HwAg0MeasGeneral: NTC_HwAg0MfgFlt=NTCNR_0X1F9, NTC_HwAg0IfFlt=NTCNR_0X094, NTC_HwAg0Snsr0PrtclFlt=NTCNR_0X093, NTC_HwAg0Snsr1PrtclFlt=NTCNR_0X095
