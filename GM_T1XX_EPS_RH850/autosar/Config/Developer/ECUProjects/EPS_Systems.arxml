AUTOSAR XML (schema 4-0-3)
package /DaVinci/PKG_ECU
  ecu instance EPS
package /ECUCompositionTypes
  composition sw component type ECU_Composition
package /EndToEndProtections
  end to end protection set EndToEndConnections
package /Systems
  system EPS: category=SYSTEM_EXTRACT
    system mapping EPS_MPPNG
    root-software-compositions:
      root sw composition prototype ECU_Composition: software-composition=ECU_Composition
