[part 2 of 2: packages /ECUCompositionTypes to /VehicleProject]
AUTOSAR XML (schema 4-0-3)
package /ECUCompositionTypes  (continued)
  composition sw component type ECU_Composition  (continued)
    connect CalRegn03Rt00GroupA.HysCmpFricWhlImbRejctnBlndY -> HysCmp.HysCmpFricWhlImbRejctnBlndY
    connect CalRegn03Rt00GroupA.HysCmpFricWhlImbRejctnOffY -> HysCmp.HysCmpFricWhlImbRejctnOffY
    connect CalRegn03Rt00GroupA.HysCmpFricWhlImbRejctnOnY -> HysCmp.HysCmpFricWhlImbRejctnOnY
    connect CalRegn03Rt00GroupA.InertiaCmpVelAssiBasdDampgCoeffX -> InertiaCmpVel.InertiaCmpVelAssiBasdDampgCoeffX
    connect CalRegn03Rt00GroupA.InertiaCmpVelAssiBasdDampgRollgY -> InertiaCmpVel.InertiaCmpVelAssiBasdDampgRollgY
    connect CalRegn03Rt00GroupA.InertiaCmpVelAssiBasdDampgStatY -> InertiaCmpVel.InertiaCmpVelAssiBasdDampgStatY
    connect CalRegn03Rt00GroupA.InertiaCmpVelDampgSpdBlndY -> InertiaCmpVel.InertiaCmpVelDampgSpdBlndY
    connect CalRegn03Rt00GroupA.InertiaCmpVelNotchBlndY -> InertiaCmpVel.InertiaCmpVelNotchBlndY
    connect CalRegn03Rt00GroupA.RtnHwAgOffsCalcdX -> Rtn.RtnHwAgOffsCalcdX
    connect CalRegn03Rt00GroupA.RtnHwAgOffsCalcdY -> Rtn.RtnHwAgOffsCalcdY
    connect CalRegn03Rt00GroupA.RtnScaTqX -> Rtn.RtnScaTqX
    connect CalRegn03Rt00GroupA.RtnScaTqY -> Rtn.RtnScaTqY
    connect CalRegn03Rt00GroupA.RtnScaVelX -> Rtn.RtnScaVelX
    connect CalRegn03Rt00GroupA.RtnScaVelY -> Rtn.RtnScaVelY
    connect CalRegn03Rt00GroupB.AssiHiFrqTqWhlImbRejctnTqX -> AAACalRegn03Rt01GroupB_Dummy.AssiHiFrqTqWhlImbRejctnTqX
    connect CalRegn03Rt00GroupB.AssiHiFrqWhlImbRejctnBlndX -> AAACalRegn03Rt01GroupB_Dummy.AssiHiFrqWhlImbRejctnBlndX
    connect CalRegn03Rt00GroupB.AssiHiFrqWhlImbRejctnBlndY -> AAACalRegn03Rt01GroupB_Dummy.AssiHiFrqWhlImbRejctnBlndY
    connect CalRegn03Rt00GroupB.AssiHiFrqWhlImbRejctnGainY -> AAACalRegn03Rt01GroupB_Dummy.AssiHiFrqWhlImbRejctnGainY
    connect CalRegn03Rt00GroupB.AssiMotTqWhlImbRejctnMaxX -> AAACalRegn03Rt01GroupB_Dummy.AssiMotTqWhlImbRejctnMaxX
    connect CalRegn03Rt00GroupB.AssiMotTqWhlImbRejctnMaxY -> AAACalRegn03Rt01GroupB_Dummy.AssiMotTqWhlImbRejctnMaxY
    connect CalRegn03Rt00GroupB.AssiWhlImbRejctnBlndScaX -> AAACalRegn03Rt01GroupB_Dummy.AssiWhlImbRejctnBlndScaX
    connect CalRegn03Rt00GroupB.AssiWhlImbRejctnBlndScaY -> AAACalRegn03Rt01GroupB_Dummy.AssiWhlImbRejctnBlndScaY
    connect CalRegn03Rt00GroupB.EotProtnDampgVehSpdTbl -> AAACalRegn03Rt01GroupB_Dummy.EotProtnDampgVehSpdTbl
    connect CalRegn03Rt00GroupB.EotProtnEntrGainVehSpdTbl -> AAACalRegn03Rt01GroupB_Dummy.EotProtnEntrGainVehSpdTbl
    connect CalRegn03Rt00GroupB.EotProtnEntrGainX -> AAACalRegn03Rt01GroupB_Dummy.EotProtnEntrGainX
    connect CalRegn03Rt00GroupB.EotProtnEntrGainY -> AAACalRegn03Rt01GroupB_Dummy.EotProtnEntrGainY
    connect CalRegn03Rt00GroupB.EotProtnExitDampgY -> AAACalRegn03Rt01GroupB_Dummy.EotProtnExitDampgY
    connect CalRegn03Rt00GroupB.EotProtnHwDegDampgX -> AAACalRegn03Rt01GroupB_Dummy.EotProtnHwDegDampgX
    connect CalRegn03Rt00GroupB.EotProtnNormDampgY -> AAACalRegn03Rt01GroupB_Dummy.EotProtnNormDampgY
    connect CalRegn03Rt00GroupB.InertiaCmpVelAssiBasdDampgRollgWhlImbRejctnOnY -> AAACalRegn03Rt01GroupB_Dummy.InertiaCmpVelAssiBasdDampgRollgWhlImbRejctnOnY
    connect CalRegn03Rt00GroupB.AssiMotTqWhlImbRejctnMaxX -> Assi.AssiMotTqWhlImbRejctnMaxX
    connect CalRegn03Rt00GroupB.AssiMotTqWhlImbRejctnMaxY -> Assi.AssiMotTqWhlImbRejctnMaxY
    connect CalRegn03Rt00GroupB.AssiWhlImbRejctnBlndScaX -> Assi.AssiWhlImbRejctnBlndScaX
    connect CalRegn03Rt00GroupB.AssiWhlImbRejctnBlndScaY -> Assi.AssiWhlImbRejctnBlndScaY
    connect CalRegn03Rt00GroupB.AssiHiFrqTqWhlImbRejctnTqX -> AssiHiFrq.AssiHiFrqTqWhlImbRejctnTqX
    connect CalRegn03Rt00GroupB.AssiHiFrqWhlImbRejctnBlndX -> AssiHiFrq.AssiHiFrqWhlImbRejctnBlndX
    connect CalRegn03Rt00GroupB.AssiHiFrqWhlImbRejctnBlndY -> AssiHiFrq.AssiHiFrqWhlImbRejctnBlndY
    connect CalRegn03Rt00GroupB.AssiHiFrqWhlImbRejctnGainY -> AssiHiFrq.AssiHiFrqWhlImbRejctnGainY
    connect CalRegn03Rt00GroupB.EotProtnDampgVehSpdTbl -> EotProtn.EotProtnDampgVehSpdTbl
    connect CalRegn03Rt00GroupB.EotProtnEntrGainVehSpdTbl -> EotProtn.EotProtnEntrGainVehSpdTbl
    connect CalRegn03Rt00GroupB.EotProtnEntrGainX -> EotProtn.EotProtnEntrGainX
    connect CalRegn03Rt00GroupB.EotProtnEntrGainY -> EotProtn.EotProtnEntrGainY
    connect CalRegn03Rt00GroupB.EotProtnExitDampgY -> EotProtn.EotProtnExitDampgY
    connect CalRegn03Rt00GroupB.EotProtnHwDegDampgX -> EotProtn.EotProtnHwDegDampgX
    connect CalRegn03Rt00GroupB.EotProtnNormDampgY -> EotProtn.EotProtnNormDampgY
    connect CalRegn03Rt00GroupB.EotProtnHwDegDampgX -> EotProtnFwl.EotProtnHwDegDampgX
    connect CalRegn03Rt00GroupB.InertiaCmpVelAssiBasdDampgRollgWhlImbRejctnOnY -> InertiaCmpVel.InertiaCmpVelAssiBasdDampgRollgWhlImbRejctnOnY
    connect CalRegn03Rt01.InertiaCmpVelDampgFilFrq -> AAACalRegn03Rt01_Dummy_1.InertiaCmpVelDampgFilFrq
    connect CalRegn03Rt01.InertiaCmpVelDampgFilFrqWhlImbRejctnOn -> AAACalRegn03Rt01_Dummy_1.InertiaCmpVelDampgFilFrqWhlImbRejctnOn
    connect CalRegn03Rt01GroupA.AssiHiFrqGainY -> AAACalRegn03Rt01GroupA_Dummy.AssiHiFrqGainY
    connect CalRegn03Rt01GroupA.AssiHiFrqTqX -> AAACalRegn03Rt01GroupA_Dummy.AssiHiFrqTqX
    connect CalRegn03Rt01GroupA.AssiMotTqWhlImbRejctnMinX -> AAACalRegn03Rt01GroupA_Dummy.AssiMotTqWhlImbRejctnMinX
    connect CalRegn03Rt01GroupA.AssiMotTqWhlImbRejctnMinY -> AAACalRegn03Rt01GroupA_Dummy.AssiMotTqWhlImbRejctnMinY
    connect CalRegn03Rt01GroupA.DampgHydCoeff{1..4}ScaY -> AAACalRegn03Rt01GroupA_Dummy.DampgHydCoeff{1..4}ScaY
    connect CalRegn03Rt01GroupA.DampgMotVelX -> AAACalRegn03Rt01GroupA_Dummy.DampgMotVelX
    connect CalRegn03Rt01GroupA.DampgMotVelY -> AAACalRegn03Rt01GroupA_Dummy.DampgMotVelY
    connect CalRegn03Rt01GroupA.HysCmpFricWhlImbRejctnBlndX -> AAACalRegn03Rt01GroupA_Dummy.HysCmpFricWhlImbRejctnBlndX
    connect CalRegn03Rt01GroupA.HysCmpFricWhlImbRejctnBlndY -> AAACalRegn03Rt01GroupA_Dummy.HysCmpFricWhlImbRejctnBlndY
    connect CalRegn03Rt01GroupA.HysCmpFricWhlImbRejctnOffY -> AAACalRegn03Rt01GroupA_Dummy.HysCmpFricWhlImbRejctnOffY
    connect CalRegn03Rt01GroupA.HysCmpFricWhlImbRejctnOnY -> AAACalRegn03Rt01GroupA_Dummy.HysCmpFricWhlImbRejctnOnY
    connect CalRegn03Rt01GroupA.InertiaCmpVelAssiBasdDampgCoeffX -> AAACalRegn03Rt01GroupA_Dummy.InertiaCmpVelAssiBasdDampgCoeffX
    connect CalRegn03Rt01GroupA.InertiaCmpVelAssiBasdDampgRollgY -> AAACalRegn03Rt01GroupA_Dummy.InertiaCmpVelAssiBasdDampgRollgY
    connect CalRegn03Rt01GroupA.InertiaCmpVelAssiBasdDampgStatY -> AAACalRegn03Rt01GroupA_Dummy.InertiaCmpVelAssiBasdDampgStatY
    connect CalRegn03Rt01GroupA.InertiaCmpVelDampgSpdBlndY -> AAACalRegn03Rt01GroupA_Dummy.InertiaCmpVelDampgSpdBlndY
    connect CalRegn03Rt01GroupA.InertiaCmpVelNotchBlndY -> AAACalRegn03Rt01GroupA_Dummy.InertiaCmpVelNotchBlndY
    connect CalRegn03Rt01GroupA.RtnHwAgOffsCalcdX -> AAACalRegn03Rt01GroupA_Dummy.RtnHwAgOffsCalcdX
    connect CalRegn03Rt01GroupA.RtnHwAgOffsCalcdY -> AAACalRegn03Rt01GroupA_Dummy.RtnHwAgOffsCalcdY
    connect CalRegn03Rt01GroupA.RtnScaTqX -> AAACalRegn03Rt01GroupA_Dummy.RtnScaTqX
    connect CalRegn03Rt01GroupA.RtnScaTqY -> AAACalRegn03Rt01GroupA_Dummy.RtnScaTqY
    connect CalRegn03Rt01GroupA.RtnScaVelX -> AAACalRegn03Rt01GroupA_Dummy.RtnScaVelX
    connect CalRegn03Rt01GroupA.RtnScaVelY -> AAACalRegn03Rt01GroupA_Dummy.RtnScaVelY
    connect CalRegn03Rt01GroupB.AssiHiFrqTqWhlImbRejctnTqX -> AAACalRegn03Rt01GroupB_Dummy_1.AssiHiFrqTqWhlImbRejctnTqX
    connect CalRegn03Rt01GroupB.AssiHiFrqWhlImbRejctnBlndX -> AAACalRegn03Rt01GroupB_Dummy_1.AssiHiFrqWhlImbRejctnBlndX
    connect CalRegn03Rt01GroupB.AssiHiFrqWhlImbRejctnBlndY -> AAACalRegn03Rt01GroupB_Dummy_1.AssiHiFrqWhlImbRejctnBlndY
    connect CalRegn03Rt01GroupB.AssiHiFrqWhlImbRejctnGainY -> AAACalRegn03Rt01GroupB_Dummy_1.AssiHiFrqWhlImbRejctnGainY
    connect CalRegn03Rt01GroupB.AssiMotTqWhlImbRejctnMaxX -> AAACalRegn03Rt01GroupB_Dummy_1.AssiMotTqWhlImbRejctnMaxX
    connect CalRegn03Rt01GroupB.AssiMotTqWhlImbRejctnMaxY -> AAACalRegn03Rt01GroupB_Dummy_1.AssiMotTqWhlImbRejctnMaxY
    connect CalRegn03Rt01GroupB.AssiWhlImbRejctnBlndScaX -> AAACalRegn03Rt01GroupB_Dummy_1.AssiWhlImbRejctnBlndScaX
    connect CalRegn03Rt01GroupB.AssiWhlImbRejctnBlndScaY -> AAACalRegn03Rt01GroupB_Dummy_1.AssiWhlImbRejctnBlndScaY
    connect CalRegn03Rt01GroupB.EotProtnDampgVehSpdTbl -> AAACalRegn03Rt01GroupB_Dummy_1.EotProtnDampgVehSpdTbl
    connect CalRegn03Rt01GroupB.EotProtnEntrGainVehSpdTbl -> AAACalRegn03Rt01GroupB_Dummy_1.EotProtnEntrGainVehSpdTbl
    connect CalRegn03Rt01GroupB.EotProtnEntrGainX -> AAACalRegn03Rt01GroupB_Dummy_1.EotProtnEntrGainX
    connect CalRegn03Rt01GroupB.EotProtnEntrGainY -> AAACalRegn03Rt01GroupB_Dummy_1.EotProtnEntrGainY
    connect CalRegn03Rt01GroupB.EotProtnExitDampgY -> AAACalRegn03Rt01GroupB_Dummy_1.EotProtnExitDampgY
    connect CalRegn03Rt01GroupB.EotProtnHwDegDampgX -> AAACalRegn03Rt01GroupB_Dummy_1.EotProtnHwDegDampgX
    connect CalRegn03Rt01GroupB.EotProtnNormDampgY -> AAACalRegn03Rt01GroupB_Dummy_1.EotProtnNormDampgY
    connect CalRegn03Rt01GroupB.InertiaCmpVelAssiBasdDampgRollgWhlImbRejctnOnY -> AAACalRegn03Rt01GroupB_Dummy_1.InertiaCmpVelAssiBasdDampgRollgWhlImbRejctnOnY
    connect CalRegn03Rt02.InertiaCmpVelDampgFilFrq -> AAACalRegn03Rt01_Dummy_2.InertiaCmpVelDampgFilFrq
    connect CalRegn03Rt02.InertiaCmpVelDampgFilFrqWhlImbRejctnOn -> AAACalRegn03Rt01_Dummy_2.InertiaCmpVelDampgFilFrqWhlImbRejctnOn
    connect CalRegn03Rt02GroupA.AssiHiFrqGainY -> AAACalRegn03Rt01GroupA_Dummy_1.AssiHiFrqGainY
    connect CalRegn03Rt02GroupA.AssiHiFrqTqX -> AAACalRegn03Rt01GroupA_Dummy_1.AssiHiFrqTqX
    connect CalRegn03Rt02GroupA.AssiMotTqWhlImbRejctnMinX -> AAACalRegn03Rt01GroupA_Dummy_1.AssiMotTqWhlImbRejctnMinX
    connect CalRegn03Rt02GroupA.AssiMotTqWhlImbRejctnMinY -> AAACalRegn03Rt01GroupA_Dummy_1.AssiMotTqWhlImbRejctnMinY
    connect CalRegn03Rt02GroupA.DampgHydCoeff{1..4}ScaY -> AAACalRegn03Rt01GroupA_Dummy_1.DampgHydCoeff{1..4}ScaY
    connect CalRegn03Rt02GroupA.DampgMotVelX -> AAACalRegn03Rt01GroupA_Dummy_1.DampgMotVelX
    connect CalRegn03Rt02GroupA.DampgMotVelY -> AAACalRegn03Rt01GroupA_Dummy_1.DampgMotVelY
    connect CalRegn03Rt02GroupA.HysCmpFricWhlImbRejctnBlndX -> AAACalRegn03Rt01GroupA_Dummy_1.HysCmpFricWhlImbRejctnBlndX
    connect CalRegn03Rt02GroupA.HysCmpFricWhlImbRejctnBlndY -> AAACalRegn03Rt01GroupA_Dummy_1.HysCmpFricWhlImbRejctnBlndY
    connect CalRegn03Rt02GroupA.HysCmpFricWhlImbRejctnOffY -> AAACalRegn03Rt01GroupA_Dummy_1.HysCmpFricWhlImbRejctnOffY
    connect CalRegn03Rt02GroupA.HysCmpFricWhlImbRejctnOnY -> AAACalRegn03Rt01GroupA_Dummy_1.HysCmpFricWhlImbRejctnOnY
    connect CalRegn03Rt02GroupA.InertiaCmpVelAssiBasdDampgCoeffX -> AAACalRegn03Rt01GroupA_Dummy_1.InertiaCmpVelAssiBasdDampgCoeffX
    connect CalRegn03Rt02GroupA.InertiaCmpVelAssiBasdDampgRollgY -> AAACalRegn03Rt01GroupA_Dummy_1.InertiaCmpVelAssiBasdDampgRollgY
    connect CalRegn03Rt02GroupA.InertiaCmpVelAssiBasdDampgStatY -> AAACalRegn03Rt01GroupA_Dummy_1.InertiaCmpVelAssiBasdDampgStatY
    connect CalRegn03Rt02GroupA.InertiaCmpVelDampgSpdBlndY -> AAACalRegn03Rt01GroupA_Dummy_1.InertiaCmpVelDampgSpdBlndY
    connect CalRegn03Rt02GroupA.InertiaCmpVelNotchBlndY -> AAACalRegn03Rt01GroupA_Dummy_1.InertiaCmpVelNotchBlndY
    connect CalRegn03Rt02GroupA.RtnHwAgOffsCalcdX -> AAACalRegn03Rt01GroupA_Dummy_1.RtnHwAgOffsCalcdX
    connect CalRegn03Rt02GroupA.RtnHwAgOffsCalcdY -> AAACalRegn03Rt01GroupA_Dummy_1.RtnHwAgOffsCalcdY
    connect CalRegn03Rt02GroupA.RtnScaTqX -> AAACalRegn03Rt01GroupA_Dummy_1.RtnScaTqX
    connect CalRegn03Rt02GroupA.RtnScaTqY -> AAACalRegn03Rt01GroupA_Dummy_1.RtnScaTqY
    connect CalRegn03Rt02GroupA.RtnScaVelX -> AAACalRegn03Rt01GroupA_Dummy_1.RtnScaVelX
    connect CalRegn03Rt02GroupA.RtnScaVelY -> AAACalRegn03Rt01GroupA_Dummy_1.RtnScaVelY
    connect CalRegn03Rt02GroupB.AssiHiFrqTqWhlImbRejctnTqX -> AAACalRegn03Rt01GroupB_Dummy_2.AssiHiFrqTqWhlImbRejctnTqX
    connect CalRegn03Rt02GroupB.AssiHiFrqWhlImbRejctnBlndX -> AAACalRegn03Rt01GroupB_Dummy_2.AssiHiFrqWhlImbRejctnBlndX
    connect CalRegn03Rt02GroupB.AssiHiFrqWhlImbRejctnBlndY -> AAACalRegn03Rt01GroupB_Dummy_2.AssiHiFrqWhlImbRejctnBlndY
    connect CalRegn03Rt02GroupB.AssiHiFrqWhlImbRejctnGainY -> AAACalRegn03Rt01GroupB_Dummy_2.AssiHiFrqWhlImbRejctnGainY
    connect CalRegn03Rt02GroupB.AssiMotTqWhlImbRejctnMaxX -> AAACalRegn03Rt01GroupB_Dummy_2.AssiMotTqWhlImbRejctnMaxX
    connect CalRegn03Rt02GroupB.AssiMotTqWhlImbRejctnMaxY -> AAACalRegn03Rt01GroupB_Dummy_2.AssiMotTqWhlImbRejctnMaxY
    connect CalRegn03Rt02GroupB.AssiWhlImbRejctnBlndScaX -> AAACalRegn03Rt01GroupB_Dummy_2.AssiWhlImbRejctnBlndScaX
    connect CalRegn03Rt02GroupB.AssiWhlImbRejctnBlndScaY -> AAACalRegn03Rt01GroupB_Dummy_2.AssiWhlImbRejctnBlndScaY
    connect CalRegn03Rt02GroupB.EotProtnDampgVehSpdTbl -> AAACalRegn03Rt01GroupB_Dummy_2.EotProtnDampgVehSpdTbl
    connect CalRegn03Rt02GroupB.EotProtnEntrGainVehSpdTbl -> AAACalRegn03Rt01GroupB_Dummy_2.EotProtnEntrGainVehSpdTbl
    connect CalRegn03Rt02GroupB.EotProtnEntrGainX -> AAACalRegn03Rt01GroupB_Dummy_2.EotProtnEntrGainX
    connect CalRegn03Rt02GroupB.EotProtnEntrGainY -> AAACalRegn03Rt01GroupB_Dummy_2.EotProtnEntrGainY
    connect CalRegn03Rt02GroupB.EotProtnExitDampgY -> AAACalRegn03Rt01GroupB_Dummy_2.EotProtnExitDampgY
    connect CalRegn03Rt02GroupB.EotProtnHwDegDampgX -> AAACalRegn03Rt01GroupB_Dummy_2.EotProtnHwDegDampgX
    connect CalRegn03Rt02GroupB.EotProtnNormDampgY -> AAACalRegn03Rt01GroupB_Dummy_2.EotProtnNormDampgY
    connect CalRegn03Rt02GroupB.InertiaCmpVelAssiBasdDampgRollgWhlImbRejctnOnY -> AAACalRegn03Rt01GroupB_Dummy_2.InertiaCmpVelAssiBasdDampgRollgWhlImbRejctnOnY
    connect CalRegn03Rt03.InertiaCmpVelDampgFilFrq -> AAACalRegn03Rt01_Dummy_3.InertiaCmpVelDampgFilFrq
    connect CalRegn03Rt03.InertiaCmpVelDampgFilFrqWhlImbRejctnOn -> AAACalRegn03Rt01_Dummy_3.InertiaCmpVelDampgFilFrqWhlImbRejctnOn
    connect CalRegn03Rt03GroupA.AssiHiFrqGainY -> AAACalRegn03Rt01GroupA_Dummy_2.AssiHiFrqGainY
    connect CalRegn03Rt03GroupA.AssiHiFrqTqX -> AAACalRegn03Rt01GroupA_Dummy_2.AssiHiFrqTqX
    connect CalRegn03Rt03GroupA.AssiMotTqWhlImbRejctnMinX -> AAACalRegn03Rt01GroupA_Dummy_2.AssiMotTqWhlImbRejctnMinX
    connect CalRegn03Rt03GroupA.AssiMotTqWhlImbRejctnMinY -> AAACalRegn03Rt01GroupA_Dummy_2.AssiMotTqWhlImbRejctnMinY
    connect CalRegn03Rt03GroupA.DampgHydCoeff{1..4}ScaY -> AAACalRegn03Rt01GroupA_Dummy_2.DampgHydCoeff{1..4}ScaY
    connect CalRegn03Rt03GroupA.DampgMotVelX -> AAACalRegn03Rt01GroupA_Dummy_2.DampgMotVelX
    connect CalRegn03Rt03GroupA.DampgMotVelY -> AAACalRegn03Rt01GroupA_Dummy_2.DampgMotVelY
    connect CalRegn03Rt03GroupA.HysCmpFricWhlImbRejctnBlndX -> AAACalRegn03Rt01GroupA_Dummy_2.HysCmpFricWhlImbRejctnBlndX
    connect CalRegn03Rt03GroupA.HysCmpFricWhlImbRejctnBlndY -> AAACalRegn03Rt01GroupA_Dummy_2.HysCmpFricWhlImbRejctnBlndY
    connect CalRegn03Rt03GroupA.HysCmpFricWhlImbRejctnOffY -> AAACalRegn03Rt01GroupA_Dummy_2.HysCmpFricWhlImbRejctnOffY
    connect CalRegn03Rt03GroupA.HysCmpFricWhlImbRejctnOnY -> AAACalRegn03Rt01GroupA_Dummy_2.HysCmpFricWhlImbRejctnOnY
    connect CalRegn03Rt03GroupA.InertiaCmpVelAssiBasdDampgCoeffX -> AAACalRegn03Rt01GroupA_Dummy_2.InertiaCmpVelAssiBasdDampgCoeffX
    connect CalRegn03Rt03GroupA.InertiaCmpVelAssiBasdDampgRollgY -> AAACalRegn03Rt01GroupA_Dummy_2.InertiaCmpVelAssiBasdDampgRollgY
    connect CalRegn03Rt03GroupA.InertiaCmpVelAssiBasdDampgStatY -> AAACalRegn03Rt01GroupA_Dummy_2.InertiaCmpVelAssiBasdDampgStatY
    connect CalRegn03Rt03GroupA.InertiaCmpVelDampgSpdBlndY -> AAACalRegn03Rt01GroupA_Dummy_2.InertiaCmpVelDampgSpdBlndY
    connect CalRegn03Rt03GroupA.InertiaCmpVelNotchBlndY -> AAACalRegn03Rt01GroupA_Dummy_2.InertiaCmpVelNotchBlndY
    connect CalRegn03Rt03GroupA.RtnHwAgOffsCalcdX -> AAACalRegn03Rt01GroupA_Dummy_2.RtnHwAgOffsCalcdX
    connect CalRegn03Rt03GroupA.RtnHwAgOffsCalcdY -> AAACalRegn03Rt01GroupA_Dummy_2.RtnHwAgOffsCalcdY
    connect CalRegn03Rt03GroupA.RtnScaTqX -> AAACalRegn03Rt01GroupA_Dummy_2.RtnScaTqX
    connect CalRegn03Rt03GroupA.RtnScaTqY -> AAACalRegn03Rt01GroupA_Dummy_2.RtnScaTqY
    connect CalRegn03Rt03GroupA.RtnScaVelX -> AAACalRegn03Rt01GroupA_Dummy_2.RtnScaVelX
    connect CalRegn03Rt03GroupA.RtnScaVelY -> AAACalRegn03Rt01GroupA_Dummy_2.RtnScaVelY
    connect CalRegn03Rt03GroupB.AssiHiFrqTqWhlImbRejctnTqX -> AAACalRegn03Rt01GroupB_Dummy_3.AssiHiFrqTqWhlImbRejctnTqX
    connect CalRegn03Rt03GroupB.AssiHiFrqWhlImbRejctnBlndX -> AAACalRegn03Rt01GroupB_Dummy_3.AssiHiFrqWhlImbRejctnBlndX
    connect CalRegn03Rt03GroupB.AssiHiFrqWhlImbRejctnBlndY -> AAACalRegn03Rt01GroupB_Dummy_3.AssiHiFrqWhlImbRejctnBlndY
    connect CalRegn03Rt03GroupB.AssiHiFrqWhlImbRejctnGainY -> AAACalRegn03Rt01GroupB_Dummy_3.AssiHiFrqWhlImbRejctnGainY
    connect CalRegn03Rt03GroupB.AssiMotTqWhlImbRejctnMaxX -> AAACalRegn03Rt01GroupB_Dummy_3.AssiMotTqWhlImbRejctnMaxX
    connect CalRegn03Rt03GroupB.AssiMotTqWhlImbRejctnMaxY -> AAACalRegn03Rt01GroupB_Dummy_3.AssiMotTqWhlImbRejctnMaxY
    connect CalRegn03Rt03GroupB.AssiWhlImbRejctnBlndScaX -> AAACalRegn03Rt01GroupB_Dummy_3.AssiWhlImbRejctnBlndScaX
    connect CalRegn03Rt03GroupB.AssiWhlImbRejctnBlndScaY -> AAACalRegn03Rt01GroupB_Dummy_3.AssiWhlImbRejctnBlndScaY
    connect CalRegn03Rt03GroupB.EotProtnDampgVehSpdTbl -> AAACalRegn03Rt01GroupB_Dummy_3.EotProtnDampgVehSpdTbl
    connect CalRegn03Rt03GroupB.EotProtnEntrGainVehSpdTbl -> AAACalRegn03Rt01GroupB_Dummy_3.EotProtnEntrGainVehSpdTbl
    connect CalRegn03Rt03GroupB.EotProtnEntrGainX -> AAACalRegn03Rt01GroupB_Dummy_3.EotProtnEntrGainX
    connect CalRegn03Rt03GroupB.EotProtnEntrGainY -> AAACalRegn03Rt01GroupB_Dummy_3.EotProtnEntrGainY
    connect CalRegn03Rt03GroupB.EotProtnExitDampgY -> AAACalRegn03Rt01GroupB_Dummy_3.EotProtnExitDampgY
    connect CalRegn03Rt03GroupB.EotProtnHwDegDampgX -> AAACalRegn03Rt01GroupB_Dummy_3.EotProtnHwDegDampgX
    connect CalRegn03Rt03GroupB.EotProtnNormDampgY -> AAACalRegn03Rt01GroupB_Dummy_3.EotProtnNormDampgY
    connect CalRegn03Rt03GroupB.InertiaCmpVelAssiBasdDampgRollgWhlImbRejctnOnY -> AAACalRegn03Rt01GroupB_Dummy_3.InertiaCmpVelAssiBasdDampgRollgWhlImbRejctnOnY
    connect CalRegn03Rt04.InertiaCmpVelDampgFilFrq -> AAACalRegn03Rt01_Dummy_4.InertiaCmpVelDampgFilFrq
    connect CalRegn03Rt04.InertiaCmpVelDampgFilFrqWhlImbRejctnOn -> AAACalRegn03Rt01_Dummy_4.InertiaCmpVelDampgFilFrqWhlImbRejctnOn
    connect CalRegn03Rt04GroupA.AssiHiFrqGainY -> AAACalRegn03Rt01GroupA_Dummy_3.AssiHiFrqGainY
    connect CalRegn03Rt04GroupA.AssiHiFrqTqX -> AAACalRegn03Rt01GroupA_Dummy_3.AssiHiFrqTqX
    connect CalRegn03Rt04GroupA.AssiMotTqWhlImbRejctnMinX -> AAACalRegn03Rt01GroupA_Dummy_3.AssiMotTqWhlImbRejctnMinX
    connect CalRegn03Rt04GroupA.AssiMotTqWhlImbRejctnMinY -> AAACalRegn03Rt01GroupA_Dummy_3.AssiMotTqWhlImbRejctnMinY
    connect CalRegn03Rt04GroupA.DampgHydCoeff{1..4}ScaY -> AAACalRegn03Rt01GroupA_Dummy_3.DampgHydCoeff{1..4}ScaY
    connect CalRegn03Rt04GroupA.DampgMotVelX -> AAACalRegn03Rt01GroupA_Dummy_3.DampgMotVelX
    connect CalRegn03Rt04GroupA.DampgMotVelY -> AAACalRegn03Rt01GroupA_Dummy_3.DampgMotVelY
    connect CalRegn03Rt04GroupA.HysCmpFricWhlImbRejctnBlndX -> AAACalRegn03Rt01GroupA_Dummy_3.HysCmpFricWhlImbRejctnBlndX
    connect CalRegn03Rt04GroupA.HysCmpFricWhlImbRejctnBlndY -> AAACalRegn03Rt01GroupA_Dummy_3.HysCmpFricWhlImbRejctnBlndY
    connect CalRegn03Rt04GroupA.HysCmpFricWhlImbRejctnOffY -> AAACalRegn03Rt01GroupA_Dummy_3.HysCmpFricWhlImbRejctnOffY
    connect CalRegn03Rt04GroupA.HysCmpFricWhlImbRejctnOnY -> AAACalRegn03Rt01GroupA_Dummy_3.HysCmpFricWhlImbRejctnOnY
    connect CalRegn03Rt04GroupA.InertiaCmpVelAssiBasdDampgCoeffX -> AAACalRegn03Rt01GroupA_Dummy_3.InertiaCmpVelAssiBasdDampgCoeffX
    connect CalRegn03Rt04GroupA.InertiaCmpVelAssiBasdDampgRollgY -> AAACalRegn03Rt01GroupA_Dummy_3.InertiaCmpVelAssiBasdDampgRollgY
    connect CalRegn03Rt04GroupA.InertiaCmpVelAssiBasdDampgStatY -> AAACalRegn03Rt01GroupA_Dummy_3.InertiaCmpVelAssiBasdDampgStatY
    connect CalRegn03Rt04GroupA.InertiaCmpVelDampgSpdBlndY -> AAACalRegn03Rt01GroupA_Dummy_3.InertiaCmpVelDampgSpdBlndY
    connect CalRegn03Rt04GroupA.InertiaCmpVelNotchBlndY -> AAACalRegn03Rt01GroupA_Dummy_3.InertiaCmpVelNotchBlndY
    connect CalRegn03Rt04GroupA.RtnHwAgOffsCalcdX -> AAACalRegn03Rt01GroupA_Dummy_3.RtnHwAgOffsCalcdX
    connect CalRegn03Rt04GroupA.RtnHwAgOffsCalcdY -> AAACalRegn03Rt01GroupA_Dummy_3.RtnHwAgOffsCalcdY
    connect CalRegn03Rt04GroupA.RtnScaTqX -> AAACalRegn03Rt01GroupA_Dummy_3.RtnScaTqX
    connect CalRegn03Rt04GroupA.RtnScaTqY -> AAACalRegn03Rt01GroupA_Dummy_3.RtnScaTqY
    connect CalRegn03Rt04GroupA.RtnScaVelX -> AAACalRegn03Rt01GroupA_Dummy_3.RtnScaVelX
    connect CalRegn03Rt04GroupA.RtnScaVelY -> AAACalRegn03Rt01GroupA_Dummy_3.RtnScaVelY
    connect CalRegn03Rt04GroupB.AssiHiFrqTqWhlImbRejctnTqX -> AAACalRegn03Rt01GroupB_Dummy_4.AssiHiFrqTqWhlImbRejctnTqX
    connect CalRegn03Rt04GroupB.AssiHiFrqWhlImbRejctnBlndX -> AAACalRegn03Rt01GroupB_Dummy_4.AssiHiFrqWhlImbRejctnBlndX
    connect CalRegn03Rt04GroupB.AssiHiFrqWhlImbRejctnBlndY -> AAACalRegn03Rt01GroupB_Dummy_4.AssiHiFrqWhlImbRejctnBlndY
    connect CalRegn03Rt04GroupB.AssiHiFrqWhlImbRejctnGainY -> AAACalRegn03Rt01GroupB_Dummy_4.AssiHiFrqWhlImbRejctnGainY
    connect CalRegn03Rt04GroupB.AssiMotTqWhlImbRejctnMaxX -> AAACalRegn03Rt01GroupB_Dummy_4.AssiMotTqWhlImbRejctnMaxX
    connect CalRegn03Rt04GroupB.AssiMotTqWhlImbRejctnMaxY -> AAACalRegn03Rt01GroupB_Dummy_4.AssiMotTqWhlImbRejctnMaxY
    connect CalRegn03Rt04GroupB.AssiWhlImbRejctnBlndScaX -> AAACalRegn03Rt01GroupB_Dummy_4.AssiWhlImbRejctnBlndScaX
    connect CalRegn03Rt04GroupB.AssiWhlImbRejctnBlndScaY -> AAACalRegn03Rt01GroupB_Dummy_4.AssiWhlImbRejctnBlndScaY
    connect CalRegn03Rt04GroupB.EotProtnDampgVehSpdTbl -> AAACalRegn03Rt01GroupB_Dummy_4.EotProtnDampgVehSpdTbl
    connect CalRegn03Rt04GroupB.EotProtnEntrGainVehSpdTbl -> AAACalRegn03Rt01GroupB_Dummy_4.EotProtnEntrGainVehSpdTbl
    connect CalRegn03Rt04GroupB.EotProtnEntrGainX -> AAACalRegn03Rt01GroupB_Dummy_4.EotProtnEntrGainX
    connect CalRegn03Rt04GroupB.EotProtnEntrGainY -> AAACalRegn03Rt01GroupB_Dummy_4.EotProtnEntrGainY
    connect CalRegn03Rt04GroupB.EotProtnExitDampgY -> AAACalRegn03Rt01GroupB_Dummy_4.EotProtnExitDampgY
    connect CalRegn03Rt04GroupB.EotProtnHwDegDampgX -> AAACalRegn03Rt01GroupB_Dummy_4.EotProtnHwDegDampgX
    connect CalRegn03Rt04GroupB.EotProtnNormDampgY -> AAACalRegn03Rt01GroupB_Dummy_4.EotProtnNormDampgY
    connect CalRegn03Rt04GroupB.InertiaCmpVelAssiBasdDampgRollgWhlImbRejctnOnY -> AAACalRegn03Rt01GroupB_Dummy_4.InertiaCmpVelAssiBasdDampgRollgWhlImbRejctnOnY
    connect CDD_Adc1CfgAndUse.Adc1CfgAndUseAdc1EnaCnvn -> CDD_DmaCfgAndUse.Adc1CfgAndUseAdc1EnaCnvn
    connect CDD_AdcDiagc.AdcDiagcEndPtrOutp -> CDD_Adc1CfgAndUse.AdcDiagcEndPtrOutp
    connect CDD_AdcDiagc.AdcDiagcStrtPtrOutp -> CDD_Adc1CfgAndUse.AdcDiagcStrtPtrOutp
    connect CDD_AdcDiagc.Adc0Faild -> CDD_GmT1xxMcuCfg.Adc0Faild
    connect CDD_AdcDiagc.Adc1Faild -> CDD_GmT1xxMcuCfg.Adc1Faild
    connect CDD_AdcDiagc.AdcDiagcEndPtrOutp -> CDD_MotCtrlMgr.AdcDiagcEndPtrOutp
    connect CDD_AdcDiagc.AdcDiagcStrtPtrOutp -> CDD_MotCtrlMgr.AdcDiagcStrtPtrOutp
    connect CDD_CurrMeas.CurrMeasWrmIninTestCmpl -> CDD_MotCtrlMgr.CurrMeasWrmIninTestCmpl
    connect CDD_CurrMeas.MotCurrEolCalSt -> CDD_MotCtrlMgr.MotCurrEolCalSt
    connect CDD_CurrMeas.MotCurrQlfr1 -> CDD_MotCtrlMgr.MotCurrQlfr1
    connect CDD_CurrMeas.MotCurrQlfr2 -> CDD_MotCtrlMgr.MotCurrQlfr2
    connect CDD_CurrMeas.MotCurrEolCalSt -> CDD_TSG31CfgAndUse.MotCurrEolCalSt
    connect CDD_CurrMeas.CurrMeasEolGainReq -> CmnMfgSrv.CurrMeasEolGainReq
    connect CDD_CurrMeas.CurrMeasEolGainStsReq -> CmnMfgSrv.CurrMeasEolGainStReq
    connect CDD_CurrMeas.CurrMeasEolOffsReq -> CmnMfgSrv.CurrMeasEolOffsReq
    connect CDD_CurrMeas.CurrMeasEolOffsStsReq -> CmnMfgSrv.CurrMeasEolOffsStReq
    connect CDD_CurrMeas.CurrMeasGainReadReq -> CmnMfgSrv.CurrMeasGainReadReq
    connect CDD_CurrMeas.CurrMeasGainWrReq -> CmnMfgSrv.CurrMeasGainWrReq
    connect CDD_CurrMeas.CurrMeasOffsReadReq -> CmnMfgSrv.CurrMeasOffsReadReq
    connect CDD_CurrMeas.CurrMeasOffsWrReq -> CmnMfgSrv.CurrMeasOffsWrReq
    connect CDD_CurrMeas.MotCurrEolCalSt -> CurrMeasCorrln.MotCurrEolCalSt
    connect CDD_CurrMeas.MotCurrQlfr1 -> CurrMeasCorrln.MotCurrQlfr1
    connect CDD_CurrMeas.MotCurrQlfr2 -> CurrMeasCorrln.MotCurrQlfr2
    connect CDD_CurrMeas.MotCurrEolCalSt -> MotCurrRegCfg.MotCurrEolCalSt
    connect CDD_CurrMeas.CurrMeasWrmIninTestCmpl -> PwrUpSeq.CurrMeasWrmIninTestCmpl
    connect CDD_DmaCfgAndUse.DmaEna2MilliSecToMotCtrlTrf -> CDD_MotCtrlMgr.DmaEna2MilliSecToMotCtrlTrf
    connect CDD_DmaCfgAndUse.DmaWaitForMotCtrlTo2MilliSecTrf -> CDD_MotCtrlMgr.DmaWaitForMotCtrlTo2MilliSecTrf
    connect CDD_EcmOutpAndDiagc.CtrlErrOut -> TmplMonr.CtrlErrOut
    connect CDD_FlsMem.CodFlsCrcChkCmpl -> PwrUpSeq.CodFlsCrcChkCmpl
    connect CDD_GmT1xxMcuCfg.BattVltg -> BattVltg.BattVltg
    connect CDD_GmT1xxMcuCfg.BattVltgSwd1 -> BattVltg.BattVltgSwd1
    connect CDD_GmT1xxMcuCfg.BattVltgSwd2 -> BattVltg.BattVltgSwd2
    connect CDD_GmT1xxMcuCfg.BattVltg -> BattVltgCorrln.BattVltg
    connect CDD_GmT1xxMcuCfg.BattVltgAdcFaild -> BattVltgCorrln.BattVltgAdcFaild
    connect CDD_GmT1xxMcuCfg.BattVltgSwd1 -> BattVltgCorrln.BattVltgSwd1
    connect CDD_GmT1xxMcuCfg.BattVltgSwd1AdcFaild -> BattVltgCorrln.BattVltgSwd1AdcFaild
    connect CDD_GmT1xxMcuCfg.BattVltgSwd2 -> BattVltgCorrln.BattVltgSwd2
    connect CDD_GmT1xxMcuCfg.BattVltgSwd2AdcFaild -> BattVltgCorrln.BattVltgSwd2AdcFaild
    connect CDD_GmT1xxMcuCfg.Adc1ScanGroup2Ref0 -> CDD_AdcDiagc.Adc1ScanGroup2Ref0
    connect CDD_GmT1xxMcuCfg.Adc1ScanGroup2Ref1 -> CDD_AdcDiagc.Adc1ScanGroup2Ref1
    connect CDD_GmT1xxMcuCfg.Adc1ScanGroup3Ref0 -> CDD_AdcDiagc.Adc1ScanGroup3Ref0
    connect CDD_GmT1xxMcuCfg.Adc1ScanGroup3Ref1 -> CDD_AdcDiagc.Adc1ScanGroup3Ref1
    connect CDD_GmT1xxMcuCfg.Adc1SelfDiag0 -> CDD_AdcDiagc.Adc1SelfDiag0
    connect CDD_GmT1xxMcuCfg.Adc1SelfDiag2 -> CDD_AdcDiagc.Adc1SelfDiag2
    connect CDD_GmT1xxMcuCfg.Adc1SelfDiag4 -> CDD_AdcDiagc.Adc1SelfDiag4
    connect CDD_GmT1xxMcuCfg.MotCurrAdcVlyAAdcFaild -> CDD_MotCtrlMgr.MotCurrAdcVlyAAdcFaild
    connect CDD_GmT1xxMcuCfg.MotCurrAdcVlyBAdcFaild -> CDD_MotCtrlMgr.MotCurrAdcVlyBAdcFaild
    connect CDD_GmT1xxMcuCfg.MotCurrAdcVlyCAdcFaild -> CDD_MotCtrlMgr.MotCurrAdcVlyCAdcFaild
    connect CDD_GmT1xxMcuCfg.MotCurrAdcVlyDAdcFaild -> CDD_MotCtrlMgr.MotCurrAdcVlyDAdcFaild
    connect CDD_GmT1xxMcuCfg.MotCurrAdcVlyEAdcFaild -> CDD_MotCtrlMgr.MotCurrAdcVlyEAdcFaild
    connect CDD_GmT1xxMcuCfg.MotCurrAdcVlyFAdcFaild -> CDD_MotCtrlMgr.MotCurrAdcVlyFAdcFaild
    connect CDD_GmT1xxMcuCfg.BattVltg -> CustDiagc.BattVltg
    connect CDD_GmT1xxMcuCfg.EcuT -> EcuTMeas.EcuT
    connect CDD_GmT1xxMcuCfg.EcuTAdcFaild -> EcuTMeas.EcuTAdcFaild
    connect CDD_GmT1xxMcuCfg.MotAg2Cos -> MotAg2Meas.MotAg2Cos
    connect CDD_GmT1xxMcuCfg.MotAg2CosAdcFaild -> MotAg2Meas.MotAg2CosAdcFaild
    connect CDD_GmT1xxMcuCfg.MotAg2Sin -> MotAg2Meas.MotAg2Sin
    connect CDD_GmT1xxMcuCfg.MotAg2SinAdcFaild -> MotAg2Meas.MotAg2SinAdcFaild
    connect CDD_GmT1xxMcuCfg.BattVltg -> PwrDiscnct.BattVltg
    connect CDD_GmT1xxMcuCfg.BattVltgSwd1 -> PwrDiscnct.BattVltgSwd1
    connect CDD_GmT1xxMcuCfg.BattVltgSwd2 -> PwrDiscnct.BattVltgSwd2
    connect CDD_HwTq0Meas.HwTq0MeasHwTq0AutTrim -> CmnMfgSrv.HwTq0MeasHwTq0AutTrim
    connect CDD_HwTq0Meas.HwTq0MeasHwTq0ClrTrim -> CmnMfgSrv.HwTq0MeasHwTq0ClrTrim
    connect CDD_HwTq0Meas.HwTq0MeasHwTq0ReadTrim -> CmnMfgSrv.HwTq0MeasHwTq0ReadTrim
    connect CDD_HwTq0Meas.HwTq0MeasHwTq0TrimPrfmdSts -> CmnMfgSrv.HwTq0MeasHwTq0TrimPrfmdSts
    connect CDD_HwTq0Meas.HwTq0MeasHwTq0WrTrim -> CmnMfgSrv.HwTq0MeasHwTq0WrTrim
    connect CDD_HwTq0Meas.RackLimrEotSig0Avl -> EotLrng.HwAgEotSig0Avl
    connect CDD_HwTq0Meas.RackLimrCcwEotSig0 -> EotLrng.HwAgEotSig0Ccw
    connect CDD_HwTq0Meas.RackLimrCwEotSig0 -> EotLrng.HwAgEotSig0Cw
    connect CDD_HwTq0Meas.HwTq0 -> HwTqArbn.HwTqA
    connect CDD_HwTq0Meas.HwTq0Qlfr -> HwTqArbn.HwTqAQlfr
    connect CDD_HwTq0Meas.HwTq0RollgCntr -> HwTqArbn.HwTqARollgCntr
    connect CDD_HwTq0Meas.HwTq0 -> HwTqCorrln.HwTqA
    connect CDD_HwTq0Meas.HwTq0Qlfr -> HwTqCorrln.HwTqAQlfr
    connect CDD_HwTq0Meas.HwTq0RollgCntr -> HwTqCorrln.HwTqARollgCntr
    connect CDD_HwTq0Meas.RackLimrEotSig0Avl -> StHlthSigNormn.RackLimrEotSig0Avl
    connect CDD_HwTq1Meas.HwTq1MeasHwTq1AutTrim -> CmnMfgSrv.HwTq1MeasHwTq1AutTrim
    connect CDD_HwTq1Meas.HwTq1MeasHwTq1ClrTrim -> CmnMfgSrv.HwTq1MeasHwTq1ClrTrim
    connect CDD_HwTq1Meas.HwTq1MeasHwTq1ReadTrim -> CmnMfgSrv.HwTq1MeasHwTq1ReadTrim
    connect CDD_HwTq1Meas.HwTq1MeasHwTq1TrimPrfmdSts -> CmnMfgSrv.HwTq1MeasHwTq1TrimPrfmdSts
    connect CDD_HwTq1Meas.HwTq1MeasHwTq1WrTrim -> CmnMfgSrv.HwTq1MeasHwTq1WrTrim
    connect CDD_HwTq1Meas.RackLimrEotSig1Avl -> EotLrng.HwAgEotSig1Avl
    connect CDD_HwTq1Meas.RackLimrCcwEotSig1 -> EotLrng.HwAgEotSig1Ccw
    connect CDD_HwTq1Meas.RackLimrCwEotSig1 -> EotLrng.HwAgEotSig1Cw
    connect CDD_HwTq1Meas.HwTq1 -> HwTqArbn.HwTqB
    connect CDD_HwTq1Meas.HwTq1Qlfr -> HwTqArbn.HwTqBQlfr
    connect CDD_HwTq1Meas.HwTq1RollgCntr -> HwTqArbn.HwTqBRollgCntr
    connect CDD_HwTq1Meas.HwTq1 -> HwTqCorrln.HwTqB
    connect CDD_HwTq1Meas.HwTq1Qlfr -> HwTqCorrln.HwTqBQlfr
    connect CDD_HwTq1Meas.HwTq1RollgCntr -> HwTqCorrln.HwTqBRollgCntr
    connect CDD_HwTq1Meas.RackLimrEotSig1Avl -> StHlthSigNormn.RackLimrEotSig1Avl
    connect CDD_HwTq2Meas.HwTq2MeasHwTq2AutTrim -> CmnMfgSrv.HwTq2MeasHwTq2AutTrim
    connect CDD_HwTq2Meas.HwTq2MeasHwTq2ClrTrim -> CmnMfgSrv.HwTq2MeasHwTq2ClrTrim
    connect CDD_HwTq2Meas.HwTq2MeasHwTq2ReadTrim -> CmnMfgSrv.HwTq2MeasHwTq2ReadTrim
    connect CDD_HwTq2Meas.HwTq2MeasHwTq2TrimPrfmdSts -> CmnMfgSrv.HwTq2MeasHwTq2TrimPrfmdSts
    connect CDD_HwTq2Meas.HwTq2MeasHwTq2WrTrim -> CmnMfgSrv.HwTq2MeasHwTq2WrTrim
    connect CDD_HwTq2Meas.HwTq2 -> HwTqArbn.HwTqC
    connect CDD_HwTq2Meas.HwTq2Qlfr -> HwTqArbn.HwTqCQlfr
    connect CDD_HwTq2Meas.HwTq2RollgCntr -> HwTqArbn.HwTqCRollgCntr
    connect CDD_HwTq2Meas.HwTq2 -> HwTqCorrln.HwTqC
    connect CDD_HwTq2Meas.HwTq2Qlfr -> HwTqCorrln.HwTqCQlfr
    connect CDD_HwTq2Meas.HwTq2RollgCntr -> HwTqCorrln.HwTqCRollgCntr
    connect CDD_HwTq2Meas.GearIdn1 -> PwrpkCmpbltyChk.GearIdn1
    connect CDD_HwTq2Meas.GearIdn1Vld -> PwrpkCmpbltyChk.GearIdn1Vld
    connect CDD_HwTq3Meas.HwTq3MeasHwTq3AutTrim -> CmnMfgSrv.HwTq3MeasHwTq3AutTrim
    connect CDD_HwTq3Meas.HwTq3MeasHwTq3ClrTrim -> CmnMfgSrv.HwTq3MeasHwTq3ClrTrim
    connect CDD_HwTq3Meas.HwTq3MeasHwTq3ReadTrim -> CmnMfgSrv.HwTq3MeasHwTq3ReadTrim
    connect CDD_HwTq3Meas.HwTq3MeasHwTq3TrimPrfmdSts -> CmnMfgSrv.HwTq3MeasHwTq3TrimPrfmdSts
    connect CDD_HwTq3Meas.HwTq3MeasHwTq3WrTrim -> CmnMfgSrv.HwTq3MeasHwTq3WrTrim
    connect CDD_HwTq3Meas.HwTq3 -> HwTqArbn.HwTqD
    connect CDD_HwTq3Meas.HwTq3Qlfr -> HwTqArbn.HwTqDQlfr
    connect CDD_HwTq3Meas.HwTq3RollgCntr -> HwTqArbn.HwTqDRollgCntr
    connect CDD_HwTq3Meas.HwTq3 -> HwTqCorrln.HwTqD
    connect CDD_HwTq3Meas.HwTq3Qlfr -> HwTqCorrln.HwTqDQlfr
    connect CDD_HwTq3Meas.HwTq3RollgCntr -> HwTqCorrln.HwTqDRollgCntr
    connect CDD_HwTq3Meas.GearIdn2 -> PwrpkCmpbltyChk.GearIdn2
    connect CDD_HwTq3Meas.GearIdn2Vld -> PwrpkCmpbltyChk.GearIdn2Vld
    connect CDD_McuDiagc.LoopCntr2MilliSec -> CDD_MotCtrlMgr.LoopCntr2MilliSec
    connect CDD_MotAg0Meas.MotAg0MeclQlfr -> CDD_MotCtrlMgr.MotAg0MeclQlfr
    connect CDD_MotAg0Meas.MotAg0MeasMotAg0CoeffTblRead -> CmnMfgSrv.MotAg0MeasMotAg0CoeffTblRead
    connect CDD_MotAg0Meas.MotAg0MeasMotAg0CoeffTblWr -> CmnMfgSrv.MotAg0MeasMotAg0CoeffTblWr
    connect CDD_MotAg0Meas.MotAg0MeclQlfr -> MotAgCorrln.MotAgAMeclQlfr
    connect CDD_MotAg1Meas.MotAg1MeclQlfr -> CDD_MotCtrlMgr.MotAg1MeclQlfr
    connect CDD_MotAg1Meas.MotAg1MeasMotAg1CoeffTblRead -> CmnMfgSrv.MotAg1MeasMotAg1CoeffTblRead
    connect CDD_MotAg1Meas.MotAg1MeasMotAg1CoeffTblWr -> CmnMfgSrv.MotAg1MeasMotAg1CoeffTblWr
    connect CDD_MotAg1Meas.MotAg1MeclQlfr -> MotAgCorrln.MotAgBMeclQlfr
    connect CDD_MotAgCmp.MotAgCmpBackEmfRead -> CmnMfgSrv.MotAgCmpBackEmfRead
    connect CDD_MotAgCmp.MotAgCmpBackEmfWr -> CmnMfgSrv.MotAgCmpBackEmfWr
    connect CDD_MotAgCmp.MotAgCumvAlgndCrf -> HwAgSnsrls.MotAgCumvAlgndCrf
    connect CDD_MotAgCmp.MotAgCumvAlgndVld -> HwAgSnsrls.MotAgCumvAlgndVld
    connect CDD_MotAgCmp.MotAgCumvAlgndMrf -> MotQuadDetn.MotAgCumvAlgndMrf
    connect CDD_MotCtrlMgr.Adc0ScanGroup2Ref0 -> CDD_AdcDiagc.Adc0ScanGroup2Ref0
    connect CDD_MotCtrlMgr.Adc0ScanGroup2Ref1 -> CDD_AdcDiagc.Adc0ScanGroup2Ref1
    connect CDD_MotCtrlMgr.Adc0ScanGroup3Ref0 -> CDD_AdcDiagc.Adc0ScanGroup3Ref0
    connect CDD_MotCtrlMgr.Adc0ScanGroup3Ref1 -> CDD_AdcDiagc.Adc0ScanGroup3Ref1
    connect CDD_MotCtrlMgr.Adc0SelfDiag0 -> CDD_AdcDiagc.Adc0SelfDiag0
    connect CDD_MotCtrlMgr.Adc0SelfDiag2 -> CDD_AdcDiagc.Adc0SelfDiag2
    connect CDD_MotCtrlMgr.Adc0SelfDiag4 -> CDD_AdcDiagc.Adc0SelfDiag4
    connect CDD_MotCtrlMgr.MotCurrAdcVlyA -> CDD_CurrMeas.MotCurrAdcVlyA
    connect CDD_MotCtrlMgr.MotCurrAdcVlyB -> CDD_CurrMeas.MotCurrAdcVlyB
    connect CDD_MotCtrlMgr.MotCurrAdcVlyC -> CDD_CurrMeas.MotCurrAdcVlyC
    connect CDD_MotCtrlMgr.MotCurrAdcVlyD -> CDD_CurrMeas.MotCurrAdcVlyD
    connect CDD_MotCtrlMgr.MotCurrAdcVlyE -> CDD_CurrMeas.MotCurrAdcVlyE
    connect CDD_MotCtrlMgr.MotCurrAdcVlyF -> CDD_CurrMeas.MotCurrAdcVlyF
    connect CDD_MotCtrlMgr.Ntc5DErrCnt -> CDD_CurrMeas.Ntc5DErrCnt
    connect CDD_MotCtrlMgr.Ntc6DErrCnt -> CDD_CurrMeas.Ntc6DErrCnt
    connect CDD_MotCtrlMgr.FastLoopCntr -> CDD_McuDiagc.FastLoopCntr
    connect CDD_MotCtrlMgr.SlowLoopCntr -> CDD_McuDiagc.SlowLoopCntr
    connect CDD_MotCtrlMgr.MotAg0ErrReg -> CDD_MotAg0Meas.MotAg0ErrReg
    connect CDD_MotCtrlMgr.MotAg0ParFltCnt -> CDD_MotAg0Meas.MotAg0ParFltCnt
    connect CDD_MotCtrlMgr.MotAg0VltgFltCnt -> CDD_MotAg0Meas.MotAg0VltgFltCnt
    connect CDD_MotCtrlMgr.MotAg1ErrReg -> CDD_MotAg1Meas.MotAg1ErrReg
    connect CDD_MotCtrlMgr.MotAg1ParFltCnt -> CDD_MotAg1Meas.MotAg1ParFltCnt
    connect CDD_MotCtrlMgr.MotAg1VltgFltCnt -> CDD_MotAg1Meas.MotAg1VltgFltCnt
    connect CDD_MotCtrlMgr.MotAgCumvAlgndMrfRev -> CDD_MotAgCmp.MotAgCumvAlgndMrfRev
    connect CDD_MotCtrlMgr.MotAgCumvInid -> CDD_MotAgCmp.MotAgCumvInid
    connect CDD_MotCtrlMgr.MotAgBuf -> CDD_MotVel.MotAgBuf
    connect CDD_MotCtrlMgr.MotAgBufIdx -> CDD_MotVel.MotAgBufIdx
    connect CDD_MotCtrlMgr.MotAgTiBuf -> CDD_MotVel.MotAgTiBuf
    connect CDD_MotCtrlMgr.MotCurrCorrdA -> CurrMeasCorrln.MotCurrCorrdA
    connect CDD_MotCtrlMgr.MotCurrCorrdB -> CurrMeasCorrln.MotCurrCorrdB
    connect CDD_MotCtrlMgr.MotCurrCorrdC -> CurrMeasCorrln.MotCurrCorrdC
    connect CDD_MotCtrlMgr.MotCurrCorrdD -> CurrMeasCorrln.MotCurrCorrdD
    connect CDD_MotCtrlMgr.MotCurrCorrdE -> CurrMeasCorrln.MotCurrCorrdE
    connect CDD_MotCtrlMgr.MotCurrCorrdF -> CurrMeasCorrln.MotCurrCorrdF
    connect CDD_MotCtrlMgr.MotCurrRollgCntr1 -> CurrMeasCorrln.MotCurrRollgCntr1
    connect CDD_MotCtrlMgr.MotCurrRollgCntr2 -> CurrMeasCorrln.MotCurrRollgCntr2
    connect CDD_MotCtrlMgr.MotAg0Mecl -> MotAgCorrln.MotAgAMecl
    connect CDD_MotCtrlMgr.MotAg0MeclRollgCntr -> MotAgCorrln.MotAgAMeclRollgCntr
    connect CDD_MotCtrlMgr.MotAg1Mecl -> MotAgCorrln.MotAgBMecl
    connect CDD_MotCtrlMgr.MotAg1MeclRollgCntr -> MotAgCorrln.MotAgBMeclRollgCntr
    connect CDD_MotCtrlMgr.MotCurrDax -> MotCurrPeakEstimn.MotCurrDax
    connect CDD_MotCtrlMgr.MotCurrQax -> MotCurrPeakEstimn.MotCurrQax
    connect CDD_MotCtrlMgr.PhaOnTiSumA -> MotDrvDiagc.PhaOnTiSumA
    connect CDD_MotCtrlMgr.PhaOnTiSumB -> MotDrvDiagc.PhaOnTiSumB
    connect CDD_MotCtrlMgr.PhaOnTiSumC -> MotDrvDiagc.PhaOnTiSumC
    connect CDD_MotRplCoggCmd.GetMotCoggCmdPrm -> CmnMfgSrv.GetMotCoggCmdPrm
    connect CDD_MotRplCoggCmd.SetMotCoggCmdPrm -> CmnMfgSrv.SetMotCoggCmdPrm
    connect CDD_MotVel.MotVelMrf -> CDD_CurrMeas.MotVelMrf
    connect CDD_MotVel.MotVelMrf -> CDD_MotCtrlMgr.MotVelMrf
    connect CDD_MotVel.MotVelCrf -> Dampg.MotVelCrf
    connect CDD_MotVel.MotVelCrf -> DampgPahFwl.MotVelCrf
    connect CDD_MotVel.MotVelCrf -> DutyCycThermProtn.MotVelCrf
    connect CDD_MotVel.MotVelCrf -> EotLrng.MotVelCrf
    connect CDD_MotVel.MotVelCrf -> EotProtn.MotVelCrf
    connect CDD_MotVel.MotVelCrf -> EotProtnFwl.MotVelCrf
    connect CDD_MotVel.MotVelCrf -> HiLoadStallLimr.MotVelCrf
    connect CDD_MotVel.MotVelCrf -> HwAgSnsrls.MotVelCrf
    connect CDD_MotVel.MotVelCrf -> HwAgSysArbn.MotVelCrf
    connect CDD_MotVel.MotVelVld -> HwAgSysArbn.MotVelVld
    connect CDD_MotVel.MotVelCrf -> HwAgTrakgServo.MotVelCrf
    connect CDD_MotVel.MotVelCrf -> InertiaCmpVel.MotVelCrf
    connect CDD_MotVel.MotVelMrf -> MotCurrRegCfg.MotVelMrf
    connect CDD_MotVel.MotVelMrf -> MotRefMdl.MotVelMrf
    connect CDD_MotVel.MotVelMrf -> MotRplCoggCfg.MotVelMrf
    connect CDD_MotVel.MotVelCrf -> MotTqTranlDampg.MotVelCrf
    connect CDD_MotVel.MotVelCrf -> MotVelCtrl.MotVelCrf
    connect CDD_MotVel.MotVelMrf -> PwrLimr.MotVelMrf
    connect CDD_MotVel.MotVelCrf -> StHlthSigNormn.MotVelCrf
    connect CDD_MotVel.MotVelCrf -> TqLoa.MotVelCrf
    connect CDD_NxtrTi.GetRefTmr1MicroSec32bit -> CDD_DmaCfgAndUse.GetRefTmr1MicroSec32bit
    connect CDD_NxtrTi.GetTiSpan1MicroSec32bit -> CDD_DmaCfgAndUse.GetTiSpan1MicroSec32bit
    connect CDD_NxtrTi.GetTiSpan100MicroSec32bit -> CDD_FlsMem.GetTiSpan100MicroSec32bit
    connect CDD_NxtrTi.GetRefTmr1MicroSec32bit -> CDD_GmT1xxMcuCfg.GetRefTmr1MicroSec32bit
    connect CDD_NxtrTi.GetTiSpan1MicroSec32bit -> CDD_GmT1xxMcuCfg.GetTiSpan1MicroSec32bit
    connect CDD_NxtrTi.GetRefTmr1MicroSec32bit -> CDD_HwTq0Meas.GetRefTmr1MicroSec32bit
    connect CDD_NxtrTi.GetTiSpan1MicroSec32bit -> CDD_HwTq0Meas.GetTiSpan1MicroSec32bit
    connect CDD_NxtrTi.GetRefTmr1MicroSec32bit -> CDD_HwTq1Meas.GetRefTmr1MicroSec32bit
    connect CDD_NxtrTi.GetTiSpan1MicroSec32bit -> CDD_HwTq1Meas.GetTiSpan1MicroSec32bit
    connect CDD_NxtrTi.GetRefTmr1MicroSec32bit -> CDD_HwTq2Meas.GetRefTmr1MicroSec32bit
    connect CDD_NxtrTi.GetTiSpan1MicroSec32bit -> CDD_HwTq2Meas.GetTiSpan1MicroSec32bit
    connect CDD_NxtrTi.GetRefTmr1MicroSec32bit -> CDD_HwTq3Meas.GetRefTmr1MicroSec32bit
    connect CDD_NxtrTi.GetTiSpan1MicroSec32bit -> CDD_HwTq3Meas.GetTiSpan1MicroSec32bit
    connect CDD_NxtrTi.GetRefTmr100MicroSec32bit -> CmnMfgSrv.GetRefTmr100MicroSec32bit1
    connect CDD_NxtrTi.GetTiSpan100MicroSec32bit -> CmnMfgSrv.GetTiSpan100MicroSec32bit1
    connect CDD_NxtrTi.GetRefTmr100MicroSec32bit -> CustDiagc.GetRefTmr100MicroSec32bit
    connect CDD_NxtrTi.GetTiSpan100MicroSec32bit -> CustDiagc.GetTiSpan100MicroSec32bit
    connect CDD_NxtrTi.GetRefTmr100MicroSec32bit -> EotLrng.GetRefTmr100MicroSec32bit
    connect CDD_NxtrTi.GetTiSpan100MicroSec32bit -> EotLrng.GetTiSpan100MicroSec32bit
    connect CDD_NxtrTi.GetRefTmr100MicroSec32bit -> FltInj.GetRefTmr100MicroSec32bit
    connect CDD_NxtrTi.GetTiSpan100MicroSec32bit -> FltInj.GetTiSpan100MicroSec32bit
    connect CDD_NxtrTi.GetRefTmr100MicroSec32bit -> GmFctDiArbn.GetRefTmr100MicroSec32bit
    connect CDD_NxtrTi.GetTiSpan100MicroSec32bit -> GmFctDiArbn.GetTiSpan100MicroSec32bit
    connect CDD_NxtrTi.GetRefTmr100MicroSec32bit -> GmMsg0C5BusHiSpd.GetRefTmr100MicroSec32bit
    connect CDD_NxtrTi.GetTiSpan100MicroSec32bit -> GmMsg0C5BusHiSpd.GetTiSpan100MicroSec32bit
    connect CDD_NxtrTi.GetRefTmr100MicroSec32bit -> GmMsg0C9BusHiSpd.GetRefTmr100MicroSec32bit
    connect CDD_NxtrTi.GetTiSpan100MicroSec32bit -> GmMsg0C9BusHiSpd.GetTiSpan100MicroSec32bit
    connect CDD_NxtrTi.GetRefTmr100MicroSec32bit -> GmMsg17DBusHiSpd.GetRefTmr100MicroSec32bit
    connect CDD_NxtrTi.GetTiSpan100MicroSec32bit -> GmMsg17DBusHiSpd.GetTiSpan100MicroSec32bit
    connect CDD_NxtrTi.GetRefTmr100MicroSec32bit -> GmMsg180BusChassisExp.GetRefTmr100MicroSec32bit
    connect CDD_NxtrTi.GetTiSpan100MicroSec32bit -> GmMsg180BusChassisExp.GetTiSpan100MicroSec32bit
    connect CDD_NxtrTi.GetRefTmr100MicroSec32bit -> GmMsg180BusHiSpd.GetRefTmr100MicroSec32bit
    connect CDD_NxtrTi.GetTiSpan100MicroSec32bit -> GmMsg180BusHiSpd.GetTiSpan100MicroSec32bit
    connect CDD_NxtrTi.GetRefTmr100MicroSec32bit -> GmMsg182BusChassisExp.GetRefTmr100MicroSec32bit
    connect CDD_NxtrTi.GetTiSpan100MicroSec32bit -> GmMsg182BusChassisExp.GetTiSpan100MicroSec32bit
    connect CDD_NxtrTi.GetRefTmr100MicroSec32bit -> GmMsg1E9BusHiSpd.GetRefTmr100MicroSec32bit
    connect CDD_NxtrTi.GetTiSpan100MicroSec32bit -> GmMsg1E9BusHiSpd.GetTiSpan100MicroSec32bit
    connect CDD_NxtrTi.GetTiSpan100MicroSec32bit -> GmMsg1F1BusHiSpd.GetTiSpan100MicroSec32bit
    connect CDD_NxtrTi.GetRefTmr100MicroSec32bit -> GmMsg1F5BusHiSpd.GetRefTmr100MicroSec32bit
    connect CDD_NxtrTi.GetTiSpan100MicroSec32bit -> GmMsg1F5BusHiSpd.GetTiSpan100MicroSec32bit
    connect CDD_NxtrTi.GetRefTmr100MicroSec32bit -> GmMsg214BusHiSpd.GetRefTmr100MicroSec32bit
    connect CDD_NxtrTi.GetTiSpan100MicroSec32bit -> GmMsg214BusHiSpd.GetTiSpan100MicroSec32bit
    connect CDD_NxtrTi.GetTiSpan100MicroSec32bit -> GmMsg232BusHiSpd.GetTiSpan100MicroSec32bit
    connect CDD_NxtrTi.GetRefTmr100MicroSec32bit -> GmMsg337BusChassisExp.GetRefTmr100MicroSec32bit
    connect CDD_NxtrTi.GetTiSpan100MicroSec32bit -> GmMsg337BusChassisExp.GetTiSpan100MicroSec32bit
    connect CDD_NxtrTi.GetRefTmr100MicroSec32bit -> GmMsg348BusChassisExp.GetRefTmr100MicroSec32bit
    connect CDD_NxtrTi.GetTiSpan100MicroSec32bit -> GmMsg348BusChassisExp.GetTiSpan100MicroSec32bit
    connect CDD_NxtrTi.GetRefTmr100MicroSec32bit -> GmMsg348BusHiSpd.GetRefTmr100MicroSec32bit
    connect CDD_NxtrTi.GetTiSpan100MicroSec32bit -> GmMsg348BusHiSpd.GetTiSpan100MicroSec32bit
    connect CDD_NxtrTi.GetRefTmr100MicroSec32bit -> GmMsg34ABusChassisExp.GetRefTmr100MicroSec32bit
    connect CDD_NxtrTi.GetTiSpan100MicroSec32bit -> GmMsg34ABusChassisExp.GetTiSpan100MicroSec32bit
    connect CDD_NxtrTi.GetRefTmr100MicroSec32bit -> GmMsg34ABusHiSpd.GetRefTmr100MicroSec32bit
    connect CDD_NxtrTi.GetTiSpan100MicroSec32bit -> GmMsg34ABusHiSpd.GetTiSpan100MicroSec32bit
    connect CDD_NxtrTi.GetRefTmr100MicroSec32bit -> GmMsg3F1BusHiSpd.GetRefTmr100MicroSec32bit
    connect CDD_NxtrTi.GetTiSpan100MicroSec32bit -> GmMsg3F1BusHiSpd.GetTiSpan100MicroSec32bit
    connect CDD_NxtrTi.GetRefTmr100MicroSec32bit -> GmMsg4D1BusHiSpd.GetRefTmr100MicroSec32bit
    connect CDD_NxtrTi.GetTiSpan100MicroSec32bit -> GmMsg4D1BusHiSpd.GetTiSpan100MicroSec32bit
    connect CDD_NxtrTi.GetRefTmr100MicroSec32bit -> GmMsg500BusHiSpd.GetRefTmr100MicroSec32bit
    connect CDD_NxtrTi.GetTiSpan100MicroSec32bit -> GmMsg500BusHiSpd.GetTiSpan100MicroSec32bit
    connect CDD_NxtrTi.GetRefTmr100MicroSec32bit -> GmMsg778BusHiSpd.GetRefTmr100MicroSec32bit
    connect CDD_NxtrTi.GetTiSpan100MicroSec32bit -> GmMsg778BusHiSpd.GetTiSpan100MicroSec32bit
    connect CDD_NxtrTi.GetRefTmr100MicroSec32bit -> GmOvrlStMgr.GetRefTmr100MicroSec32bit
    connect CDD_NxtrTi.GetTiSpan100MicroSec32bit -> GmOvrlStMgr.GetTiSpan100MicroSec32bit
    connect CDD_NxtrTi.GetRefTmr100MicroSec32bit -> GmRoadWhlInQlfr.GetRefTmr100MicroSec32bit
    connect CDD_NxtrTi.GetTiSpan100MicroSec32bit -> GmRoadWhlInQlfr.GetTiSpan100MicroSec32bit
    connect CDD_NxtrTi.GetRefTmr100MicroSec32bit -> GmStrtStop.GetRefTmr100MicroSec32bit
    connect CDD_NxtrTi.GetTiSpan100MicroSec32bit -> GmStrtStop.GetTiSpan100MicroSec32bit
    connect CDD_NxtrTi.GetRefTmr100MicroSec32bit -> GmVehPwrMod.GetRefTmr100MicroSec32bit
    connect CDD_NxtrTi.GetTiSpan100MicroSec32bit -> GmVehPwrMod.GetTiSpan100MicroSec32bit
    connect CDD_NxtrTi.GetRefTmr100MicroSec32bit -> GmVehSpdArbn.GetRefTmr100MicroSec32bit
    connect CDD_NxtrTi.GetTiSpan100MicroSec32bit -> GmVehSpdArbn.GetTiSpan100MicroSec32bit
    connect CDD_NxtrTi.GetRefTmr100MicroSec32bit -> HowDetn.GetRefTmr100MicroSec32bit
    connect CDD_NxtrTi.GetTiSpan100MicroSec32bit -> HowDetn.GetTiSpan100MicroSec32bit
    connect CDD_NxtrTi.GetRefTmr1MicroSec32bit -> HwAg0Meas.GetRefTmr1MicroSec32bit
    connect CDD_NxtrTi.GetTiSpan1MicroSec32bit -> HwAg0Meas.GetTiSpan1MicroSec32bit
    connect CDD_NxtrTi.GetRefTmr1MicroSec32bit -> HwAg1Meas.GetRefTmr1MicroSec32bit
    connect CDD_NxtrTi.GetTiSpan1MicroSec32bit -> HwAg1Meas.GetTiSpan1MicroSec32bit
    connect CDD_NxtrTi.GetRefTmr100MicroSec32bit -> HwAgSnsrls.GetRefTmr100MicroSec32bit
    connect CDD_NxtrTi.GetTiSpan100MicroSec32bit -> HwAgSnsrls.GetTiSpan100MicroSec32bit
    connect CDD_NxtrTi.GetRefTmr100MicroSec32bit -> HwAgSysArbn.GetRefTmr100MicroSec32bit
    connect CDD_NxtrTi.GetTiSpan100MicroSec32bit -> HwAgSysArbn.GetTiSpan100MicroSec32bit
    connect CDD_NxtrTi.GetRefTmr100MicroSec32bit -> MotTqTranlDampg.GetRefTmr100MicroSec32bit
    connect CDD_NxtrTi.GetTiSpan100MicroSec32bit -> MotTqTranlDampg.GetTiSpan100MicroSec32bit
    connect CDD_NxtrTi.GetRefTmr100MicroSec32bit -> MotVelCtrl.GetRefTmr100MicroSec32bit
    connect CDD_NxtrTi.GetTiSpan100MicroSec32bit -> MotVelCtrl.GetTiSpan100MicroSec32bit
    connect CDD_NxtrTi.GetRefTmr100MicroSec32bit -> PullCmpActv.GetRefTmr100MicroSec32bit
    connect CDD_NxtrTi.GetTiSpan100MicroSec32bit -> PullCmpActv.GetTiSpan100MicroSec32bit
    connect CDD_NxtrTi.GetRefTmr100MicroSec32bit -> PwrLimr.GetRefTmr100MicroSec32bit
    connect CDD_NxtrTi.GetTiSpan100MicroSec32bit -> PwrLimr.GetTiSpan100MicroSec32bit
    connect CDD_NxtrTi.GetRefTmr100MicroSec32bit -> PwrpkCmpbltyChk.GetRefTmr100MicroSec32bit
    connect CDD_NxtrTi.GetTiSpan100MicroSec32bit -> PwrpkCmpbltyChk.GetTiSpan100MicroSec32bit
    connect CDD_NxtrTi.GetRefTmr100MicroSec32bit -> SerlComInpProxy.GetRefTmr100MicroSec32bit
    connect CDD_NxtrTi.GetRefTmr100MicroSec32bit -> SnsrOffsLrng.GetRefTmr100MicroSec32bit
    connect CDD_NxtrTi.GetTiSpan100MicroSec32bit -> SnsrOffsLrng.GetTiSpan100MicroSec32bit
    connect CDD_NxtrTi.GetRefTmr100MicroSec32bit -> Swp.GetRefTmr100MicroSec32bit
    connect CDD_NxtrTi.GetTiSpan100MicroSec32bit -> Swp.GetTiSpan100MicroSec32bit
    connect CDD_NxtrTi.GetRefTmr100MicroSec32bit -> SysFricLrng.GetRefTmr100MicroSec32bit
    connect CDD_NxtrTi.GetTiSpan100MicroSec32bit -> SysFricLrng.GetTiSpan100MicroSec32bit
    connect CDD_NxtrTi.GetRefTmr100MicroSec32bit -> WhlImbRejctn.GetRefTmr100MicroSec32bit
    connect CDD_NxtrTi.GetTiSpan100MicroSec32bit -> WhlImbRejctn.GetTiSpan100MicroSec32bit
    connect CDD_RamMem.LclRamEccSngBitCntrOutp -> StHlthSigNormn.LclRamEccSngBitCntrOutp
    connect CDD_SyncCrc.ResvCrcHwUnit -> CDD_FlsMem.ResvCrcHwUnit
    connect CDD_SyncCrc.Calc32BitCrc_u32 -> TunSelnMngt.Calc32BitCrc_u32
    connect CDD_Tauj0CfgAndUse.PhaOnTiMeasdA -> MotDrvDiagc.PhaOnTiMeasdA
    connect CDD_Tauj0CfgAndUse.PhaOnTiMeasdB -> MotDrvDiagc.PhaOnTiMeasdB
    connect CDD_Tauj0CfgAndUse.PhaOnTiMeasdC -> MotDrvDiagc.PhaOnTiMeasdC
    connect CDD_Tauj1CfgAndUse.PhaOnTiMeasdD -> MotDrvDiagc.PhaOnTiMeasdD
    connect CDD_Tauj1CfgAndUse.PhaOnTiMeasdE -> MotDrvDiagc.PhaOnTiMeasdE
    connect CDD_Tauj1CfgAndUse.PhaOnTiMeasdF -> MotDrvDiagc.PhaOnTiMeasdF
    connect CmnMfgSrv.AssiLnrGain -> Assi.AssiLnrGain
    connect CmnMfgSrv.AssiLnrGainEna -> Assi.AssiLnrGainEna
    connect CmnMfgSrv.AssiLnrGainEna -> AssiPahFwl.AssiLnrGainEna
    connect CmnMfgSrv.MfgEnaSt -> AssiPahFwl.MfgEnaSt
    connect CmnMfgSrv.MfgEnaSt -> CDD_XcpIf.MfgEnaSt
    connect CmnMfgSrv.CmnMfgSrvCmnMfgSrvMaiFct -> CmnMfgSrvIf.CmnMfgSrvCmnMfgSrvMaiFct
    connect CmnMfgSrv.MfgEnaSt -> CmnMfgSrvIf.MfgEnaSt
    connect CmnMfgSrv.SysStReqEnaOvrd -> CustDiagc.SysStReqEnaOvrdNxtr
    connect CmnMfgSrv.DampgCmdBasDi -> Dampg.DampgCmdBasDi
    connect CmnMfgSrv.DampgCmdBasDi -> DampgPahFwl.DampgCmdBasDi
    connect CmnMfgSrv.MfgEnaSt -> DampgPahFwl.MfgEnaSt
    connect CmnMfgSrv.IgnCntr -> DiagcMgr.IgnCntr
    connect CmnMfgSrv.MfgDiagcInhb -> DiagcMgr.MfgDiagcInhb
    connect CmnMfgSrv.MfgEnaSt -> DiagcMgr.MfgEnaSt
    connect CmnMfgSrv.DutyCycThermProtnDi -> DutyCycThermProtn.DutyCycThermProtnDi
    connect CmnMfgSrv.EotProtnDi -> EotProtn.EotProtnDi
    connect CmnMfgSrv.EotProtnDi -> EotProtnFwl.EotProtnDi
    connect CmnMfgSrv.MfgEnaSt -> EotProtnFwl.MfgEnaSt
    connect CmnMfgSrv.StallMotTqLimDi -> HiLoadStallLimr.StallMotTqLimDi
    connect CmnMfgSrv.HysCmpCmdDi -> HysCmp.HysCmpCmdDi
    connect CmnMfgSrv.InertiaCmpVelCmdDi -> InertiaCmpVel.InertiaCmpVelCmdDi
    connect CmnMfgSrv.LoaScaDi -> LoaMgr.LoaScaDi
    connect CmnMfgSrv.PullCmpCmdDi -> PullCmpActv.PullCmpCmdDi
    connect CmnMfgSrv.PullCmpLrngDi -> PullCmpActv.PullCmpLrngDi
    connect CmnMfgSrv.RtnCmdDi -> Rtn.RtnCmdDi
    connect CmnMfgSrv.MfgEnaSt -> RtnPahFwl.MfgEnaSt
    connect CmnMfgSrv.RtnCmdDi -> RtnPahFwl.RtnCmdDi
    connect CmnMfgSrv.SysMotTqCmdRampRateDi -> StOutpCtrl.SysMotTqCmdRampRateDi
    connect CmnMfgSrv.FricLrngDi -> SysFricLrng.FricLrngDi
    connect CmnMfgSrv.SysStImdtTranReqOff -> SysStMod.SysStImdtTranReqOff
    connect CmnMfgSrv.AssiMechTEstimnDi -> TEstimn.AssiMechTEstimnDi
    connect CmnMfgSrv.VehSpdOvrd -> VehSigCdng.VehSpdOvrd
    connect CmnMfgSrv.VehSpdOvrdEna -> VehSigCdng.VehSpdOvrdEna
    connect CmnMfgSrvIf.CmnMfgSrvIfCmnMfgSrvIfImdtTx -> CmnMfgSrv.CmnMfgSrvIfCmnMfgSrvIfImdtTx
    connect CmplncErr.CmplncErrMotToPinion -> HwAgSnsrls.CmplncErrMotToPinion
    connect CmplncErr.CmplncErrMotToPinion -> HwAgSysArbn.CmplncErrMotToPinion
    connect CmplncErr.CmplncErrPinionToHw -> HwAgSysArbn.CmplncErrPinionToHw
    connect CurrMeasCorrln.CurrMeasCorrlnSts -> CDD_MotCtrlMgr.CurrMeasCorrlnSts
    connect CurrMeasCorrln.CurrMeasIdptSig -> LoaMgr.CurrMeasIdptSig
    connect CurrMeasCorrln.CurrMotSumABC -> StHlthSigNormn.CurrMotSumABC
    connect CurrMeasCorrln.CurrMotSumDEF -> StHlthSigNormn.CurrMotSumDEF
    connect CustDiagc.MfgOvrlDi -> GmOvrlStMgr.MfgOvrlDi
    connect CustDiagc.SysStReqEnaOvrdCombd -> GmVehPwrMod.SysStEnaReqOvrd
    connect CustDiagc.SerlComDi -> SerlComInpProxy.SerlComDi
    connect Dampg.DampgCmdBas -> DampgPahFwl.DampgCmdBas
    connect DampgPahFwl.DampgCmd -> AssiSumLim.DampgCmd
    connect DiagcMgr.DiagcStsIvtr1Inactv -> BattVltgCorrln.DiagcStsIvtr1Inactv
    connect DiagcMgr.DiagcStsIvtr2Inactv -> BattVltgCorrln.DiagcStsIvtr2Inactv
    connect DiagcMgr.DiagcStsIvtr1Inactv -> CDD_CurrMeas.DiagcStsIvtr1Inactv
    connect DiagcMgr.DiagcStsIvtr2Inactv -> CDD_CurrMeas.DiagcStsIvtr2Inactv
    connect DiagcMgr.DiagcStsIvtr1Inactv -> CDD_MotCtrlMgr.DiagcStsIvtr1Inactv
    connect DiagcMgr.DiagcStsIvtr2Inactv -> CDD_MotCtrlMgr.DiagcStsIvtr2Inactv
    connect DiagcMgr.ClrAllDiagc -> CmnMfgSrv.ClrAllDiagc
    connect DiagcMgr.ClrSnpshtData -> CmnMfgSrv.ClrSnpshtData
    connect DiagcMgr.ReadNtcFltAry -> CmnMfgSrv.ReadNtcFltAry
    connect DiagcMgr.ReadNtcInfoAndDebCntr -> CmnMfgSrv.ReadNtcInfoAndDebCntr
    connect DiagcMgr.ReadSnpshtData -> CmnMfgSrv.ReadSnpshtData
    connect DiagcMgr.DiagcStsIvtr1Inactv -> CurrMeasCorrln.DiagcStsIvtr1Inactv
    connect DiagcMgr.DiagcStsIvtr2Inactv -> CurrMeasCorrln.DiagcStsIvtr2Inactv
    connect DiagcMgr.ClrAllDiagc -> CustDiagc.ClrAllDiagc
    connect DiagcMgr.ClrDiagcFlgProxy -> DiagcMgrProxyAppl10.ClrDiagcFlgProxy
    connect DiagcMgr.DiagcMgrIninCore -> DiagcMgrProxyAppl10.DiagcMgrIninCore
    connect DiagcMgr.GetNtcActvCore -> DiagcMgrProxyAppl10.GetNtcActvCore
    connect DiagcMgr.GetNtcQlfrStsCore -> DiagcMgrProxyAppl10.GetNtcQlfrStsCore
    connect DiagcMgr.GetNtcStsCore -> DiagcMgrProxyAppl10.GetNtcStsCore
    connect DiagcMgr.SetNtcStsCore -> DiagcMgrProxyAppl10.SetNtcStsCore
    connect DiagcMgr.ClrDiagcFlgProxy -> DiagcMgrProxyAppl6.ClrDiagcFlgProxy
    connect DiagcMgr.DiagcMgrIninCore -> DiagcMgrProxyAppl6.DiagcMgrIninCore
    connect DiagcMgr.GetNtcActvCore -> DiagcMgrProxyAppl6.GetNtcActvCore
    connect DiagcMgr.GetNtcQlfrStsCore -> DiagcMgrProxyAppl6.GetNtcQlfrStsCore
    connect DiagcMgr.GetNtcStsCore -> DiagcMgrProxyAppl6.GetNtcStsCore
    connect DiagcMgr.SetNtcStsCore -> DiagcMgrProxyAppl6.SetNtcStsCore
    connect DiagcMgr.DiagcStsLimdTPrfmnc -> DutyCycThermProtn.DiagcStsLimdTPrfmnc
    connect DiagcMgr.DiagcStsLimdTPrfmnc -> EcuTMeas.DiagcStsLimdTPrfmnc
    connect DiagcMgr.DiagcStsIvtr1Inactv -> GateDrv0Ctrl.DiagcStsIvtr1Inactv
    connect DiagcMgr.DiagcStsIvtr2Inactv -> GateDrv1Ctrl.DiagcStsIvtr2Inactv
    connect DiagcMgr.SysStFltOutpReqDi -> GmVehPwrMod.SysStFltOutpReqDi
    connect DiagcMgr.DiagcStsIvtr1Inactv -> LoaMgr.DiagcStsIvtr1Inactv
    connect DiagcMgr.DiagcStsIvtr2Inactv -> LoaMgr.DiagcStsIvtr2Inactv
    connect DiagcMgr.DiagcStsIvtr1Inactv -> MotDrvDiagc.DiagcStsIvtr1Inactv
    connect DiagcMgr.DiagcStsIvtr2Inactv -> MotDrvDiagc.DiagcStsIvtr2Inactv
    connect DiagcMgr.DiagcStsCtrldShtDwnFltPrsnt -> MotTqTranlDampg.DiagcStsCtrldShtDwnFltPrsnt
    connect DiagcMgr.DiagcStsCtrldShtDwnFltPrsnt -> StOutpCtrl.DiagcStsCtrldShtDwnFltPrsnt
    connect DiagcMgr.SysDiMotTqCmdSca -> StOutpCtrl.SysDiMotTqCmdSca
    connect DiagcMgr.SysDiRampRate -> StOutpCtrl.SysDiRampRate
    connect DiagcMgr.SysStFltOutpReqDi -> StOutpCtrl.SysStFltOutpReqDi
    connect DiagcMgr.SysStFltOutpReqDi -> SysStMod.SysStFltOutpReqDi
    connect DiagcMgr.DiagcStsIvtr1Inactv -> TmplMonr.DiagcStsIvtr1Inactv
    connect DiagcMgr.DiagcStsIvtr2Inactv -> TmplMonr.DiagcStsIvtr2Inactv
    connect DiagcMgrProxyAppl10.GetNtcQlfrSts10 -> AssiPahFwl.GetNtcQlfrSts
    connect DiagcMgrProxyAppl10.SetNtcSts10 -> AssiPahFwl.SetNtcSts
    connect DiagcMgrProxyAppl10.GetNtcQlfrSts10 -> AssiSumLim.GetNtcQlfrSts
    connect DiagcMgrProxyAppl10.SetNtcSts10 -> AssiSumLim.SetNtcSts
    connect DiagcMgrProxyAppl10.GetNtcQlfrSts10 -> BattVltgCorrln.GetNtcQlfrSts
    connect DiagcMgrProxyAppl10.SetNtcSts10 -> BattVltgCorrln.SetNtcSts
    connect DiagcMgrProxyAppl10.GetNtcQlfrSts10 -> CDD_AdcDiagc.GetNtcQlfrSts
    connect DiagcMgrProxyAppl10.SetNtcSts10 -> CDD_AdcDiagc.SetNtcSts
    connect DiagcMgrProxyAppl10.GetNtcQlfrSts10 -> CDD_CurrMeas.GetNtcQlfrSts
    connect DiagcMgrProxyAppl10.SetNtcSts10 -> CDD_CurrMeas.SetNtcSts
    connect DiagcMgrProxyAppl10.SetNtcSts10 -> CDD_ExcpnHndlg.SetNtcSts
    connect DiagcMgrProxyAppl10.GetNtcQlfrSts10 -> CDD_FlsMem.GetNtcQlfrSts
    connect DiagcMgrProxyAppl10.SetNtcSts10 -> CDD_FlsMem.SetNtcSts
    connect DiagcMgrProxyAppl10.GetNtcQlfrSts10 -> CDD_HwTq0Meas.GetNtcQlfrSts
    connect DiagcMgrProxyAppl10.SetNtcSts10 -> CDD_HwTq0Meas.SetNtcSts
    connect DiagcMgrProxyAppl10.GetNtcQlfrSts10 -> CDD_HwTq1Meas.GetNtcQlfrSts
    connect DiagcMgrProxyAppl10.SetNtcSts10 -> CDD_HwTq1Meas.SetNtcSts
    connect DiagcMgrProxyAppl10.GetNtcQlfrSts10 -> CDD_HwTq2Meas.GetNtcQlfrSts
    connect DiagcMgrProxyAppl10.SetNtcSts10 -> CDD_HwTq2Meas.SetNtcSts
    connect DiagcMgrProxyAppl10.GetNtcQlfrSts10 -> CDD_HwTq3Meas.GetNtcQlfrSts
    connect DiagcMgrProxyAppl10.SetNtcSts10 -> CDD_HwTq3Meas.SetNtcSts
    connect DiagcMgrProxyAppl10.SetNtcSts10 -> CDD_McuDiagc.SetNtcSts
    connect DiagcMgrProxyAppl10.GetNtcQlfrSts10 -> CDD_MotAg0Meas.GetNtcQlfrSts
    connect DiagcMgrProxyAppl10.SetNtcSts10 -> CDD_MotAg0Meas.SetNtcSts
    connect DiagcMgrProxyAppl10.GetNtcQlfrSts10 -> CDD_MotAg1Meas.GetNtcQlfrSts
    connect DiagcMgrProxyAppl10.SetNtcSts10 -> CDD_MotAg1Meas.SetNtcSts
    connect DiagcMgrProxyAppl10.SetNtcSts10 -> CDD_NvMProxy.SetNtcSts
    connect DiagcMgrProxyAppl10.SetNtcSts10 -> CDD_NxtrTi.SetNtcSts
    connect DiagcMgrProxyAppl10.SetNtcSts10 -> CDD_RamMem.SetNtcSts
    connect DiagcMgrProxyAppl10.SetNtcSts10 -> CDD_VrfyCritReg.SetNtcSts
    connect DiagcMgrProxyAppl10.GetNtcSts10 -> CmnMfgSrv.GetNtcSts
    connect DiagcMgrProxyAppl10.GetNtcQlfrSts10 -> CurrMeasCorrln.GetNtcQlfrSts
    connect DiagcMgrProxyAppl10.SetNtcSts10 -> CurrMeasCorrln.SetNtcSts
    connect DiagcMgrProxyAppl10.GetNtcQlfrSts10 -> DampgPahFwl.GetNtcQlfrSts
    connect DiagcMgrProxyAppl10.SetNtcSts10 -> DampgPahFwl.SetNtcSts
    connect DiagcMgrProxyAppl10.GetDiagcDataAppl10 -> DiagcMgr.GetDiagcDataAppl10
    connect DiagcMgrProxyAppl10.GetNtcDebCntrAppl10 -> DiagcMgr.GetNtcDebCntrAppl10
    connect DiagcMgrProxyAppl10.GetNtcInfoAppl10 -> DiagcMgr.GetNtcInfoAppl10
    connect DiagcMgrProxyAppl10.SetNtcSts10 -> DutyCycThermProtn.SetNtcSts
    connect DiagcMgrProxyAppl10.SetNtcSts10 -> EcuTMeas.SetNtcSts
    connect DiagcMgrProxyAppl10.GetNtcQlfrSts10 -> EotLrng.GetNtcQlfrSts
    connect DiagcMgrProxyAppl10.SetNtcSts10 -> EotLrng.SetNtcSts
    connect DiagcMgrProxyAppl10.SetNtcSts10 -> EotProtnFwl.SetNtcSts
    connect DiagcMgrProxyAppl10.SetNtcSts10 -> GateDrv0Ctrl.SetNtcSts
    connect DiagcMgrProxyAppl10.SetNtcSts10 -> GateDrv1Ctrl.SetNtcSts
    connect DiagcMgrProxyAppl10.SetNtcSts10 -> GmOvrlStMgr.SetNtcSts
    connect DiagcMgrProxyAppl10.SetNtcSts10 -> GmRoadWhlInQlfr.SetNtcSts
    connect DiagcMgrProxyAppl10.SetNtcSts10 -> GmVehSpdArbn.SetNtcSts
    connect DiagcMgrProxyAppl10.GetNtcQlfrSts10 -> HwAg0Meas.GetNtcQlfrSts
    connect DiagcMgrProxyAppl10.SetNtcSts10 -> HwAg0Meas.SetNtcSts
    connect DiagcMgrProxyAppl10.GetNtcQlfrSts10 -> HwAg1Meas.GetNtcQlfrSts
    connect DiagcMgrProxyAppl10.SetNtcSts10 -> HwAg1Meas.SetNtcSts
    connect DiagcMgrProxyAppl10.GetNtcQlfrSts10 -> HwAgCorrln.GetNtcQlfrSts
    connect DiagcMgrProxyAppl10.SetNtcSts10 -> HwAgCorrln.SetNtcSts
    connect DiagcMgrProxyAppl10.GetNtcQlfrSts10 -> HwAgSnsrls.GetNtcQlfrSts
    connect DiagcMgrProxyAppl10.SetNtcSts10 -> HwAgSysArbn.SetNtcSts
    connect DiagcMgrProxyAppl10.SetNtcSts10 -> HwAgVehCentrTrim.SetNtcSts
    connect DiagcMgrProxyAppl10.GetNtcQlfrSts10 -> HwTqCorrln.GetNtcQlfrSts
    connect DiagcMgrProxyAppl10.SetNtcSts10 -> HwTqCorrln.SetNtcSts
    connect DiagcMgrProxyAppl10.SetNtcSts10 -> LoaMgr.SetNtcSts
    connect DiagcMgrProxyAppl10.GetNtcQlfrSts10 -> MotAg2Meas.GetNtcQlfrSts
    connect DiagcMgrProxyAppl10.SetNtcSts10 -> MotAg2Meas.SetNtcSts
    connect DiagcMgrProxyAppl10.GetNtcQlfrSts10 -> MotAgCorrln.GetNtcQlfrSts
    connect DiagcMgrProxyAppl10.SetNtcSts10 -> MotAgCorrln.SetNtcSts
    connect DiagcMgrProxyAppl10.SetNtcSts10 -> MotDrvDiagc.SetNtcSts
    connect DiagcMgrProxyAppl10.GetNtcQlfrSts10 -> PwrDiscnct.GetNtcQlfrSts
    connect DiagcMgrProxyAppl10.SetNtcSts10 -> PwrDiscnct.SetNtcSts
    connect DiagcMgrProxyAppl10.SetNtcSts10 -> PwrLimr.SetNtcSts
    connect DiagcMgrProxyAppl10.GetNtcQlfrSts10 -> PwrpkCmpbltyChk.GetNtcQlfrSts
    connect DiagcMgrProxyAppl10.SetNtcSts10 -> PwrpkCmpbltyChk.SetNtcSts
    connect DiagcMgrProxyAppl10.SetNtcSts10 -> PwrSply.SetNtcSts
    connect DiagcMgrProxyAppl10.SetNtcSts10 -> RtnPahFwl.SetNtcSts
    connect DiagcMgrProxyAppl10.GetNtcQlfrSts10 -> StHlthSigNormn.GetNtcQlfrSts
    connect DiagcMgrProxyAppl10.SetNtcSts10 -> StHlthSigNormn.SetNtcSts
    connect DiagcMgrProxyAppl10.SetNtcSts10 -> SysFricLrng.SetNtcSts
    connect DiagcMgrProxyAppl10.SetNtcSts10 -> TmplMonr.SetNtcSts
    connect DiagcMgrProxyAppl10.SetNtcSts10 -> TunSelnMngt.SetNtcSts
    connect DiagcMgrProxyAppl10.SetNtcSts10 -> WhlImbRejctn.SetNtcSts
    connect DiagcMgrProxyAppl6.GetNtcActv6 -> CustDiagc.GetNtcActv
    connect DiagcMgrProxyAppl6.GetNtcSts6 -> CustDiagc.GetNtcSts
    connect DiagcMgrProxyAppl6.GetDiagcDataAppl6 -> DiagcMgr.GetDiagcDataAppl6
    connect DiagcMgrProxyAppl6.GetNtcDebCntrAppl6 -> DiagcMgr.GetNtcDebCntrAppl6
    connect DiagcMgrProxyAppl6.GetNtcInfoAppl6 -> DiagcMgr.GetNtcInfoAppl6
    connect DiagcMgrProxyAppl6.SetNtcSts6 -> GmMsg0C5BusHiSpd.SetNtcSts
    connect DiagcMgrProxyAppl6.SetNtcSts6 -> GmMsg0C9BusHiSpd.SetNtcSts
    connect DiagcMgrProxyAppl6.SetNtcSts6 -> GmMsg17DBusHiSpd.SetNtcSts
    connect DiagcMgrProxyAppl6.SetNtcSts6 -> GmMsg180BusChassisExp.SetNtcSts
    connect DiagcMgrProxyAppl6.SetNtcSts6 -> GmMsg180BusHiSpd.SetNtcSts
    connect DiagcMgrProxyAppl6.SetNtcSts6 -> GmMsg182BusChassisExp.SetNtcSts
    connect DiagcMgrProxyAppl6.SetNtcSts6 -> GmMsg1E9BusHiSpd.SetNtcSts
    connect DiagcMgrProxyAppl6.SetNtcSts6 -> GmMsg1F1BusHiSpd.SetNtcSts
    connect DiagcMgrProxyAppl6.SetNtcSts6 -> GmMsg1F5BusHiSpd.SetNtcSts
    connect DiagcMgrProxyAppl6.SetNtcSts6 -> GmMsg214BusHiSpd.SetNtcSts
    connect DiagcMgrProxyAppl6.SetNtcSts6 -> GmMsg232BusHiSpd.SetNtcSts
    connect DiagcMgrProxyAppl6.SetNtcSts6 -> GmMsg337BusChassisExp.SetNtcSts
    connect DiagcMgrProxyAppl6.SetNtcSts6 -> GmMsg348BusChassisExp.SetNtcSts
    connect DiagcMgrProxyAppl6.SetNtcSts6 -> GmMsg348BusHiSpd.SetNtcSts
    connect DiagcMgrProxyAppl6.SetNtcSts6 -> GmMsg34ABusChassisExp.SetNtcSts
    connect DiagcMgrProxyAppl6.SetNtcSts6 -> GmMsg34ABusHiSpd.SetNtcSts
    connect DiagcMgrProxyAppl6.SetNtcSts6 -> GmMsg3F1BusHiSpd.SetNtcSts
    connect DiagcMgrProxyAppl6.SetNtcSts6 -> GmMsg4D1BusHiSpd.SetNtcSts
    connect DiagcMgrProxyAppl6.SetNtcSts6 -> GmMsg500BusHiSpd.SetNtcSts
    connect DiagcMgrProxyAppl6.SetNtcSts6 -> PartNr.SetNtcSts
    connect DiagcMgrProxyAppl6.SetNtcSts6 -> SerlComOutpProxy.SetNtcSts
    connect DiagcMgrStub.GetDiagcDataStub -> DiagcMgr.GetDiagcDataAppl{0..5}
    connect DiagcMgrStub.GetDiagcDataStub -> DiagcMgr.GetDiagcDataAppl{7..9}
    connect DiagcMgrStub.GetNtcDebCntrStub -> DiagcMgr.GetNtcDebCntrAppl{0..5}
    connect DiagcMgrStub.GetNtcDebCntrStub -> DiagcMgr.GetNtcDebCntrAppl{7..9}
    connect DiagcMgrStub.GetNtcInfoStub -> DiagcMgr.GetNtcInfoAppl{0..5}
    connect DiagcMgrStub.GetNtcInfoStub -> DiagcMgr.GetNtcInfoAppl{7..9}
    connect DutyCycThermProtn.ThermLimSlowFilMax -> Assi.ThermLimSlowFilMax
    connect DutyCycThermProtn.ThermRednFac -> AssiSumLim.ThermRednFac
    connect DutyCycThermProtn.ThermMotTqLim -> LimrCdng.ThermMotTqLim
    connect DutyCycThermProtn.DutyCycThermProtnMaxOutp -> StHlthSigNormn.DutyCycThermProtnMaxOutp
    connect EcuTMeas.EcuTFild -> CDD_MotCtrlMgr.EcuTFild
    connect EcuTMeas.EcuTFild -> CustDiagc.EcuTFild
    connect EcuTMeas.EcuTFild -> DiagcMgr.EcuTFild
    connect EcuTMeas.EcuTFild -> DutyCycThermProtn.EcuTFild
    connect EcuTMeas.EcuTFild -> StHlthSigNormn.EcuTFild
    connect EcuTMeas.EcuTFild -> TEstimn.EcuTFild
    connect EotLrng.GetHwAgOverTrvlCnt -> CmnMfgSrv.GetHwAgOverTrvlCnt
    connect EotLrng.RstHwAgOverTrvlCnt -> CmnMfgSrv.RstHwAgOverTrvlCnt
    connect EotLrng.RstMaxHwAgCwAndCcw -> CmnMfgSrv.RstMaxHwAgCwAndCcw
    connect EotLrng.RtnMaxHwAgCwAndCcw -> CmnMfgSrv.RtnMaxHwAgCwAndCcw
    connect EotLrng.SerlComRstEot -> CmnMfgSrv.SerlComRstEot
    connect EotLrng.SetHwAgOverTrvlCnt -> CmnMfgSrv.SetHwAgOverTrvlCnt
    connect EotLrng.HwAgCcwDetd -> CustDiagc.HwAgCcwDetd
    connect EotLrng.HwAgCwDetd -> CustDiagc.HwAgCwDetd
    connect EotLrng.HwAgEotCcw -> CustDiagc.HwAgEotCcw
    connect EotLrng.HwAgEotCw -> CustDiagc.HwAgEotCw
    connect EotLrng.RtnMaxHwAgCwAndCcw -> CustDiagc.RtnMaxHwAgCwAndCcw
    connect EotLrng.HwAgCcwDetd -> EotProtn.HwAgCcwDetd
    connect EotLrng.HwAgCwDetd -> EotProtn.HwAgCwDetd
    connect EotLrng.HwAgEotCcw -> EotProtn.HwAgEotCcw
    connect EotLrng.HwAgEotCw -> EotProtn.HwAgEotCw
    connect EotLrng.HwAgEotCcw -> GmFctDiArbn.HwAgEotCcw
    connect EotLrng.HwAgEotCw -> GmFctDiArbn.HwAgEotCw
    connect EotLrng.HwAgEotCcw -> GmOvrlStMgr.HwAgEotCcw
    connect EotLrng.HwAgEotCw -> GmOvrlStMgr.HwAgEotCw
    connect EotLrng.HwAgCcwDetd -> HwAgVehCentrTrim.HwAgCcwDetd
    connect EotLrng.HwAgCwDetd -> HwAgVehCentrTrim.HwAgCwDetd
    connect EotLrng.HwAgEotCcw -> HwAgVehCentrTrim.HwAgEotCcw
    connect EotLrng.HwAgEotCw -> HwAgVehCentrTrim.HwAgEotCw
    connect EotLrng.HwAgEotCcw -> StHlthSigNormn.HwAgEotCcw
    connect EotLrng.HwAgEotCw -> StHlthSigNormn.HwAgEotCw
    connect EotLrng.HwAgEotCcw -> VehSpdLimr.HwAgEotCcw
    connect EotLrng.HwAgEotCw -> VehSpdLimr.HwAgEotCw
    connect EotProtn.EotActvCmd -> EotProtnFwl.EotActvCmd
    connect EotProtn.EotDampgCmd -> EotProtnFwl.EotDampgCmd
    connect EotProtn.EotAssiSca -> LimrCdng.EotAssiSca
    connect EotProtn.EotMotTqLim -> LimrCdng.EotMotTqLim
    connect EotProtnFwl.EotActvCmdLimd -> AssiSumLim.EotActvCmd
    connect EotProtnFwl.EotDampgCmdLimd -> AssiSumLim.EotDampgCmd
    connect FltInj.FltInj_f32 -> Assi.FltInj_f32
    connect FltInj.FltInj_f32 -> CDD_HwTq0Meas.FltInj_f32
    connect FltInj.FltInj_u08 -> CDD_HwTq0Meas.FltInj_u08
    connect FltInj.FltInj_f32 -> CDD_HwTq2Meas.FltInj_f32
    connect FltInj.FltInj_u08 -> CurrMeasCorrln.FltInj_u08
    connect FltInj.FltInj_f32 -> Dampg.FltInj_f32
    connect FltInj.FltInj_logl -> DiagcMgr.FltInj_logl
    connect FltInj.FltInj_f32 -> HwAg0Meas.FltInj_f32
    connect FltInj.FltInj_u08 -> HwAg0Meas.FltInj_u08
    connect FltInj.FltInj_f32 -> HwAgCorrln.FltInj_f32
    connect FltInj.FltInj_u08 -> HwAgCorrln.FltInj_u08
    connect FltInj.FltInj_f32 -> HwAgSysArbn.FltInj_f32
    connect FltInj.FltInj_u08 -> HwTqCorrln.FltInj_u08
    connect FltInj.FltInj_f32 -> HysCmp.FltInj_f32
    connect FltInj.FltInj_f32 -> InertiaCmpVel.FltInj_f32
    connect FltInj.FltInj_f32 -> LimrCdng.FltInj_f32
    connect FltInj.FltInj_f32 -> MotAg2Meas.FltInj_f32
    connect FltInj.FltInj_u08 -> MotAgCorrln.FltInj_u08
    connect FltInj.FltInj_f32 -> Rtn.FltInj_f32
    connect FltInj.FltInj_f32 -> StabyCmp.FltInj_f32
    connect FltInj.FltInj_f32 -> SysFricLrng.FltInj_f32
    connect FltInj.FltInj_f32 -> TqOscn.FltInj_f32
    connect FltInj.FltInj_f32 -> VehSigCdng.FltInj_f32
    connect GateDrv0Ctrl.MotDrvr0IninTestCmpl -> PwrUpSeq.MotDrvr0IninTestCmpl
    connect GateDrv1Ctrl.MotDrvr1IninTestCmpl -> PwrUpSeq.MotDrvr1IninTestCmpl
    connect GmFctDiArbn.GmFctDiReq -> CustDiagc.GmFctDiReq
    connect GmFctDiArbn.GmFctDiSts -> CustDiagc.GmFctDiSts
    connect GmFctDiArbn.ApaEnaArbn -> GmOvrlStMgr.ApaEna
    connect GmFctDiArbn.EscEnaArbn -> GmOvrlStMgr.EscEna
    connect GmFctDiArbn.LkaEnaArbn -> GmOvrlStMgr.LkaEna
    connect GmFctDiArbn.InertiaCmpDecelGainDi -> InertiaCmpVel.InertiaCmpDecelGainDi
    connect GmFctDiArbn.PullCmpActvDi -> PullCmpActv.PullCmpActvDi
    connect GmFctDiArbn.TunSetRtDi -> TunSelnAuthy.TunSelnRtDi
    connect GmFctDiArbn.WhlImbRejctnDi -> WhlImbRejctn.WhlImbRejctnDi
    connect GmMsg0C5BusHiSpd.LeWhlDstPlsCntr -> GmRoadWhlInQlfr.WhlLeDstPlsCntr
    connect GmMsg0C5BusHiSpd.LeWhlDstTiStamp -> GmRoadWhlInQlfr.WhlLeDstTiStamp
    connect GmMsg0C5BusHiSpd.LeWhlDstVld -> GmRoadWhlInQlfr.WhlLeDstVld
    connect GmMsg0C5BusHiSpd.RiWhlDstPlsCntr -> GmRoadWhlInQlfr.WhlRiDstPlsCntr
    connect GmMsg0C5BusHiSpd.RiWhlDstTiStamp -> GmRoadWhlInQlfr.WhlRiDstTiStamp
    connect GmMsg0C5BusHiSpd.RiWhlDstVld -> GmRoadWhlInQlfr.WhlRiDstVld
    connect GmMsg0C9BusHiSpd.EngRunActv -> CustDiagc.EngRunActv
    connect GmMsg0C9BusHiSpd.EngSpd -> CustDiagc.EngSpd
    connect GmMsg0C9BusHiSpd.MissMsg0C9 -> CustDiagc.MissMsg0C9
    connect GmMsg0C9BusHiSpd.EngRunActv -> GmMsg1F1BusHiSpd.EngRunActv
    connect GmMsg0C9BusHiSpd.EngSpd -> GmStrtStop.EngSpd
    connect GmMsg0C9BusHiSpd.InvldMsg0C9 -> GmStrtStop.Msg0C9BusHiSpdInvld
    connect GmMsg0C9BusHiSpd.MissMsg0C9 -> GmStrtStop.Msg0C9BusHiSpdMiss
    connect GmMsg0C9BusHiSpd.EngRunActv -> GmVehPwrMod.EngRunActv
    connect GmMsg0C9BusHiSpd.MissMsg0C9 -> GmVehPwrMod.PrpnSysActvMsgInvld
    connect GmMsg0C9BusHiSpd.EngRunActv -> HwAgVehCentrTrim.EngRunActv
    connect GmMsg148BusHiSpd.PwrSteerIndcr -> SerlComOutpProxy.PwrSteerIndcr
    connect GmMsg148BusHiSpd.SteerAssiLimd -> SerlComOutpProxy.SteerAssiLimd
    connect GmMsg148BusHiSpd.SteerAssiLimdLvl2 -> SerlComOutpProxy.SteerAssiLimdLvl2
    connect GmMsg148BusHiSpd.SteerAssiLimdLvl3 -> SerlComOutpProxy.SteerAssiLimdLvl3
    connect GmMsg17DBusHiSpd.InvldMsg17D -> GmOvrlStMgr.Msg17DBusHiSpdInvld
    connect GmMsg17DBusHiSpd.MissMsg17D -> GmOvrlStMgr.Msg17DBusHiSpdMiss
    connect GmMsg180BusChassisExp.EscReqActv -> GmFctDiArbn.EscEna
    connect GmMsg180BusChassisExp.InvldMsg180BusChassisExp -> GmOvrlStMgr.Msg180BusChassisExpInvld
    connect GmMsg180BusChassisExp.MissMsg180BusChassisExp -> GmOvrlStMgr.Msg180BusChassisExpMiss
    connect GmMsg180BusChassisExp.EscCmd -> GmTqArbn.EscCmd
    connect GmMsg180BusHiSpd.LkaCmd -> CustDiagc.LkaCmd
    connect GmMsg180BusHiSpd.LkaReqActv -> GmFctDiArbn.LkaEna
    connect GmMsg180BusHiSpd.InvldMsg180BusHiSpd -> GmOvrlStMgr.Msg180BusHiSpdInvld
    connect GmMsg180BusHiSpd.MissMsg180BusHiSpd -> GmOvrlStMgr.Msg180BusHiSpdMiss
    connect GmMsg180BusHiSpd.LkaCmd -> GmTqArbn.LkaTqCmd
    connect GmMsg182BusChassisExp.SerlComVehLgtA -> VehSigCdng.VehLgtASerlCom
    connect GmMsg184BusHiSpd.HandsOffSteerWhlDetnMod -> SerlComOutpProxy.HandsOffSteerWhlDetnMod
    connect GmMsg184BusHiSpd.HandsOffSteerWhlDetnSt -> SerlComOutpProxy.HandsOffSteerWhlDetnSt
    connect GmMsg184BusHiSpd.HandsOffSteerWhlDetnStVld -> SerlComOutpProxy.HandsOffSteerWhlDetnStVld
    connect GmMsg184BusHiSpd.LkaDrvrAppldTq -> SerlComOutpProxy.LkaDrvrAppldTq
    connect GmMsg184BusHiSpd.LkaDrvrAppldTqVld -> SerlComOutpProxy.LkaDrvrAppldTqVld
    connect GmMsg184BusHiSpd.LkaElecPwrSteerTotTqDlvd -> SerlComOutpProxy.LkaElecPwrSteerTotTqDlvd
    connect GmMsg184BusHiSpd.LkaTqOvrlDeltaTqDlvd -> SerlComOutpProxy.LkaTqOvrlDeltaTqDlvd
    connect GmMsg184BusHiSpd.LkaTqOvrlDlvdRollgCntr -> SerlComOutpProxy.LkaTqOvrlDlvdRollgCntr
    connect GmMsg184BusHiSpd.LkaTqOvrlStsChks -> SerlComOutpProxy.LkaTqOvrlStsChks
    connect GmMsg184BusHiSpd.LkaTqOvrlTqDlvdSts -> SerlComOutpProxy.LkaTqOvrlTqDlvdSts
    connect GmMsg184BusHiSpd.MsgTxCallBack -> SerlComOutpProxy.Msg184TxCallBack
    connect GmMsg1CABusChassisExp.ElecPwrSteerTotTqDlvd -> SerlComOutpProxy.ElecPwrSteerTotTqDlvd
    connect GmMsg1CABusChassisExp.Msg1CATxCallBack -> SerlComOutpProxy.Msg1CATxCallBack
    connect GmMsg1CABusChassisExp.TqOvrlDeltaTqDlvd -> SerlComOutpProxy.TqOvrlDeltaTqDlvd
    connect GmMsg1CABusChassisExp.TqOvrlDlvdChks -> SerlComOutpProxy.TqOvrlDlvdChks
    connect GmMsg1CABusChassisExp.TqOvrlDlvdRollgCntr -> SerlComOutpProxy.TqOvrlDlvdRollgCntr
    connect GmMsg1CABusChassisExp.TqOvrlTqDlvdSts -> SerlComOutpProxy.TqOvrlTqDlvdSts
    connect GmMsg1E5BusChassisExp.Msg1E5ChassisExpTxCallBack -> SerlComOutpProxy.Msg1E5ChassisExpTxCallBack
    connect GmMsg1E5BusChassisExp.SteerWhlAgAlvRollgCntBusChassisExp -> SerlComOutpProxy.SteerWhlAgAlvRollgCntBusChassisExp
    connect GmMsg1E5BusChassisExp.SteerWhlAgBusChassisExp -> SerlComOutpProxy.SteerWhlAgBusChassisExp
    connect GmMsg1E5BusChassisExp.SteerWhlAgGrdtBusChassisExp -> SerlComOutpProxy.SteerWhlAgGrdtBusChassisExp
    connect GmMsg1E5BusChassisExp.SteerWhlAgGrdtMaskBusChassisExp -> SerlComOutpProxy.SteerWhlAgGrdtMaskBusChassisExp
    connect GmMsg1E5BusChassisExp.SteerWhlAgGrdtVldBusChassisExp -> SerlComOutpProxy.SteerWhlAgGrdtVldBusChassisExp
    connect GmMsg1E5BusChassisExp.SteerWhlAgMaskBusChassisExp -> SerlComOutpProxy.SteerWhlAgMaskBusChassisExp
    connect GmMsg1E5BusChassisExp.SteerWhlAgSnsrCalStsBusChassisExp -> SerlComOutpProxy.SteerWhlAgSnsrCalStsBusChassisExp
    connect GmMsg1E5BusChassisExp.SteerWhlAgSnsrChksBusChassisExp -> SerlComOutpProxy.SteerWhlAgSnsrChksBusChassisExp
    connect GmMsg1E5BusChassisExp.SteerWhlAgSnsrTypBusChassisExp -> SerlComOutpProxy.SteerWhlAgSnsrTypBusChassisExp
    connect GmMsg1E5BusChassisExp.SteerWhlAgVldBusChassisExp -> SerlComOutpProxy.SteerWhlAgVldBusChassisExp
    connect GmMsg1E5BusHiSpd.Msg1E5HiSpdCallBack -> SerlComOutpProxy.Msg1E5HiSpdTxCallBack
    connect GmMsg1E5BusHiSpd.SteerWhlAgAlvRollgCntBusHiSpd -> SerlComOutpProxy.SteerWhlAgAlvRollgCntBusHiSpd
    connect GmMsg1E5BusHiSpd.SteerWhlAgBusHiSpd -> SerlComOutpProxy.SteerWhlAgBusHiSpd
    connect GmMsg1E5BusHiSpd.SteerWhlAgGrdtBusHiSpd -> SerlComOutpProxy.SteerWhlAgGrdtBusHiSpd
    connect GmMsg1E5BusHiSpd.SteerWhlAgGrdtMaskBusHiSpd -> SerlComOutpProxy.SteerWhlAgGrdtMaskBusHiSpd
    connect GmMsg1E5BusHiSpd.SteerWhlAgGrdtVldBusHiSpd -> SerlComOutpProxy.SteerWhlAgGrdtVldBusHiSpd
    connect GmMsg1E5BusHiSpd.SteerWhlAgMaskBusHiSpd -> SerlComOutpProxy.SteerWhlAgMaskBusHiSpd
    connect GmMsg1E5BusHiSpd.SteerWhlAgSnsrCalStsBusHiSpd -> SerlComOutpProxy.SteerWhlAgSnsrCalStsBusHiSpd
    connect GmMsg1E5BusHiSpd.SteerWhlAgSnsrChksBusHiSpd -> SerlComOutpProxy.SteerWhlAgSnsrChksBusHiSpd
    connect GmMsg1E5BusHiSpd.SteerWhlAgSnsrTypBusHiSpd -> SerlComOutpProxy.SteerWhlAgSnsrTypBusHiSpd
    connect GmMsg1E5BusHiSpd.SteerWhlAgVldBusHiSpd -> SerlComOutpProxy.SteerWhlAgVldBusHiSpd
    connect GmMsg1E9BusHiSpd.VehStabyEnhmtActv -> GmMsg214BusHiSpd.VehStabyEnhmtActv
    connect GmMsg1E9BusHiSpd.InvldMsg1E9 -> GmOvrlStMgr.Msg1E9BusHiSpdInvld
    connect GmMsg1E9BusHiSpd.MissMsg1E9 -> GmOvrlStMgr.Msg1E9BusHiSpdMiss
    connect GmMsg1E9BusHiSpd.VehStabyEnhmtActv -> GmOvrlStMgr.VehStabyEnhmtActv
    connect GmMsg1E9BusHiSpd.SerlComYawRateVld -> SnsrOffsLrng.VehYawRateVld
    connect GmMsg1E9BusHiSpd.SerlComLatA -> VehSigCdng.VehLatASerlCom
    connect GmMsg1E9BusHiSpd.VehLatAVldSerlCom -> VehSigCdng.VehLatAVldSerlCom
    connect GmMsg1E9BusHiSpd.SerlComYawRate -> VehSigCdng.VehYawRateSerlCom
    connect GmMsg1E9BusHiSpd.SerlComYawRateVld -> VehSigCdng.VehYawRateVldSerlCom
    connect GmMsg1F1BusHiSpd.SysPwrMod -> CustDiagc.GmSysPwrMod
    connect GmMsg1F1BusHiSpd.MissMsg1F1 -> CustDiagc.MissMsg1F1
    connect GmMsg1F1BusHiSpd.SysPwrMod -> CustDiagc.SysPwrMod
    connect GmMsg1F1BusHiSpd.MissMsg1F1 -> GmVehPwrMod.SysPwrModMsgInvld
    connect GmMsg1F1BusHiSpd.SysPwrModRun -> GmVehPwrMod.SysPwrModRun
    connect GmMsg1F1BusHiSpd.SysPwrMod -> PartNr.GmSysPwrMod
    connect GmMsg1F1BusHiSpd.SysPwrModRun -> PartNr.SysPwrModRun
    connect GmMsg1F5BusHiSpd.InvldMsg1F5 -> GmOvrlStMgr.Msg1F5BusHiSpdInvld
    connect GmMsg1F5BusHiSpd.ShiftLvrInRvs -> GmOvrlStMgr.ShiftLvrRvs
    connect GmMsg214BusHiSpd.RdntVehStabyEnhmtActv -> GmMsg1E9BusHiSpd.RdntVehStabyEnhmtActv
    connect GmMsg214BusHiSpd.AbsProtd -> GmOvrlStMgr.AbsActvProtd
    connect GmMsg214BusHiSpd.VehStabyEnhmtInvld -> GmOvrlStMgr.Msg214BusHiSpdInvld
    connect GmMsg214BusHiSpd.MissMsg214 -> GmOvrlStMgr.Msg214BusHiSpdMiss
    connect GmMsg232BusHiSpd.DesRtIdx -> CustDiagc.DesRtIdx
    connect GmMsg232BusHiSpd.DesRtIdx -> TunSelnMngt.DesRtIdx
    connect GmMsg335BusChassisExp.DrvrSteerIntvDetd -> SerlComOutpProxy.DrvrSteerIntvDetd
    connect GmMsg335BusChassisExp.DrvrSteerIntvDetdProtnVal -> SerlComOutpProxy.DrvrSteerIntvDetdProtnVal
    connect GmMsg335BusChassisExp.DrvrSteerIntvDetdRollgCntr -> SerlComOutpProxy.DrvrSteerIntvDetdRollgCntr
    connect GmMsg335BusChassisExp.DrvrSteerIntvDetdVld -> SerlComOutpProxy.DrvrSteerIntvDetdVld
    connect GmMsg335BusChassisExp.ElecPowerSteerAvlSts -> SerlComOutpProxy.ElecPowerSteerAvlSts
    connect GmMsg335BusChassisExp.ElecPowerSteerAvlStsProtnVal -> SerlComOutpProxy.ElecPowerSteerAvlStsProtnVal
    connect GmMsg335BusChassisExp.ElecPowerSteerAvlStsRollgCntr -> SerlComOutpProxy.ElecPowerSteerAvlStsRollgCntr
    connect GmMsg335BusChassisExp.Msg335TxCallBack -> SerlComOutpProxy.Msg335TxCallBack
    connect GmMsg337BusChassisExp.SteerWhlAgReqTarAg -> CustDiagc.SteerWhlAgReqTarAg
    connect GmMsg337BusChassisExp.ApaReqActv -> GmFctDiArbn.ApaEna
    connect GmMsg337BusChassisExp.SteerWhlAgReqTarAg -> GmOvrlStMgr.HwAgTar
    connect GmMsg337BusChassisExp.FbReqActv -> GmOvrlStMgr.HwHaptcEna
    connect GmMsg337BusChassisExp.InvldMsg337 -> GmOvrlStMgr.Msg337BusChassisExpInvld
    connect GmMsg337BusChassisExp.MissMsg337 -> GmOvrlStMgr.Msg337BusChassisExpMiss
    connect GmMsg348BusChassisExp.WhlGndVelLeDrvnBusChassisExp -> GmVehSpdArbn.WhlGndVelLeDrvnBusChassisExp
    connect GmMsg348BusChassisExp.WhlGndVelLeDrvnStuckBusChassisExp -> GmVehSpdArbn.WhlGndVelLeDrvnStuckBusChassisExp
    connect GmMsg348BusChassisExp.WhlGndVelLeDrvnVldBusChassisExp -> GmVehSpdArbn.WhlGndVelLeDrvnVldBusChassisExp
    connect GmMsg348BusChassisExp.WhlGndVelRiDrvnBusChassisExp -> GmVehSpdArbn.WhlGndVelRiDrvnBusChassisExp
    connect GmMsg348BusChassisExp.WhlGndVelRiDrvnStuckBusChassisExp -> GmVehSpdArbn.WhlGndVelRiDrvnStuckBusChassisExp
    connect GmMsg348BusChassisExp.WhlGndVelRiDrvnVldBusChassisExp -> GmVehSpdArbn.WhlGndVelRiDrvnVldBusChassisExp
    connect GmMsg348BusHiSpd.WhlGndVelLeDrvnBusHiSpd -> GmVehSpdArbn.WhlGndVelLeDrvnBusHiSpd
    connect GmMsg348BusHiSpd.WhlGndVelLeDrvnStuckBusHiSpd -> GmVehSpdArbn.WhlGndVelLeDrvnStuckBusHiSpd
    connect GmMsg348BusHiSpd.WhlGndVelLeDrvnVldBusHiSpd -> GmVehSpdArbn.WhlGndVelLeDrvnVldBusHiSpd
    connect GmMsg348BusHiSpd.WhlGndVelRiDrvnBusHiSpd -> GmVehSpdArbn.WhlGndVelRiDrvnBusHiSpd
    connect GmMsg348BusHiSpd.WhlGndVelRiDrvnStuckBusHiSpd -> GmVehSpdArbn.WhlGndVelRiDrvnStuckBusHiSpd
    connect GmMsg348BusHiSpd.WhlGndVelRiDrvnVldBusHiSpd -> GmVehSpdArbn.WhlGndVelRiDrvnVldBusHiSpd
    connect GmMsg34ABusChassisExp.WhlGndVelLeNonDrvnBusChassisExp -> GmVehSpdArbn.WhlGndVelLeNonDrvnBusChassisExp
    connect GmMsg34ABusChassisExp.WhlGndVelLeNonDrvnStuckBusChassisExp -> GmVehSpdArbn.WhlGndVelLeNonDrvnStuckBusChassisExp
    connect GmMsg34ABusChassisExp.WhlGndVelLeNonDrvnVldBusChassisExp -> GmVehSpdArbn.WhlGndVelLeNonDrvnVldBusChassisExp
    connect GmMsg34ABusChassisExp.WhlGndVelRiNonDrvnBusChassisExp -> GmVehSpdArbn.WhlGndVelRiNonDrvnBusChassisExp
    connect GmMsg34ABusChassisExp.WhlGndVelRiNonDrvnStuckBusChassisExp -> GmVehSpdArbn.WhlGndVelRiNonDrvnStuckBusChassisExp
    connect GmMsg34ABusChassisExp.WhlGndVelRiNonDrvnVldBusChassisExp -> GmVehSpdArbn.WhlGndVelRiNonDrvnVldBusChassisExp
    connect GmMsg34ABusHiSpd.WhlGndVelLeNonDrvnBusHiSpd -> GmVehSpdArbn.WhlGndVelLeNonDrvnBusHiSpd
    connect GmMsg34ABusHiSpd.WhlGndVelLeNonDrvnStuckBusHiSpd -> GmVehSpdArbn.WhlGndVelLeNonDrvnStuckBusHiSpd
    connect GmMsg34ABusHiSpd.WhlGndVelLeNonDrvnVldBusHiSpd -> GmVehSpdArbn.WhlGndVelLeNonDrvnVldBusHiSpd
    connect GmMsg34ABusHiSpd.WhlGndVelRiNonDrvnBusHiSpd -> GmVehSpdArbn.WhlGndVelRiNonDrvnBusHiSpd
    connect GmMsg34ABusHiSpd.WhlGndVelRiNonDrvnStuckBusHiSpd -> GmVehSpdArbn.WhlGndVelRiNonDrvnStuckBusHiSpd
    connect GmMsg34ABusHiSpd.WhlGndVelRiNonDrvnVldBusHiSpd -> GmVehSpdArbn.WhlGndVelRiNonDrvnVldBusHiSpd
    connect GmMsg3F1BusHiSpd.AmbT -> TEstimn.AmbT
    connect GmMsg4D1BusHiSpd.EngOilT -> TEstimn.EngOilT
    connect GmMsg500BusHiSpd.WhlPlsPerRev -> GmRoadWhlInQlfr.WhlPlsPerRev
    connect GmMsg500BusHiSpd.WhlRotlStsTiStampResl -> GmRoadWhlInQlfr.WhlRotlStsTiStampResl
    connect GmMsg778BusHiSpd.ClrTrigStsAry -> CustDiagc.ClrTrigStsAry
    connect GmMsg778BusHiSpd.CodSupported -> SerlComOutpProxy.CodSupported
    connect GmMsg778BusHiSpd.CurrSts -> SerlComOutpProxy.CurrSts
    connect GmMsg778BusHiSpd.DtcFailrTyp -> SerlComOutpProxy.DtcFailrTyp
    connect GmMsg778BusHiSpd.DtcFltTyp -> SerlComOutpProxy.DtcFltTyp
    connect GmMsg778BusHiSpd.DtcNr -> SerlComOutpProxy.DtcNr
    connect GmMsg778BusHiSpd.DtcSrc -> SerlComOutpProxy.DtcSrc
    connect GmMsg778BusHiSpd.DtcTrig -> SerlComOutpProxy.DtcTrig
    connect GmMsg778BusHiSpd.HistSts -> SerlComOutpProxy.HistSts
    connect GmMsg778BusHiSpd.TstFaildCodClrdSts -> SerlComOutpProxy.TstFaildCodClrdSts
    connect GmMsg778BusHiSpd.TstFaildPwrUpSts -> SerlComOutpProxy.TstFaildPwrUpSts
    connect GmMsg778BusHiSpd.TstNotPassdCodClrdSts -> SerlComOutpProxy.TstNotPassdCodClrdSts
    connect GmMsg778BusHiSpd.TstNotPassdPwrUpSts -> SerlComOutpProxy.TstNotPassdPwrUpSts
    connect GmMsg778BusHiSpd.WarnIndcrReqdSts -> SerlComOutpProxy.WarnIndcrReqdSts
    connect GmOvrlStMgr.ApaSt -> CustDiagc.ApaSt
    connect GmOvrlStMgr.LkaSt -> CustDiagc.LkaSt
    connect GmOvrlStMgr.LkaSt -> GmMsg184BusHiSpd.LkaSt
    connect GmOvrlStMgr.EscSt -> GmMsg1CABusChassisExp.EscSt
    connect GmOvrlStMgr.ApaDrvrIntvDetd -> GmMsg335BusChassisExp.ApaDrvrIntvDetd
    connect GmOvrlStMgr.ApaSt -> GmMsg335BusChassisExp.ApaSt
    connect GmOvrlStMgr.EscSt -> GmTqArbn.EscSt
    connect GmOvrlStMgr.HwAgServoEna -> GmTqArbn.HwAgServoEna
    connect GmOvrlStMgr.HwOscnEna -> GmTqArbn.HwOscnEna
    connect GmOvrlStMgr.LkaSt -> GmTqArbn.LkaSt
    connect GmOvrlStMgr.HwAgServoCmd -> HwAgTrakgServo.HwAgTrakgServoCmd
    connect GmOvrlStMgr.HwAgServoEna -> HwAgTrakgServo.HwAgTrakgServoEna
    connect GmOvrlStMgr.GetGmLoaIgnCntr -> ProgMfgSrv.GetGmLoaIgnCntr
    connect GmOvrlStMgr.SetGmLoaIgnCntr -> ProgMfgSrv.SetGmLoaIgnCntr
    connect GmOvrlStMgr.HwOscnEna -> TqOscn.HwOscnEna
    connect GmOvrlStMgr.HwOscnFrq -> TqOscn.HwOscnFrq
    connect GmOvrlStMgr.HwOscnMotAmp -> TqOscn.HwOscnMotAmp
    connect GmRoadWhlInQlfr.WhlFrqVld -> HwAgSnsrls.WhlFrqVld
    connect GmRoadWhlInQlfr.WhlLeFrq -> HwAgSnsrls.WhlLeFrq
    connect GmRoadWhlInQlfr.WhlRiFrq -> HwAgSnsrls.WhlRiFrq
    connect GmRoadWhlInQlfr.WhlFrqVld -> WhlImbRejctn.WhlFrqVld
    connect GmRoadWhlInQlfr.WhlLeFrq -> WhlImbRejctn.WhlLeFrq
    connect GmRoadWhlInQlfr.WhlRiFrq -> WhlImbRejctn.WhlRiFrq
    connect GmStrtStop.VehStrtStopSt -> CustDiagc.StrtStopSt
    connect GmStrtStop.VehStrtStopMotTqCmdSca -> StOutpCtrl.VehStrtStopMotTqCmdSca
    connect GmStrtStop.VehStrtStopRampRate -> StOutpCtrl.VehStrtStopRampRate
    connect GmTqArbn.AssiCmdBasSca -> Assi.AssiCmdBasSca
    connect GmTqArbn.HwTqOvrl -> Assi.HwTqOvrl
    connect GmTqArbn.HwTqOvrl -> AssiPahFwl.HwTqOvrl
    connect GmTqArbn.MotTqCmdOvrl -> AssiSumLim.MotTqCmdOvrl
    connect GmTqArbn.DampgCmdSca -> Dampg.DampgCmdSca
    connect GmTqArbn.LkaTqCmdCdnd -> GmMsg184BusHiSpd.LkaTqDlvd
    connect GmTqArbn.EscCmdArbd -> GmMsg1CABusChassisExp.EscTqDlvd
    connect GmTqArbn.EscLimdActv -> GmOvrlStMgr.EscLimdActv
    connect GmTqArbn.LkaTqCmdCdnd -> GmOvrlStMgr.LkaTqCmdCdnd
    connect GmTqArbn.HwTqOvrl -> HysCmp.HwTqOvrl
    connect GmTqArbn.PullCmpCustLrngDi -> PullCmpActv.PullCmpCustLrngDi
    connect GmTqArbn.RtnCmdSca -> Rtn.RtnCmdSca
    connect GmTqArbn.AssiCmdBasSca -> StabyCmp.AssiCmdBasSca
    connect GmVehPwrMod.VehPwrModDftVehSpdEna -> GmVehSpdArbn.VehPwrModDftVehSpdEna
    connect GmVehPwrMod.SysOperMotTqCmdSca -> StOutpCtrl.SysOperMotTqCmdSca
    connect GmVehPwrMod.SysOperRampRate -> StOutpCtrl.SysOperRampRate
    connect GmVehPwrMod.PwrSplyEnaReq -> SysStMod.PwrSplyEnaReq
    connect GmVehPwrMod.SysStReqEna -> SysStMod.SysStReqEna
    connect GmVehSpdArbn.VehSpdMaxSecur -> GmOvrlStMgr.VehSpdSecurMax
    connect GmVehSpdArbn.VehSpdMaxSecurVld -> GmOvrlStMgr.VehSpdSecurMaxVld
    connect GmVehSpdArbn.VehSpdMinSecur -> GmOvrlStMgr.VehSpdSecurMin
    connect GmVehSpdArbn.VehSpdMinSecurVld -> GmOvrlStMgr.VehSpdSecurMinVld
    connect GmVehSpdArbn.VehSpdMaxSecur -> GmTqArbn.VehSpdMaxSecur
    connect GmVehSpdArbn.VehSpdArbd -> GmVehPwrMod.VehSpdArbd
    connect GmVehSpdArbn.VehSpdSnsrVld -> GmVehPwrMod.VehSpdSnsrVld
    connect GmVehSpdArbn.VehSpdArbd -> VehSigCdng.VehSpdSerlCom
    connect GmVehSpdArbn.VehSpdArbdVld -> VehSigCdng.VehSpdVldSerlCom
    connect HiLoadStallLimr.StallMotTqLim -> LimrCdng.StallMotTqLim
    connect HowDetn.HowDetnFlg -> GmMsg184BusHiSpd.HowDetnFlg
    connect HwAg0Meas.HwAg0MeasHwAg0AutTrim -> CmnMfgSrv.HwAg0MeasHwAg0AutoTrim
    connect HwAg0Meas.HwAg0MeasHwAg0ClrTrim -> CmnMfgSrv.HwAg0MeasHwAg0ClrTrim
    connect HwAg0Meas.HwAg0MeasHwAg0ReadTrim -> CmnMfgSrv.HwAg0MeasHwAg0ReadTrim
    connect HwAg0Meas.HwAg0MeasHwAg0TrimPrfmdSts -> CmnMfgSrv.HwAg0MeasHwAg0TrimPrfmdSts
    connect HwAg0Meas.HwAg0MeasHwAg0WrTrim -> CmnMfgSrv.HwAg0MeasHwAg0WrTrim
    connect HwAg0Meas.HwAg0 -> HwAgArbn.HwAgA
    connect HwAg0Meas.HwAg0Qlfr -> HwAgArbn.HwAgAQlfr
    connect HwAg0Meas.HwAg0RollgCntr -> HwAgArbn.HwAgARollgCntr
    connect HwAg0Meas.HwAg0 -> HwAgCorrln.HwAgA
    connect HwAg0Meas.HwAg0Qlfr -> HwAgCorrln.HwAgAQlfr
    connect HwAg0Meas.HwAg0RollgCntr -> HwAgCorrln.HwAgARollgCntr
    connect HwAg1Meas.HwAg1MeasHwAg1AutTrim -> CmnMfgSrv.HwAg1MeasHwAg1AutoTrim
    connect HwAg1Meas.HwAg1MeasHwAg1ClrTrim -> CmnMfgSrv.HwAg1MeasHwAg1ClrTrim
    connect HwAg1Meas.HwAg1MeasHwAg1ReadTrim -> CmnMfgSrv.HwAg1MeasHwAg1ReadTrim
    connect HwAg1Meas.HwAg1MeasHwAg1TrimPrfmdSts -> CmnMfgSrv.HwAg1MeasHwAg1TrimPrfmdSts
    connect HwAg1Meas.HwAg1MeasHwAg1WrTrim -> CmnMfgSrv.HwAg1MeasHwAg1WrTrim
    connect HwAg1Meas.HwAg1 -> HwAgArbn.HwAgB
    connect HwAg1Meas.HwAg1Qlfr -> HwAgArbn.HwAgBQlfr
    connect HwAg1Meas.HwAg1RollgCntr -> HwAgArbn.HwAgBRollgCntr
    connect HwAg1Meas.HwAg1 -> HwAgCorrln.HwAgB
    connect HwAg1Meas.HwAg1RollgCntr -> HwAgCorrln.HwAgBARollgCntr
    connect HwAg1Meas.HwAg1Qlfr -> HwAgCorrln.HwAgBQlfr
    connect HwAgArbn.HwAg -> HwAgSysArbn.HwAg
    connect HwAgArbn.HwAg -> HwAgVehCentrTrim.HwAg
    connect HwAgCorrln.HwAgCorrlnSt -> HwAgArbn.HwAgCorrlnSt
    connect HwAgCorrln.HwAgIdptSig -> HwAgSysArbn.HwAgIdptSig
    connect HwAgSnsrls.FSnsrlsHwCentr -> CmnMfgSrv.FSnsrlsHwCentr
    connect HwAgSnsrls.RstSnsrlsHwCentr -> CmnMfgSrv.RstSnsrlsHwCentr
    connect HwAgSnsrls.HwAgSnsrls -> HwAgSysArbn.HwAgSnsrls
    connect HwAgSnsrls.HwAgSnsrlsConf -> HwAgSysArbn.HwAgSnsrlsConf
    connect HwAgSysArbn.PinionAg -> CustDiagc.PinionAg
    connect HwAgSysArbn.PinionAgConf -> CustDiagc.PinionAgConf
    connect HwAgSysArbn.HwAgNotCorrd -> EotLrng.HwAg
    connect HwAgSysArbn.PinionAgConf -> EotLrng.HwAgAuthy
    connect HwAgSysArbn.HwAgNotCorrd -> EotProtn.HwAg
    connect HwAgSysArbn.PinionAgConf -> EotProtn.HwAgAuthy
    connect HwAgSysArbn.HwAgNotCorrd -> EotProtnFwl.HwAg
    connect HwAgSysArbn.PinionAgConf -> EotProtnFwl.PinionAgConf
    connect HwAgSysArbn.HwVel -> FltInj.HwVel
    connect HwAgSysArbn.PinionAg -> GmFctDiArbn.HwAg
    connect HwAgSysArbn.HwAgToSerlCom -> GmMsg1E5BusChassisExp.HwAg
    connect HwAgSysArbn.HwAgVldToSerlCom -> GmMsg1E5BusChassisExp.HwAgVldToSerlCom
    connect HwAgSysArbn.HwVelToSerlCom -> GmMsg1E5BusChassisExp.HwVel
    connect HwAgSysArbn.HwAgToSerlCom -> GmMsg1E5BusHiSpd.HwAg
    connect HwAgSysArbn.HwAgVldToSerlCom -> GmMsg1E5BusHiSpd.HwAgVldToSerlCom
    connect HwAgSysArbn.HwVelToSerlCom -> GmMsg1E5BusHiSpd.HwVel
    connect HwAgSysArbn.HwVel -> GmStrtStop.HwVel
    connect HwAgSysArbn.PinionAg -> HwAgSnsrls.PinionAg
    connect HwAgSysArbn.PinionAgConf -> HwAgSnsrls.PinionAgConf
    connect HwAgSysArbn.PinionAg -> HwAgTrajGenn.HwAg
    connect HwAgSysArbn.PinionAg -> HwAgTrakgServo.HwAg
    connect HwAgSysArbn.PinionAg -> MotTqTranlDampg.HwAg
    connect HwAgSysArbn.PinionAg -> PullCmpActv.HwAg
    connect HwAgSysArbn.HwVel -> PullCmpActv.HwVel
    connect HwAgSysArbn.PinionAgConf -> PullCmpActv.PinionAgConf
    connect HwAgSysArbn.PinionAg -> Rtn.HwAg
    connect HwAgSysArbn.PinionAgConf -> Rtn.HwAgAuthySca
    connect HwAgSysArbn.HwVel -> Rtn.HwVel
    connect HwAgSysArbn.PinionAg -> RtnPahFwl.HwAg
    connect HwAgSysArbn.PinionAgConf -> SnsrOffsLrng.HwAgAuthy
    connect HwAgSysArbn.HwVel -> SnsrOffsLrng.HwVel
    connect HwAgSysArbn.PinionAg -> StHlthSigNormn.HwAg
    connect HwAgSysArbn.PinionAgConf -> StHlthSigNormn.HwAuthy
    connect HwAgSysArbn.PinionAg -> SysFricLrng.HwAg
    connect HwAgSysArbn.PinionAgConf -> SysFricLrng.HwAgAuthy
    connect HwAgSysArbn.HwVel -> SysFricLrng.HwVel
    connect HwAgSysArbn.HwVel -> TEstimn.HwVel
    connect HwAgSysArbn.PinionAg -> TqLoa.PinionAg
    connect HwAgSysArbn.PinionAgConf -> TqLoa.PinionAgConf
    connect HwAgSysArbn.HwVel -> TunSelnAuthy.HwVel
    connect HwAgSysArbn.HwAgFinal -> VehSpdLimr.HwAg
    connect HwAgSysArbn.PinionAgConf -> VehSpdLimr.HwAgAuthy
    connect HwAgTrajGenn.HwAgTrakgServoCmd -> GmOvrlStMgr.HwAgTraj
    connect HwAgTrakgServo.MotTqServoCmd -> GmTqArbn.MotTqServoCmd
    connect HwAgVehCentrTrim.ClrHwAgTrimVal -> CmnMfgSrv.ClrHwAgTrimVal
    connect HwAgVehCentrTrim.GetHwAgTrimVal -> CmnMfgSrv.GetHwAgTrimVal
    connect HwAgVehCentrTrim.SetHwAgTrimVal -> CmnMfgSrv.SetHwAgTrimVal
    connect HwAgVehCentrTrim.UpdHwAgTrimVal -> CmnMfgSrv.UpdHwAgTrimVal
    connect HwAgVehCentrTrim.ClrHwAgTrimVal -> CustDiagc.ClrHwAgTrimVal
    connect HwAgVehCentrTrim.HwAgTrimPrfmd -> CustDiagc.HwAgTrimPrfmd
    connect HwAgVehCentrTrim.UpdHwAgTrimVal -> CustDiagc.UpdHwAgTrimVal
    connect HwAgVehCentrTrim.HwAgTrimPrfmd -> GmMsg1E5BusChassisExp.HwAgTrimPrfmd
    connect HwAgVehCentrTrim.HwAgTrimPrfmd -> GmMsg1E5BusHiSpd.HwAgTrimPrfmd
    connect HwAgVehCentrTrim.HwAgVehTrimOffs -> SnsrOffsCorrn.HwAg
    connect HwAgVehCentrTrim.HwAgVehTrimOffs -> SnsrOffsLrng.HwAg
    connect HwTqArbn.HwTq -> HwAgSysArbn.HwTq
    connect HwTqArbn.HwTqChA -> HwTqCorrln.HwTqChA
    connect HwTqArbn.HwTqChB -> HwTqCorrln.HwTqChB
    connect HwTqArbn.HwTq -> SnsrOffsCorrn.HwTq
    connect HwTqArbn.HwTq -> SnsrOffsLrng.HwTq
    connect HwTqCorrln.HwTqIdptSig -> CustDiagc.HwTqIdptSig
    connect HwTqCorrln.HwTqIdptSig -> GmMsg184BusHiSpd.HwTqIdptSig
    connect HwTqCorrln.HwTqIdptSig -> GmMsg335BusChassisExp.HwTqIdptSig
    connect HwTqCorrln.HwTqCorrlnSts -> HwTqArbn.HwTqCorrlnSts
    connect HwTqCorrln.HwTqIdptSig -> LoaMgr.HwTqIdptSig
    connect HwTqCorrln.HwTqChACorrlnTraErr -> StHlthSigNormn.HwTqChACorrlnTraErr
    connect HwTqCorrln.HwTqChBCorrlnTraErr -> StHlthSigNormn.HwTqChBCorrlnTraErr
    connect HwTqCorrln.HwTqIdptSig -> StHlthSigNormn.HwTqIdptSig
    connect HysCmp.HysCmpCmd -> AssiPahFwl.HysCmpCmd
    connect InertiaCmpVel.InertiaCmpVelCmd -> DampgPahFwl.InertiaCmpVelCmd
    connect IoHwAb.SetFctPrphlHwTq{0..3} -> CDD_HwTq{0..3}Meas.IoHwAb_SetFctPrphlHwTq{0..3}
    connect IoHwAb.SetFctGpioPhaALowrCmd -> CDD_TSG31CfgAndUse.IoHwAb_SetFctGpioPhaALowrCmd
    connect IoHwAb.SetFctGpioPhaAUpprCmd -> CDD_TSG31CfgAndUse.IoHwAb_SetFctGpioPhaAUpprCmd
    connect IoHwAb.SetFctGpioPhaBLowrCmd -> CDD_TSG31CfgAndUse.IoHwAb_SetFctGpioPhaBLowrCmd
    connect IoHwAb.SetFctGpioPhaBUpprCmd -> CDD_TSG31CfgAndUse.IoHwAb_SetFctGpioPhaBUpprCmd
    connect IoHwAb.SetFctGpioPhaCLowrCmd -> CDD_TSG31CfgAndUse.IoHwAb_SetFctGpioPhaCLowrCmd
    connect IoHwAb.SetFctGpioPhaCUpprCmd -> CDD_TSG31CfgAndUse.IoHwAb_SetFctGpioPhaCUpprCmd
    connect IoHwAb.SetFctPeriphPhaALowrCmd -> CDD_TSG31CfgAndUse.IoHwAb_SetFctPeriphPhaALowrCmd
    connect IoHwAb.SetFctPeriphPhaAUpprCmd -> CDD_TSG31CfgAndUse.IoHwAb_SetFctPeriphPhaAUpprCmd
    connect IoHwAb.SetFctPeriphPhaBLowrCmd -> CDD_TSG31CfgAndUse.IoHwAb_SetFctPeriphPhaBLowrCmd
    connect IoHwAb.SetFctPeriphPhaBUpprCmd -> CDD_TSG31CfgAndUse.IoHwAb_SetFctPeriphPhaBUpprCmd
    connect IoHwAb.SetFctPeriphPhaCLowrCmd -> CDD_TSG31CfgAndUse.IoHwAb_SetFctPeriphPhaCLowrCmd
    connect IoHwAb.SetFctPeriphPhaCUpprCmd -> CDD_TSG31CfgAndUse.IoHwAb_SetFctPeriphPhaCUpprCmd
    connect IoHwAb.SetGpioPhaALowrCmd -> CDD_TSG31CfgAndUse.IoHwAb_SetGpioPhaALowrCmd
    connect IoHwAb.SetGpioPhaAUpprCmd -> CDD_TSG31CfgAndUse.IoHwAb_SetGpioPhaAUpprCmd
    connect IoHwAb.SetGpioPhaBLowrCmd -> CDD_TSG31CfgAndUse.IoHwAb_SetGpioPhaBLowrCmd
    connect IoHwAb.SetGpioPhaBUpprCmd -> CDD_TSG31CfgAndUse.IoHwAb_SetGpioPhaBUpprCmd
    connect IoHwAb.SetGpioPhaCLowrCmd -> CDD_TSG31CfgAndUse.IoHwAb_SetGpioPhaCLowrCmd
    connect IoHwAb.SetGpioPhaCUpprCmd -> CDD_TSG31CfgAndUse.IoHwAb_SetGpioPhaCUpprCmd
    connect IoHwAb.GetGpioMcuEna -> CustDiagc.GetGpioMcuEna
    connect IoHwAb.GetGpioMotDrvr0Diag -> GateDrv0Ctrl.IoHwAb_GetGpioMotDrvr0Diag
    connect IoHwAb.SetGpioGateDrv0Rst -> GateDrv0Ctrl.IoHwAb_SetGpioGateDrv0Rst
    connect IoHwAb.SetGpioSysFlt2A -> GateDrv0Ctrl.IoHwAb_SetGpioSysFlt2A
    connect IoHwAb.GetGpioMotDrvr1Diag -> GateDrv1Ctrl.IoHwAb_GetGpioMotDrvr1Diag
    connect IoHwAb.SetGpioGateDrv1Rst -> GateDrv1Ctrl.IoHwAb_SetGpioGateDrv1Rst
    connect IoHwAb.SetGpioSysFlt2B -> GateDrv1Ctrl.IoHwAb_SetGpioSysFlt2B
    connect IoHwAb.GetGpioMcuEna -> GmVehPwrMod.GetGpioMcuEna
    connect IoHwAb.GetGpioMcuEna -> GmVehPwrMod.IoHwAb_GetGpioMcuEna
    connect IoHwAb.SetFctPrphlHwAg0 -> HwAg0Meas.IoHwAb_SetFctPrphlHwAg0
    connect IoHwAb.SetFctPrphlHwAg1 -> HwAg1Meas.IoHwAb_SetFctPrphlHwAg1
    connect IoHwAb.SetGpioPwrTurnOffCtrl -> PwrUpSeq.IoHwAb_SetGpioPwrTurnOffCtrl
    connect IoHwAb.GetGpioPwrOutpEnaFb -> TmplMonr.IoHwAb_GetGpioPwrOutpEnaFb
    connect IoHwAb.SetGpioSysFlt2A -> TmplMonr.IoHwAb_SetGpioSysFlt2A
    connect IoHwAb.SetGpioSysFlt2B -> TmplMonr.IoHwAb_SetGpioSysFlt2B
    connect IoHwAb.SetGpioTmplMonrWdg -> TmplMonr.IoHwAb_SetGpioTmplMonrWdg
    connect LimrCdng.EotAssiScaCdnd -> AssiSumLim.EotAssiSca
    connect LimrCdng.EotMotTqLimCdnd -> AssiSumLim.EotMotTqLim
    connect LimrCdng.StallMotTqLimCdnd -> AssiSumLim.StallMotTqLim
    connect LimrCdng.SysMotTqCmdScaCdnd -> AssiSumLim.SysMotTqCmdSca
    connect LimrCdng.ThermMotTqLimCdnd -> AssiSumLim.ThermMotTqLim
    connect LimrCdng.VehSpdMotTqLimCdnd -> AssiSumLim.VehSpdMotTqLim
    connect LoaMgr.HwTqLoaMtgtnEna -> AssiSumLim.HwTqLoaMtgtnEna
    connect LoaMgr.CurrMeasLoaMtgtnEna -> CDD_MotCtrlMgr.CurrMeasLoaMtgtnEna
    connect LoaMgr.IvtrLoaMtgtnEna -> CDD_MotCtrlMgr.IvtrLoaMtgtnEna
    connect LoaMgr.LoaSt -> GmFctDiArbn.LoaSt
    connect LoaMgr.LoaSt -> GmOvrlStMgr.LoaSt
    connect LoaMgr.IvtrLoaMtgtnEna -> MotCtrlPrmEstimn.IvtrLoaMtgtnEna
    connect LoaMgr.CurrMeasLoaMtgtnEna -> MotCurrPeakEstimn.CurrMeasLoaMtgtnEna
    connect LoaMgr.CurrMeasLoaMtgtnEna -> MotCurrRegCfg.CurrMeasLoaMtgtnEna
    connect LoaMgr.IvtrLoaMtgtnEna -> MotCurrRegCfg.IvtrLoaMtgtnEna
    connect LoaMgr.CurrMeasLoaMtgtnEna -> MotRefMdl.CurrMeasLoaMtgtnEna
    connect LoaMgr.IvtrLoaMtgtnEna -> MotRefMdl.IvtrLoaMtgtnEna
    connect LoaMgr.LoaSt -> MotTqTranlDampg.LoaSt
    connect LoaMgr.IvtrLoaMtgtnEna -> PwrLimr.IvtrLoaMtgtnEna
    connect LoaMgr.LoaRateLim -> StOutpCtrl.LoaRateLim
    connect LoaMgr.LoaSca -> StOutpCtrl.LoaSca
    connect LoaMgr.MotAgLoaMtgtnEna -> TqLoa.MotAgLoaMtgtnEna
    connect MotAg2Meas.MotAg2MeasEolPrmRead -> CmnMfgSrv.MotAgMeasEolPrmRead
    connect MotAg2Meas.MotAg2MeasEolPrmWr -> CmnMfgSrv.MotAgMeasEolPrmWr
    connect MotAg2Meas.MotAg2Mecl -> MotAgCorrln.MotAgCMecl
    connect MotAg2Meas.MotAg2MeclQlfr -> MotAgCorrln.MotAgCMeclQlfr
    connect MotAg2Meas.MotAg2MeclRollgCntr -> MotAgCorrln.MotAgCMeclRollgCntr
    connect MotAg2Meas.MotAg2VltgSqd -> StHlthSigNormn.MotAg2VltgSqd
    connect MotAgCorrln.MotAgMeclCorrlnSt -> CDD_MotCtrlMgr.MotAgMeclCorrlnSt
    connect MotAgCorrln.MotAgMeclIdptSig -> CDD_MotVel.MotAgMeclIdptSig
    connect MotAgCorrln.MotAgMeclIdptSig -> LoaMgr.MotAgMeclIdptSig
    connect MotAgCorrln.MotAgABErrTerm -> StHlthSigNormn.MotAgABErrTerm
    connect MotAgCorrln.MotAgACErrTerm -> StHlthSigNormn.MotAgACErrTerm
    connect MotAgCorrln.MotAgBCErrTerm -> StHlthSigNormn.MotAgBCErrTerm
    connect MotCtrlPrmEstimn.MotREstimd -> CDD_MotCtrlMgr.MotREstimd
    connect MotCtrlPrmEstimn.GetMotPrmNomEol -> CmnMfgSrv.GetMotPrmNomEol
    connect MotCtrlPrmEstimn.SetMotPrmNomEol -> CmnMfgSrv.SetMotPrmNomEol
    connect MotCtrlPrmEstimn.MotInduDaxEstimd -> MotCurrRegCfg.MotInduDaxEstimd
    connect MotCtrlPrmEstimn.MotInduQaxEstimd -> MotCurrRegCfg.MotInduQaxEstimd
    connect MotCtrlPrmEstimn.MotREstimd -> MotCurrRegCfg.MotREstimd
    connect MotCtrlPrmEstimn.MotBackEmfConEstimd -> MotRefMdl.MotBackEmfConEstimd
    connect MotCtrlPrmEstimn.MotInduDaxEstimd -> MotRefMdl.MotInduDaxEstimd
    connect MotCtrlPrmEstimn.MotInduQaxEstimd -> MotRefMdl.MotInduQaxEstimd
    connect MotCtrlPrmEstimn.MotREstimd -> MotRefMdl.MotREstimd
    connect MotCtrlPrmEstimn.MotBackEmfConEstimd -> MotRplCoggCfg.MotBackEmfConEstimd
    connect MotCtrlPrmEstimn.MotInduDaxEstimd -> MotRplCoggCfg.MotInduDaxEstimd
    connect MotCtrlPrmEstimn.MotInduQaxEstimd -> MotRplCoggCfg.MotInduQaxEstimd
    connect MotCtrlPrmEstimn.MotBackEmfConEstimd -> PwrLimr.MotBackEmfConEstimd
    connect MotCurrPeakEstimn.MotCurrPeakEstimd -> CustDiagc.MotCurrPeakEstimd
    connect MotCurrPeakEstimn.MotCurrPeakEstimd -> DutyCycThermProtn.MotCurrPeakEstimd
    connect MotCurrPeakEstimn.MotCurrPeakEstimdFild -> DutyCycThermProtn.MotCurrPeakEstimdFild
    connect MotCurrPeakEstimn.MotCurrPeakEstimdFild -> TEstimn.MotCurrPeakEstimd
    connect MotCurrRegCfg.MotAgElecDly -> CDD_MotCtrlMgr.MotAgElecDly
    connect MotCurrRegCfg.MotDampgDax -> CDD_MotCtrlMgr.MotDampgDax
    connect MotCurrRegCfg.MotDampgQax -> CDD_MotCtrlMgr.MotDampgQax
    connect MotCurrRegCfg.MotIntglGainDax -> CDD_MotCtrlMgr.MotIntglGainDax
    connect MotCurrRegCfg.MotIntglGainQax -> CDD_MotCtrlMgr.MotIntglGainQax
    connect MotCurrRegCfg.MotPropGainDax -> CDD_MotCtrlMgr.MotPropGainDax
    connect MotCurrRegCfg.MotPropGainQax -> CDD_MotCtrlMgr.MotPropGainQax
    connect MotDrvDiagc.MotDrvErrA -> StHlthSigNormn.MotDrvErrA
    connect MotDrvDiagc.MotDrvErrB -> StHlthSigNormn.MotDrvErrB
    connect MotDrvDiagc.MotDrvErrC -> StHlthSigNormn.MotDrvErrC
    connect MotDrvDiagc.MotDrvErrD -> StHlthSigNormn.MotDrvErrD
    connect MotDrvDiagc.MotDrvErrE -> StHlthSigNormn.MotDrvErrE
    connect MotDrvDiagc.MotDrvErrF -> StHlthSigNormn.MotDrvErrF
    connect MotQuadDetn.MotQuad -> MotRefMdl.MotQuad
    connect MotRefMdl.MotCurrDaxCmd -> CDD_MotCtrlMgr.MotCurrDaxCmd
    connect MotRefMdl.MotCurrDaxMax -> CDD_MotCtrlMgr.MotCurrDaxMax
    connect MotRefMdl.MotCurrQaxCmd -> CDD_MotCtrlMgr.MotCurrQaxCmd
    connect MotRefMdl.MotReacncDax -> CDD_MotCtrlMgr.MotReacncDax
    connect MotRefMdl.MotReacncQax -> CDD_MotCtrlMgr.MotReacncQax
    connect MotRefMdl.MotVltgDaxFf -> CDD_MotCtrlMgr.MotVltgDaxFf
    connect MotRefMdl.MotVltgQaxFf -> CDD_MotCtrlMgr.MotVltgQaxFf
    connect MotRefMdl.MotCurrDaxCmd -> CustDiagc.MotCurrDaxCmd
    connect MotRefMdl.MotCurrDaxCmd -> MotCtrlPrmEstimn.MotCurrDaxCmd
    connect MotRefMdl.MotCurrQaxCmd -> MotCtrlPrmEstimn.MotCurrQaxCmd
    connect MotRefMdl.MotCurrDaxCmd -> MotCurrPeakEstimn.MotCurrDaxCmd
    connect MotRefMdl.MotCurrQaxCmd -> MotCurrPeakEstimn.MotCurrQaxCmd
    connect MotRefMdl.MotCurrDaxCmd -> MotRplCoggCfg.MotCurrDaxCmd
    connect MotRefMdl.MotCurrQaxCmd -> MotRplCoggCfg.MotCurrQaxCmd
    connect MotRplCoggCfg.MotAgElecDlyRpl -> CDD_MotCtrlMgr.MotAgElecDlyRpl
    connect MotRplCoggCfg.MotCurrQaxToMotTqGain -> CDD_MotCtrlMgr.MotCurrQaxToMotTqGain
    connect MotRplCoggCfg.MotTqRplCoggOrder1Mgn -> CDD_MotCtrlMgr.MotTqRplCoggOrder1Mgn
    connect MotRplCoggCfg.MotTqRplCoggOrder1Pha -> CDD_MotCtrlMgr.MotTqRplCoggOrder1Pha
    connect MotRplCoggCfg.MotTqRplCoggOrder2Mgn -> CDD_MotCtrlMgr.MotTqRplCoggOrder2Mgn
    connect MotRplCoggCfg.MotTqRplCoggOrder2Pha -> CDD_MotCtrlMgr.MotTqRplCoggOrder2Pha
    connect MotRplCoggCfg.MotTqRplCoggOrder3Mgn -> CDD_MotCtrlMgr.MotTqRplCoggOrder3Mgn
    connect MotRplCoggCfg.MotTqRplCoggOrder3Pha -> CDD_MotCtrlMgr.MotTqRplCoggOrder3Pha
    connect MotRplCoggCfg.GetMotRplCoggPrm -> CmnMfgSrv.GetMotRplCoggPrm
    connect MotRplCoggCfg.SetMotRplCoggPrm -> CmnMfgSrv.SetMotRplCoggPrm
    connect MotTqCmdSca.GetMotTqCmdSca -> CmnMfgSrv.GetMotTqCmdSca
    connect MotTqCmdSca.SetMotTqCmdSca -> CmnMfgSrv.SetMotTqCmdSca
    connect MotTqCmdSca.MotTqCmdMrfScad -> DiagcMgr.MotTqCmdMrfScad
    connect MotTqCmdSca.MotTqCmdMrfScad -> MotQuadDetn.MotTqCmd
    connect MotTqCmdSca.MotTqCmdMrfScad -> MotRefMdl.MotTqCmdMrfScad
    connect MotTqCmdSca.MotTqCmdMrfScad -> MotRplCoggCfg.MotTqCmdMrfScad
    connect MotTqTranlDampg.MotTqCmdCrfDampd -> CmplncErr.MotTqCmdCrf
    connect MotTqTranlDampg.MotTqCmdCrfDampd -> HwAgSnsrls.MotTqCmdCrf
    connect MotTqTranlDampg.MotTqCmdMrfDampd -> PwrLimr.MotTqCmdMrf
    connect MotTqTranlDampg.MotTqCmdCrfDampd -> SnsrOffsLrng.MotTqCmdCrf
    connect MotTqTranlDampg.MotTqTranlDampgCmpl -> StOutpCtrl.MotTqTranlDampgCmpl
    connect MotTqTranlDampg.MotTqCmdCrfDampd -> SysFricLrng.MotTqCmdCrf
    connect MotVelCtrl.GetCtrlPrm -> CmnMfgSrv.GetCtrlPrm
    connect MotVelCtrl.SetCtrlPrm -> CmnMfgSrv.SetCtrlPrm
    connect MotVelCtrl.StopCtrl -> CmnMfgSrv.StopCtrl
    connect MotVelCtrl.StrtCtrl -> CmnMfgSrv.StrtCtrl
    connect NxtrCalIds.NxtrCalIdsCalDevlpRd -> CmnMfgSrv.NxtrCalIdsCalDevlpRd
    connect NxtrCalIds.NxtrCalIdsCalRelRd -> CmnMfgSrv.NxtrCalIdsCalRelRd
    connect NxtrSwIds.NxtrSwIdsPsrInfoRd -> CmnMfgSrv.NxtrSwIdsPsrInfoRd
    connect NxtrSwIds.NxtrSwIdsSwBuildDateTiRd -> CmnMfgSrv.NxtrSwIdsSwBuildDateTiRd
    connect NxtrSwIds.NxtrSwIdsSwRelInfoRd -> CmnMfgSrv.NxtrSwIdsSwRelInfoRd
    connect NxtrSwIds.NxtrSwIdsSwRelNrRd -> CmnMfgSrv.NxtrSwIdsSwRelNrRd
    connect NxtrSwIds.NxtrSwIdsSwRelVerRd -> CmnMfgSrv.NxtrSwIdsSwRelVerRd
    connect PartNr.CustMfgEnSt -> CustDiagc.CustMfgEnaSt
    connect PartNr.PartNrBasMdlPartNrAlphaCodRd -> CustDiagc.PartNrBasMdlPartNrAlphaCodRd
    connect PartNr.PartNrBasMdlPartNrRd -> CustDiagc.PartNrBasMdlPartNrRd
    connect PartNr.PartNrCalProgdStsRd -> CustDiagc.PartNrCalProgdStsRd
    connect PartNr.PartNrCalProgdStsWr -> CustDiagc.PartNrCalProgdStsWr
    connect PartNr.PartNrCcaMfgTrakgRd -> CustDiagc.PartNrCcaMfgTrakgRd
    connect PartNr.PartNrCmpdVehPartnProdtStructRd -> CustDiagc.PartNrCmpdVehPartnProdtStructRd
    connect PartNr.PartNrCtrlPidKeyChk -> CustDiagc.PartNrCtrlPidKeyChk
    connect PartNr.PartNrCtrlPidKeyWr -> CustDiagc.PartNrCtrlPidKeyWr
    connect PartNr.PartNrCtrlPidSeedRd -> CustDiagc.PartNrCtrlPidSeedRd
    connect PartNr.PartNrCtrlPidSeedUpprByteWr -> CustDiagc.PartNrCtrlPidSeedUpprByteWr
    connect PartNr.PartNrCustMfgEnaCntrRd -> CustDiagc.PartNrCustMfgEnaCntrRd
    connect PartNr.PartNrCustMfgEnaCntrWr -> CustDiagc.PartNrCustMfgEnaCntrWr
    connect PartNr.PartNrDataUniversalNrSysIdRd -> CustDiagc.PartNrDataUniversalNrSysIdRd
    connect PartNr.PartNrEcuIdRd -> CustDiagc.PartNrEcuIdRd
    connect PartNr.PartNrEndMdlPartNrAlphaCodRd -> CustDiagc.PartNrEndMdlPartNrAlphaCodRd
    connect PartNr.PartNrEndMdlPartNrAlphaCodWr -> CustDiagc.PartNrEndMdlPartNrAlphaCodWr
    connect PartNr.PartNrEndMdlPartNrRd -> CustDiagc.PartNrEndMdlPartNrRd
    connect PartNr.PartNrEndMdlPartNrWr -> CustDiagc.PartNrEndMdlPartNrWr
    connect PartNr.PartNrLstRepairShopCodRd -> CustDiagc.PartNrLstRepairShopCodRd
    connect PartNr.PartNrNxtrMfgTrakgRd -> CustDiagc.PartNrNxtrMfgTrakgRd
    connect PartNr.PartNrNxtrMfgTrakgWr -> CustDiagc.PartNrNxtrMfgTrakgWr
    connect PartNr.PartNrProgmDateRd -> CustDiagc.PartNrProgmDateRd
    connect PartNr.PartNrProgmDateWr -> CustDiagc.PartNrProgmDateWr
    connect PartNr.PartNrProgmSessionKeyChk -> CustDiagc.PartNrProgmSessionKeyChk
    connect PartNr.PartNrProgmSessionSeedRd -> CustDiagc.PartNrProgmSessionSeedRd
    connect PartNr.PartNrRepairShopCodRd -> CustDiagc.PartNrRepairShopCodRd
    connect PartNr.PartNrRepairShopCodWr -> CustDiagc.PartNrRepairShopCodWr
    connect PartNr.PartNrSecuBypAuthnRd -> CustDiagc.PartNrSecuBypAuthnRd
    connect PartNr.PartNrSecuBypAuthnWr -> CustDiagc.PartNrSecuBypAuthnWr
    connect PartNr.PartNrSysCodVersNrRd -> CustDiagc.PartNrSysCodVersNrRd
    connect PartNr.PartNrSysCodVersNrWr -> CustDiagc.PartNrSysCodVersNrWr
    connect PartNr.PartNrSysNameRd -> CustDiagc.PartNrSysNameRd
    connect PartNr.PartNrSysNameWr -> CustDiagc.PartNrSysNameWr
    connect PartNr.PartNrVinDataRd -> CustDiagc.PartNrVinDataRd
    connect PartNr.PartNrVinDataWr -> CustDiagc.PartNrVinDataWr
    connect PartNr.PartNrBasMdlPartNrAlphaCodRd -> ProgMfgSrv.PartNrBasMdlPartNrAlphaCodRd
    connect PartNr.PartNrBasMdlPartNrAlphaCodWr -> ProgMfgSrv.PartNrBasMdlPartNrAlphaCodWr
    connect PartNr.PartNrBasMdlPartNrRd -> ProgMfgSrv.PartNrBasMdlPartNrRd
    connect PartNr.PartNrBasMdlPartNrWr -> ProgMfgSrv.PartNrBasMdlPartNrWr
    connect PartNr.PartNrCcaMfgTrakgRd -> ProgMfgSrv.PartNrCcaMfgTrakgRd
    connect PartNr.PartNrCcaMfgTrakgWr -> ProgMfgSrv.PartNrCcaMfgTrakgWr
    connect PartNr.PartNrCtrlPidSeedKeyWr -> ProgMfgSrv.PartNrCtrlPidSeedKeyWr
    connect PartNr.PartNrCustMfgEnaCntrRd -> ProgMfgSrv.PartNrCustMfgEnaCntrRd
    connect PartNr.PartNrCustMfgEnaCntrWr -> ProgMfgSrv.PartNrCustMfgEnaCntrWr
    connect PartNr.PartNrDataUniversalNrSysIdRd -> ProgMfgSrv.PartNrDataUniversalNrSysIdRd
    connect PartNr.PartNrDataUniversalNrSysIdWr -> ProgMfgSrv.PartNrDataUniversalNrSysIdWr
    connect PartNr.PartNrEcuIdRd -> ProgMfgSrv.PartNrEcuIdRd
    connect PartNr.PartNrEcuIdWr -> ProgMfgSrv.PartNrEcuIdWr
    connect PartNr.PartNrEndMdlPartNrAlphaCodRd -> ProgMfgSrv.PartNrEndMdlPartNrAlphaCodRd
    connect PartNr.PartNrEndMdlPartNrAlphaCodWr -> ProgMfgSrv.PartNrEndMdlPartNrAlphaCodWr
    connect PartNr.PartNrEndMdlPartNrRd -> ProgMfgSrv.PartNrEndMdlPartNrRd
    connect PartNr.PartNrEndMdlPartNrWr -> ProgMfgSrv.PartNrEndMdlPartNrWr
    connect PartNr.PartNrNxtrMfgTrakgRd -> ProgMfgSrv.PartNrNxtrMfgTrakgRd
    connect PartNr.PartNrNxtrMfgTrakgWr -> ProgMfgSrv.PartNrNxtrMfgTrakgWr
    connect PartNr.PartNrProgmDateRd -> ProgMfgSrv.PartNrProgmDateRd
    connect PartNr.PartNrProgmDateWr -> ProgMfgSrv.PartNrProgmDateWr
    connect PartNr.PartNrProgmSessionSeedKeyWr -> ProgMfgSrv.PartNrProgmSessionSeedKeyWr
    connect PartNr.PartNrRepairShopCodRd -> ProgMfgSrv.PartNrRepairShopCodRd
    connect PartNr.PartNrRepairShopCodWr -> ProgMfgSrv.PartNrRepairShopCodWr
    connect PartNr.PartNrSecuBypAuthnRd -> ProgMfgSrv.PartNrSecuBypAuthnRd
    connect PartNr.PartNrSecuBypAuthnWr -> ProgMfgSrv.PartNrSecuBypAuthnWr
    connect PartNr.PartNrSysCodVersNrRd -> ProgMfgSrv.PartNrSysCodVersNrRd
    connect PartNr.PartNrSysCodVersNrWr -> ProgMfgSrv.PartNrSysCodVersNrWr
    connect PartNr.PartNrSysNameRd -> ProgMfgSrv.PartNrSysNameRd
    connect PartNr.PartNrSysNameWr -> ProgMfgSrv.PartNrSysNameWr
    connect PartNr.PartNrVinDataRd -> ProgMfgSrv.PartNrVinDataRd
    connect PartNr.PartNrVinDataWr -> ProgMfgSrv.PartNrVinDataWr
    connect PolarityCfg.HwTq{0..3}Polarity -> CDD_HwTq{0..3}Meas.HwTq{0..3}Polarity
    connect PolarityCfg.AssiMechPolarity -> CDD_MotAgCmp.AssiMechPolarity
    connect PolarityCfg.MotAgMecl0Polarity -> CDD_MotCtrlMgr.MotAgMecl0Polarity
    connect PolarityCfg.MotAgMecl1Polarity -> CDD_MotCtrlMgr.MotAgMecl1Polarity
    connect PolarityCfg.MotElecMeclPolarity -> CDD_MotCtrlMgr.MotElecMeclPolarity
    connect PolarityCfg.AssiMechPolarity -> CDD_MotVel.AssiMechPolarity
    connect PolarityCfg.MotElecMeclPolarity -> CDD_SinVltgGenn.MotElecMeclPolarity
    connect PolarityCfg.PolarityCfgRead -> CmnMfgSrv.PolarityCfgRead
    connect PolarityCfg.PolarityCfgWr -> CmnMfgSrv.PolarityCfgWr
    connect PolarityCfg.HwAg0Polarity -> HwAg0Meas.HwAg0Polarity
    connect PolarityCfg.HwAg1Polarity -> HwAg1Meas.HwAg1Polarity
    connect PolarityCfg.MotAgMecl2Polarity -> MotAg2Meas.MotAgMecl2Polarity
    connect PolarityCfg.AssiMechPolarity -> MotTqTranlDampg.AssiMechPolarity
    connect PullCmpActv.PullCmpCmd -> AssiSumLim.PullCmpCmd
    connect PullCmpActv.GetPullCmpPrm -> CmnMfgSrv.GetPullCmpPrm
    connect PullCmpActv.RstPullCmp -> CmnMfgSrv.RstPullCmp
    connect PullCmpActv.SetPullCmpLongTerm -> CmnMfgSrv.SetPullCmpLongTerm
    connect PullCmpActv.SetPullCmpShoTerm -> CmnMfgSrv.SetPullCmpShoTerm
    connect PwrDiscnct.PwrDiscnctATestCmpl -> PwrUpSeq.PwrDiscnctATestCmpl
    connect PwrDiscnct.PwrDiscnctBTestCmpl -> PwrUpSeq.PwrDiscnctBTestCmpl
    connect PwrLimr.PwrLimrRednFac -> AssiSumLim.PwrLimrRednFac
    connect PwrLimr.MotTqCmdPwrLimd -> MotTqCmdSca.MotTqCmdMrf
    connect PwrUpSeq.StrtUpSt -> BattVltgCorrln.StrtUpSt
    connect PwrUpSeq.StrtUpSt -> CDD_CurrMeas.StrtUpSt
    connect PwrUpSeq.StrtUpSt -> GateDrv0Ctrl.StrtUpSt
    connect PwrUpSeq.StrtUpSt -> GateDrv1Ctrl.StrtUpSt
    connect PwrUpSeq.StrtUpSt -> PwrDiscnct.StrtUpSt
    connect PwrUpSeq.StrtUpSt -> SysStMod.StrtUpSt
    connect PwrUpSeq.SysStWrmIninCmpl -> SysStMod.SysStWrmIninCmpl
    connect PwrUpSeq.StrtUpSt -> TmplMonr.StrtUpSt
    connect Rtn.RtnCmd -> RtnPahFwl.RtnCmd
    connect RtnPahFwl.RtnCmdLimd -> AssiSumLim.RtnCmd
    connect SerlComInpProxy.SerlComInpProxyGmLanIdRd -> CustDiagc.PartNrGmLanIdRd
    connect SerlComInpProxy.LeWhlDstPlsCntrRaw -> GmMsg0C5BusHiSpd.LeWhlDstPlsCntrRaw
    connect SerlComInpProxy.LeWhlDstTiStampRaw -> GmMsg0C5BusHiSpd.LeWhlDstTiStampRaw
    connect SerlComInpProxy.LeWhlDstVldRaw -> GmMsg0C5BusHiSpd.LeWhlDstVldRaw
    connect SerlComInpProxy.LeWhlRotlStsRstRaw -> GmMsg0C5BusHiSpd.LeWhlRotlStsRstRaw
    connect SerlComInpProxy.LeWhlSeqNrRaw -> GmMsg0C5BusHiSpd.LeWhlSeqNrRaw
    connect SerlComInpProxy.LstRxnTiMsg0C5 -> GmMsg0C5BusHiSpd.LstRxnTiMsg0C5BusHiSpd
    connect SerlComInpProxy.RiWhlDstPlsCntrRaw -> GmMsg0C5BusHiSpd.RiWhlDstPlsCntrRaw
    connect SerlComInpProxy.RiWhlDstTiStampRaw -> GmMsg0C5BusHiSpd.RiWhlDstTiStampRaw
    connect SerlComInpProxy.RiWhlDstVldRaw -> GmMsg0C5BusHiSpd.RiWhlDstVldRaw
    connect SerlComInpProxy.RiWhlRotlStsRstRaw -> GmMsg0C5BusHiSpd.RiWhlRotlStsRstRaw
    connect SerlComInpProxy.RiWhlSeqNrRaw -> GmMsg0C5BusHiSpd.RiWhlSeqNrRaw
    connect SerlComInpProxy.EngRunActvRaw -> GmMsg0C9BusHiSpd.EngRunActvRaw
    connect SerlComInpProxy.EngSpdRaw -> GmMsg0C9BusHiSpd.EngSpdRaw
    connect SerlComInpProxy.EngSpdStsRaw -> GmMsg0C9BusHiSpd.EngSpdStsRaw
    connect SerlComInpProxy.LstRxnTiMsg0C9 -> GmMsg0C9BusHiSpd.LstRxnTiMsg0C9
    connect SerlComInpProxy.PtCrkActvRaw -> GmMsg0C9BusHiSpd.PtCrkActvRaw
    connect SerlComInpProxy.LstRxnTiMsg17D -> GmMsg17DBusHiSpd.LstRxnTiMsg17D
    connect SerlComInpProxy.VehStabyEnhmtStsRaw -> GmMsg17DBusHiSpd.VehStabyEnhmtStsRaw
    connect SerlComInpProxy.LstRxnTiMsg180BusChassisExp -> GmMsg180BusChassisExp.LstRxnTiMsg180BusChassisExp
    connect SerlComInpProxy.TqOvrlAlvRollgCntrRaw -> GmMsg180BusChassisExp.TqOvrlAlvRollgCntrRaw
    connect SerlComInpProxy.TqOvrlCmdChksRaw -> GmMsg180BusChassisExp.TqOvrlCmdChksRaw
    connect SerlComInpProxy.TqOvrlDeltaTqCmdActvRaw -> GmMsg180BusChassisExp.TqOvrlDeltaTqCmdActvRaw
    connect SerlComInpProxy.TqOvrlDeltaTqCmdValRaw -> GmMsg180BusChassisExp.TqOvrlDeltaTqCmdValRaw
    connect SerlComInpProxy.LkaCmdProtnValRaw -> GmMsg180BusHiSpd.LkaCmdProtnValRaw
    connect SerlComInpProxy.LkaCmdRollgCntrRaw -> GmMsg180BusHiSpd.LkaCmdRollgCntrRaw
    connect SerlComInpProxy.LkaCmdTqReqActvRaw -> GmMsg180BusHiSpd.LkaCmdTqReqActvRaw
    connect SerlComInpProxy.LkaCmdTqValRaw -> GmMsg180BusHiSpd.LkaCmdTqValRaw
    connect SerlComInpProxy.LstRxnTiMsg180BusHiSpd -> GmMsg180BusHiSpd.LstRxnTiMsg180BusHiSpd
    connect SerlComInpProxy.LstRxnTiMsg182 -> GmMsg182BusChassisExp.LstRxnTiMsg182
    connect SerlComInpProxy.VehDynOverUnderSteerVldRaw -> GmMsg182BusChassisExp.VehDynOverUnderSteerVldRaw
    connect SerlComInpProxy.VehStabyEnhmtLgtALoReslRaw -> GmMsg182BusChassisExp.VehStabyEnhmtLgtALoReslRaw
    connect SerlComInpProxy.VehStabyEnhmtLgtALoReslVldRaw -> GmMsg182BusChassisExp.VehStabyEnhmtLgtALoReslVldRaw
    connect SerlComInpProxy.AbsActvRaw -> GmMsg1E9BusHiSpd.AbsActvRaw
    connect SerlComInpProxy.AbsFaildRaw -> GmMsg1E9BusHiSpd.AbsFaildRaw
    connect SerlComInpProxy.LstRxnTiMsg1E9 -> GmMsg1E9BusHiSpd.LstRxnTiMsg1E9
    connect SerlComInpProxy.TracCtrlSysActvRaw -> GmMsg1E9BusHiSpd.TracCtrlSysActvRaw
    connect SerlComInpProxy.TracCtrlSysEnaRaw -> GmMsg1E9BusHiSpd.TracCtrlSysEnaRaw
    connect SerlComInpProxy.VehDynCtrlSysStRaw -> GmMsg1E9BusHiSpd.VehDynCtrlSysStRaw
    connect SerlComInpProxy.VehDynYawRateRaw -> GmMsg1E9BusHiSpd.VehDynYawRateRaw
    connect SerlComInpProxy.VehDynYawRateVldRaw -> GmMsg1E9BusHiSpd.VehDynYawRateVldRaw
    connect SerlComInpProxy.VehStabyEnhmtActvRaw -> GmMsg1E9BusHiSpd.VehStabyEnhmtActvRaw
    connect SerlComInpProxy.VehStabyEnhmtLatARaw -> GmMsg1E9BusHiSpd.VehStabyEnhmtLatARaw
    connect SerlComInpProxy.VehStabyEnhmtLatAVldRaw -> GmMsg1E9BusHiSpd.VehStabyEnhmtLatAVldRaw
    connect SerlComInpProxy.LstRxnTiMsg1F1 -> GmMsg1F1BusHiSpd.LstRxnTiMsg1F1
    connect SerlComInpProxy.SysBackUpPwrModEnaRaw -> GmMsg1F1BusHiSpd.SysBackUpPwrModEnaRaw
    connect SerlComInpProxy.SysBackUpPwrModRaw -> GmMsg1F1BusHiSpd.SysBackUpPwrModRaw
    connect SerlComInpProxy.SysPwrModRaw -> GmMsg1F1BusHiSpd.SysPwrModRaw
    connect SerlComInpProxy.LstRxnTiMsg1F5 -> GmMsg1F5BusHiSpd.LstRxnTiMsg1F5
    connect SerlComInpProxy.ShiftLvrPosnRaw -> GmMsg1F5BusHiSpd.ShiftLvrPosnRaw
    connect SerlComInpProxy.ShiftLvrPosnVldRaw -> GmMsg1F5BusHiSpd.ShiftLvrPosnVldRaw
    connect SerlComInpProxy.AbsActvProtdProtnValRaw -> GmMsg214BusHiSpd.AbsActvProtdProtnValRaw
    connect SerlComInpProxy.AbsActvProtdRaw -> GmMsg214BusHiSpd.AbsActvProtdRaw
    connect SerlComInpProxy.AbsActvProtdRollgCntrRaw -> GmMsg214BusHiSpd.AbsActvProtdRollgCntrRaw
    connect SerlComInpProxy.LstRxnTiMsg214 -> GmMsg214BusHiSpd.LstRxnTiMsg214
    connect SerlComInpProxy.RdntVehStabyEnhmtSysActvRaw -> GmMsg214BusHiSpd.RdntVehStabyEnhmtSysActvRaw
    connect SerlComInpProxy.RdntVehStabyEnhmtSysActvRollgCntrRaw -> GmMsg214BusHiSpd.RdntVehStabyEnhmtSysActvRollgCntrRaw
    connect SerlComInpProxy.LstRxnTiMsg232 -> GmMsg232BusHiSpd.LstRxnTiMsg232
    connect SerlComInpProxy.SteerSysPrfmncModReqRaw -> GmMsg232BusHiSpd.SteerSysPrfmncModReqRaw
    connect SerlComInpProxy.LstRxnTiMsg337BusChassisExp -> GmMsg337BusChassisExp.LstRxnTiMsg337BusChassisExp
    connect SerlComInpProxy.SteerWhlAgReqActvRaw -> GmMsg337BusChassisExp.SteerWhlAgReqActvRaw
    connect SerlComInpProxy.SteerWhlAgReqActvVldRaw -> GmMsg337BusChassisExp.SteerWhlAgReqActvVldRaw
    connect SerlComInpProxy.SteerWhlAgReqProtnValRaw -> GmMsg337BusChassisExp.SteerWhlAgReqProtnValRaw
    connect SerlComInpProxy.SteerWhlAgReqRollgCntrRaw -> GmMsg337BusChassisExp.SteerWhlAgReqRollgCntrRaw
    connect SerlComInpProxy.SteerWhlAgReqTarAgRaw -> GmMsg337BusChassisExp.SteerWhlAgReqTarAgRaw
    connect SerlComInpProxy.SteerWhlFbReqActvProtnValRaw -> GmMsg337BusChassisExp.SteerWhlFbReqActvProtnValRaw
    connect SerlComInpProxy.SteerWhlFbReqActvRaw -> GmMsg337BusChassisExp.SteerWhlFbReqActvRaw
    connect SerlComInpProxy.SteerWhlFbReqActvRollgCntrRaw -> GmMsg337BusChassisExp.SteerWhlFbReqActvRollgCntrRaw
    connect SerlComInpProxy.LstRxnTiMsg348BusChassisExp -> GmMsg348BusChassisExp.LstRxnTiMsg348BusChassisExp
    connect SerlComInpProxy.WhlGndVelLeDrvnRawBusChassisExp -> GmMsg348BusChassisExp.WhlGndVelLeDrvnRawBusChassisExp
    connect SerlComInpProxy.WhlGndVelLeDrvnVldRawBusChassisExp -> GmMsg348BusChassisExp.WhlGndVelLeDrvnVldRawBusChassisExp
    connect SerlComInpProxy.WhlGndVelRiDrvnRawBusChassisExp -> GmMsg348BusChassisExp.WhlGndVelRiDrvnRawBusChassisExp
    connect SerlComInpProxy.WhlGndVelRiDrvnVldRawBusChassisExp -> GmMsg348BusChassisExp.WhlGndVelRiDrvnVldRawBusChassisExp
    connect SerlComInpProxy.LstRxnTiMsg348BusHiSpd -> GmMsg348BusHiSpd.LstRxnTiMsg348BusHiSpd
    connect SerlComInpProxy.WhlGndVelLeDrvnRawBusHiSpd -> GmMsg348BusHiSpd.WhlGndVelLeDrvnRawBusHiSpd
    connect SerlComInpProxy.WhlGndVelLeDrvnVldRawBusHiSpd -> GmMsg348BusHiSpd.WhlGndVelLeDrvnVldRawBusHiSpd
    connect SerlComInpProxy.WhlGndVelRiDrvnRawBusHiSpd -> GmMsg348BusHiSpd.WhlGndVelRiDrvnRawBusHiSpd
    connect SerlComInpProxy.WhlGndVelRiDrvnVldRawBusHiSpd -> GmMsg348BusHiSpd.WhlGndVelRiDrvnVldRawBusHiSpd
    connect SerlComInpProxy.LstRxnTiMsg34ABusChassisExp -> GmMsg34ABusChassisExp.LstRxnTiMsg34ABusChassisExp
    connect SerlComInpProxy.WhlGndVelLeNonDrvnRawBusChassisExp -> GmMsg34ABusChassisExp.WhlGndVelLeNonDrvnRawBusChassisExp
    connect SerlComInpProxy.WhlGndVelLeNonDrvnVldRawBusChassisExp -> GmMsg34ABusChassisExp.WhlGndVelLeNonDrvnVldRawBusChassisExp
    connect SerlComInpProxy.WhlGndVelRiNonDrvnRawBusChassisExp -> GmMsg34ABusChassisExp.WhlGndVelRiNonDrvnRawBusChassisExp
    connect SerlComInpProxy.WhlGndVelRiNonDrvnVldRawBusChassisExp -> GmMsg34ABusChassisExp.WhlGndVelRiNonDrvnVldRawBusChassisExp
    connect SerlComInpProxy.LstRxnTiMsg34ABusHiSpd -> GmMsg34ABusHiSpd.LstRxnTiMsg34ABusHiSpd
    connect SerlComInpProxy.WhlGndVelLeNonDrvnRawBusHiSpd -> GmMsg34ABusHiSpd.WhlGndVelLeNonDrvnRawBusHiSpd
    connect SerlComInpProxy.WhlGndVelLeNonDrvnVldRawBusHiSpd -> GmMsg34ABusHiSpd.WhlGndVelLeNonDrvnVldRawBusHiSpd
    connect SerlComInpProxy.WhlGndVelRiNonDrvnRawBusHiSpd -> GmMsg34ABusHiSpd.WhlGndVelRiNonDrvnRawBusHiSpd
    connect SerlComInpProxy.WhlGndVelRiNonDrvnVldRawBusHiSpd -> GmMsg34ABusHiSpd.WhlGndVelRiNonDrvnVldRawBusHiSpd
    connect SerlComInpProxy.LstRxnTiMsg3F1 -> GmMsg3F1BusHiSpd.LstRxnTiMsg3F1
    connect SerlComInpProxy.OutdAirTCorrdValMaskRaw -> GmMsg3F1BusHiSpd.OutdAirTCorrdValMaskRaw
    connect SerlComInpProxy.OutdAirTCorrdValRaw -> GmMsg3F1BusHiSpd.OutdAirTCorrdValRaw
    connect SerlComInpProxy.OutdAirTCorrdValVldRaw -> GmMsg3F1BusHiSpd.OutdAirTCorrdValVldRaw
    connect SerlComInpProxy.EngOilTRaw -> GmMsg4D1BusHiSpd.EngOilTRaw
    connect SerlComInpProxy.EngOilVldRaw -> GmMsg4D1BusHiSpd.EngOilVldRaw
    connect SerlComInpProxy.LstRxnTiMsg4D1 -> GmMsg4D1BusHiSpd.LstRxnTiMsg4D1
    connect SerlComInpProxy.LstRxnTiMsg500BusHiSpd -> GmMsg500BusHiSpd.LstRxnTiMsg500BusHiSpd
    connect SerlComInpProxy.WhlPlsPerRevRaw -> GmMsg500BusHiSpd.WhlPlsPerRevRaw
    connect SerlComInpProxy.WhlRotlStsTiStampReslRaw -> GmMsg500BusHiSpd.WhlRotlStsTiStampReslRaw
    connect SerlComOutpProxy.BusOffHiSpd -> GmVehPwrMod.BusOffHiSpd
    connect SnsrOffsCorrn.HwAgCorrd -> HwAgSysArbn.HwAgCorrd
    connect SnsrOffsCorrn.VehYawRateCorrd -> PullCmpActv.VehYawRate
    connect SnsrOffsCorrn.HwTqCorrd -> Swp.HwTq
    connect SnsrOffsLrng.GetHwAgOffs -> CmnMfgSrv.GetHwAgOffs
    connect SnsrOffsLrng.GetHwTqOffs -> CmnMfgSrv.GetHwTqOffs
    connect SnsrOffsLrng.GetYawRateOffs -> CmnMfgSrv.GetYawRateOffs
    connect SnsrOffsLrng.RstHwTq -> CmnMfgSrv.RstHwTq
    connect SnsrOffsLrng.RstYawAndAg -> CmnMfgSrv.RstYawAndAg
    connect SnsrOffsLrng.SetHwAgOffs -> CmnMfgSrv.SetHwAgOffs
    connect SnsrOffsLrng.SetHwTqOffs -> CmnMfgSrv.SetHwTqOffs
    connect SnsrOffsLrng.SetYawRateOffs -> CmnMfgSrv.SetYawRateOffs
    connect SnsrOffsLrng.HwAgOffs -> SnsrOffsCorrn.HwAgOffs
    connect SnsrOffsLrng.HwTqOffs -> SnsrOffsCorrn.HwTqOffs
    connect SnsrOffsLrng.VehYawRateOffs -> SnsrOffsCorrn.VehYawRateOffs
    connect StabyCmp.AssiCmd -> AssiSumLim.AssiCmd
    connect StHlthSigNormn.UpdRawSig -> CDD_ChkPtAppl10.UpdRawSig
    connect StHlthSigNormn.CtrlrTRng -> CustDiagc.CtrlrTRng
    connect StHlthSigNormn.VltgRng -> CustDiagc.VltgRng
    connect StHlthSigNormn.AbsltMotPosABDifStHlth -> StHlthSigStc.AbsltMotPosABDifStHlth
    connect StHlthSigNormn.AbsltMotPosACDifStHlth -> StHlthSigStc.AbsltMotPosACDifStHlth
    connect StHlthSigNormn.AbsltMotPosBCDifStHlth -> StHlthSigStc.AbsltMotPosBCDifStHlth
    connect StHlthSigNormn.CtrlrTStHlth -> StHlthSigStc.CtrlrTStHlth
    connect StHlthSigNormn.CurrMotSumABCStHlth -> StHlthSigStc.CurrMotSumABCStHlth
    connect StHlthSigNormn.CurrMotSumDEFStHlth -> StHlthSigStc.CurrMotSumDEFStHlth
    connect StHlthSigNormn.DigTqIdptSigStHlth -> StHlthSigStc.DigTqIdptSigStHlth
    connect StHlthSigNormn.DigTqSnsrAStHlth -> StHlthSigStc.DigTqSnsrAStHlth
    connect StHlthSigNormn.DigTqSnsrBStHlth -> StHlthSigStc.DigTqSnsrBStHlth
    connect StHlthSigNormn.DutyCycStHlth -> StHlthSigStc.DutyCycStHlth
    connect StHlthSigNormn.EotImpctStHlth -> StHlthSigStc.EotImpctStHlth
    connect StHlthSigNormn.FricEstimnStHlth -> StHlthSigStc.FricEstimnStHlth
    connect StHlthSigNormn.MotPosStHlth -> StHlthSigStc.MotPosStHlth
    connect StHlthSigNormn.OutpAssiStHlth -> StHlthSigStc.OutpAssiStHlth
    connect StHlthSigNormn.PhaAStHlth -> StHlthSigStc.PhaAStHlth
    connect StHlthSigNormn.PhaBStHlth -> StHlthSigStc.PhaBStHlth
    connect StHlthSigNormn.PhaCStHlth -> StHlthSigStc.PhaCStHlth
    connect StHlthSigNormn.PhaDStHlth -> StHlthSigStc.PhaDStHlth
    connect StHlthSigNormn.PhaEStHlth -> StHlthSigStc.PhaEStHlth
    connect StHlthSigNormn.PhaFStHlth -> StHlthSigStc.PhaFStHlth
    connect StHlthSigNormn.RamEccSngBitCorrnStHlth -> StHlthSigStc.RamEccSngBitCorrnStHlth
    connect StHlthSigNormn.WhlImbMaxCmpStHlth -> StHlthSigStc.WhlImbMaxCmpStHlth
    connect StHlthSigStc.UpdStHlthStcData -> CDD_ChkPtAppl10.UpdStHlthStcData
    connect StHlthSigStc.GetSigStcHlthData -> CustDiagc.GetSigStcHlthData
    connect StOutpCtrl.SysMotTqCmdSca -> EotProtn.SysMotTqCmdSca
    connect StOutpCtrl.SysMotTqCmdSca -> LimrCdng.SysMotTqCmdSca
    connect StOutpCtrl.SysStReqDi -> SysStMod.SysStReqDi
    connect Swp.HwTqSwp -> Assi.HwTq
    connect Swp.HwTqSwp -> AssiHiFrq.HwTq
    connect Swp.HwTqSwp -> AssiPahFwl.HwTq
    connect Swp.HwTqSwp -> CmplncErr.HwTq
    connect Swp.HwTqSwp -> CustDiagc.HwTq
    connect Swp.HwTqSwp -> Dampg.HwTq
    connect Swp.HwTqSwp -> DiagcMgr.HwTq
    connect Swp.HwTqSwp -> EotLrng.HwTq
    connect Swp.HwTqSwp -> EotProtn.HwTq
    connect Swp.HwTqSwp -> GmFctDiArbn.HwTq
    connect Swp.HwTqSwp -> GmMsg184BusHiSpd.HwTq
    connect Swp.HwTqSwp -> GmMsg1CABusChassisExp.HwTq
    connect Swp.HwTqSwp -> GmOvrlStMgr.HwTq
    connect Swp.HwTqSwp -> GmStrtStop.HwTq
    connect Swp.HwTqSwp -> GmTqArbn.HwTq
    connect Swp.HwTqSwp -> GmVehPwrMod.HwTq
    connect Swp.HwTqSwp -> HowDetn.HwTq
    connect Swp.HwTqSwp -> HwAgSnsrls.HwTq
    connect Swp.HwTqSwp -> HwAgTrakgServo.HwTq
    connect Swp.HwTqSwp -> HysCmp.HwTq
    connect Swp.HwTqSwp -> InertiaCmpVel.HwTq
    connect Swp.MotTqCmdSwp -> MotTqTranlDampg.MotTqCmdCrf
    connect Swp.HwTqSwp -> PullCmpActv.HwTq
    connect Swp.HwTqSwp -> Rtn.HwTq
    connect Swp.HwTqSwp -> StabyCmp.HwTq
    connect Swp.HwTqSwp -> SysFricLrng.HwTq
    connect Swp.HwTqSwp -> TunSelnAuthy.HwTq
    connect Swp.HwTqSwp -> VehSigCdng.HwTq
    connect Swp.HwTqSwp -> WhlImbRejctn.HwTq
    connect SysFricLrng.ClrFricLrngOperMod -> CmnMfgSrv.ClrFricLrngOperMod
    connect SysFricLrng.GetFricData -> CmnMfgSrv.GetFricData
    connect SysFricLrng.GetFricLrngData -> CmnMfgSrv.GetFricLrngData
    connect SysFricLrng.GetFricOffsOutpDi -> CmnMfgSrv.GetFricOffsOutpDi
    connect SysFricLrng.InitFricLrngTbl -> CmnMfgSrv.InitFricLrngTbl
    connect SysFricLrng.SetFricData -> CmnMfgSrv.SetFricData
    connect SysFricLrng.SetFricLrngData -> CmnMfgSrv.SetFricLrngData
    connect SysFricLrng.SetFricOffsOutpDi -> CmnMfgSrv.SetFricOffsOutpDi
    connect SysFricLrng.SysFricOffs -> HysCmp.SysFricOffs
    connect SysFricLrng.GetFricLrngData -> StHlthSigNormn.GetFricLrngData
    connect SysFricLrng.MaxLrndFric -> StHlthSigNormn.MaxLrndFric
    connect SysStMod.SysSt -> BattVltgCorrln.SysSt
    connect SysStMod.SysSt -> CDD_CurrMeas.SysSt
    connect SysStMod.SysSt -> CDD_MotCtrlMgr.SysSt
    connect SysStMod.SysSt -> CDD_TSG31CfgAndUse.SysSt
    connect SysStMod.SysSt -> CmnMfgSrv.SysSt
    connect SysStMod.SysSt -> CurrMeasCorrln.SysSt
    connect SysStMod.SysSt -> CustDiagc.SysSt
    connect SysStMod.SysSt -> DiagcMgr.SysSt
    connect SysStMod.SysSt -> GateDrv0Ctrl.SysSt
    connect SysStMod.SysSt -> GateDrv1Ctrl.SysSt
    connect SysStMod.SysSt -> GmMsg148BusHiSpd.SysSt
    connect SysStMod.SysSt -> GmMsg778BusHiSpd.SysSt
    connect SysStMod.SysSt -> GmOvrlStMgr.SysSt
    connect SysStMod.SysSt -> MotDrvDiagc.SysSt
    connect SysStMod.SysSt -> MotTqTranlDampg.SysSt
    connect SysStMod.SysSt -> PwrDiscnct.SysSt
    connect SysStMod.SysSt -> PwrSply.SysSt
    connect SysStMod.SysSt -> PwrUpSeq.SysSt
    connect SysStMod.SysSt -> WhlImbRejctn.SysSt
    connect TEstimn.AssiMechT -> Dampg.AssiMechT
    connect TEstimn.MotFetT -> DutyCycThermProtn.MotFetT
    connect TEstimn.MotMagT -> DutyCycThermProtn.MotMagT
    connect TEstimn.MotWidgT -> DutyCycThermProtn.MotWidgT
    connect TEstimn.AssiMechT -> HysCmp.AssiMechT
    connect TEstimn.MotFetT -> MotCtrlPrmEstimn.MotFetT
    connect TEstimn.MotMagT -> MotCtrlPrmEstimn.MotMagT
    connect TEstimn.MotWidgT -> MotCtrlPrmEstimn.MotWidgT
    connect TEstimn.AssiMechT -> Rtn.AssiMechT
    connect TEstimn.AssiMechT -> SysFricLrng.AssiMechT
    connect TmplMonr.TmplMonrIninTestCmpl -> PwrUpSeq.TmplMonIninTestCmpl
    connect TqLoa.TqLoaCmd -> AssiSumLim.TqLoaCmd
    connect TqLoa.TqLoaAvl -> LoaMgr.TqLoaAvl
    connect TqOscn.HwOscnCmd -> GmTqArbn.HwTqOscCmd
    connect TunSelnAuthy.XcpCalChgReq -> CDD_XcpIf.XcpCalChgReq
    connect TunSelnAuthy.RtCalChgReq -> TunSelnMngt.RtCalChgReq
    connect TunSelnMngt.ActvGroup -> CDD_XcpIf.ActvGroup
    connect TunSelnMngt.ActvIninIdx -> CDD_XcpIf.ActvIninIdx
    connect TunSelnMngt.ActvRtIdx -> CDD_XcpIf.ActvRtIdx
    connect TunSelnMngt.CalCopySts -> CDD_XcpIf.CalCopySts
    connect TunSelnMngt.CopyCalPageReq -> CDD_XcpIf.CopyCalPageReq
    connect TunSelnMngt.GetCalPageReq -> CDD_XcpIf.GetCalPageReq
    connect TunSelnMngt.GetSegInfoReq -> CDD_XcpIf.GetSegInfoReq
    connect TunSelnMngt.OnlineTunRamAdrMpg -> CDD_XcpIf.OnlineTunRamAdrMpg
    connect TunSelnMngt.SetCalPageReq -> CDD_XcpIf.SetCalPageReq
    connect VehSigCdng.VehSpd -> Assi.VehSpd
    connect VehSigCdng.VehSpd -> AssiHiFrq.VehSpd
    connect VehSigCdng.VehSpd -> AssiPahFwl.VehSpd
    connect VehSigCdng.VehSpd -> AssiSumLim.VehSpd
    connect VehSigCdng.VehSpd -> CDD_CurrMeas.VehSpd
    connect VehSigCdng.VehSpdVld -> CDD_CurrMeas.VehSpdVld
    connect VehSigCdng.VehSpd -> CustDiagc.VehSpd
    connect VehSigCdng.VehSpdVld -> CustDiagc.VehSpdVld
    connect VehSigCdng.VehSpd -> Dampg.VehSpd
    connect VehSigCdng.VehSpd -> DampgPahFwl.VehSpd
    connect VehSigCdng.VehSpd -> DiagcMgr.VehSpd
    connect VehSigCdng.VehSpd -> EotProtn.VehSpd
    connect VehSigCdng.VehSpd -> EotProtnFwl.VehSpd
    connect VehSigCdng.VehSpd -> GmMsg0C9BusHiSpd.VehSpd
    connect VehSigCdng.VehSpdVld -> GmMsg0C9BusHiSpd.VehSpdVld
    connect VehSigCdng.VehSpdVld -> GmMsg184BusHiSpd.VehSpdVld
    connect VehSigCdng.VehSpd -> GmOvrlStMgr.VehSpd
    connect VehSigCdng.VehSpd -> GmStrtStop.VehSpd
    connect VehSigCdng.VehSpdVld -> GmStrtStop.VehSpdVld
    connect VehSigCdng.VehSpd -> HowDetn.VehSpd
    connect VehSigCdng.VehSpd -> HwAgSnsrls.VehSpd
    connect VehSigCdng.VehSpdVld -> HwAgSnsrls.VehSpdVld
    connect VehSigCdng.VehYawRate -> HwAgSnsrls.VehYawRate
    connect VehSigCdng.VehSpd -> HwAgTrakgServo.VehSpd
    connect VehSigCdng.VehSpd -> HwAgVehCentrTrim.VehSpd
    connect VehSigCdng.VehSpd -> HysCmp.VehSpd
    connect VehSigCdng.VehLgtA -> InertiaCmpVel.VehLgtA
    connect VehSigCdng.VehSpd -> InertiaCmpVel.VehSpd
    connect VehSigCdng.VehSpd -> LimrCdng.VehSpd
    connect VehSigCdng.VehSpd -> MotCurrRegCfg.VehSpd
    connect VehSigCdng.VehSpd -> MotTqTranlDampg.VehSpd
    connect VehSigCdng.VehLatAEstimd -> PullCmpActv.VehLatA
    connect VehSigCdng.VehSpd -> PullCmpActv.VehSpd
    connect VehSigCdng.VehSpdVld -> PullCmpActv.VehSpdVld
    connect VehSigCdng.VehYawRateVld -> PullCmpActv.VehYawRateVld
    connect VehSigCdng.VehSpd -> Rtn.VehSpd
    connect VehSigCdng.VehSpdVld -> Rtn.VehSpdVld
    connect VehSigCdng.VehSpd -> RtnPahFwl.VehSpd
    connect VehSigCdng.VehYawRate -> SnsrOffsCorrn.VehYawRate
    connect VehSigCdng.VehSpd -> SnsrOffsLrng.VehSpd
    connect VehSigCdng.VehSpdVld -> SnsrOffsLrng.VehSpdVld
    connect VehSigCdng.VehYawRate -> SnsrOffsLrng.VehYawRate
    connect VehSigCdng.VehSpd -> StabyCmp.VehSpd
    connect VehSigCdng.VehSpd -> Swp.VehSpd
    connect VehSigCdng.VehSpdVld -> Swp.VehSpdVld
    connect VehSigCdng.VehLatAEstimd -> SysFricLrng.VehLatA
    connect VehSigCdng.VehSpd -> SysFricLrng.VehSpd
    connect VehSigCdng.VehSpdVld -> SysFricLrng.VehSpdVld
    connect VehSigCdng.VehLatAEstimd -> TqLoa.VehLatA
    connect VehSigCdng.VehLatAVld -> TqLoa.VehLatAVld
    connect VehSigCdng.VehSpd -> TqLoa.VehSpd
    connect VehSigCdng.VehSpdVld -> TqLoa.VehSpdVld
    connect VehSigCdng.VehSpd -> TunSelnAuthy.VehSpd
    connect VehSigCdng.VehSpd -> VehSpdLimr.VehSpd
    connect VehSigCdng.VehSpd -> WhlImbRejctn.VehSpd
    connect VehSigCdng.VehSpdVld -> WhlImbRejctn.VehSpdVld
    connect VehSpdLimr.VehSpdMotTqLim -> LimrCdng.VehSpdMotTqLim
    connect WhlImbRejctn.WhlImbRejctnAmp -> Assi.WhlImbRejctnAmp
    connect WhlImbRejctn.WhlImbRejctnAmp -> AssiHiFrq.WhlImbRejctnAmp
    connect WhlImbRejctn.WhlImbRejctnCmd -> AssiSumLim.WhlImbRejctnCmd
    connect WhlImbRejctn.WhlImbRejctnAmp -> HysCmp.WhlImbRejctnAmp
    connect WhlImbRejctn.WhlImbRejctnAmp -> InertiaCmpVel.WhlImbRejctnAmp
    connect WhlImbRejctn.WhlImbRejctnCmd -> StHlthSigNormn.WhlImbRejctnCmd
package /EndToEndProtections
  end to end protection set EndToEndConnections
package /VehicleProject
  system System: category=SYSTEM_EXTRACT
    system mapping System_MPPNG
    root-software-compositions:
      root sw composition prototype ECU_Composition: software-composition=ECU_Composition
