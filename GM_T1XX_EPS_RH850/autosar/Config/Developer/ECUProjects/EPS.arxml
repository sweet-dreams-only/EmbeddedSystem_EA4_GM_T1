[part 1 of 2: packages /DaVinci/PKG_Cluster_CAN00 to /ECUCompositionTypes]
AUTOSAR XML (schema 4-0-3)
package /DaVinci/PKG_Cluster_CAN00
  can cluster CAN00
    can physical channel CHNL: comm-connectors=CAN00_CHNL
package /DaVinci/PKG_ECU
  ecu instance EPS
    can communication connector CAN00_CHNL
package /ECUCompositionTypes
  composition sw component type ECU_Composition
    232 x component:
      AAACalRegn01Rt01_Dummy: type=AAACalRegn01Rt01_Dummy
      AAACalRegn01Rt01_Dummy_{1..4}: type=AAACalRegn01Rt01_Dummy
      AAACalRegn02Rt01GroupC_Dummy: type=AAACalRegn02Rt01GroupC_Dummy
      AAACalRegn02Rt01GroupC_Dummy_{1..4}: type=AAACalRegn02Rt01GroupC_Dummy
      AAACalRegn03Rt01_Dummy: type=AAACalRegn03Rt01_Dummy
      AAACalRegn03Rt01_Dummy_{1..4}: type=AAACalRegn03Rt01_Dummy
      AAACalRegn03Rt01GroupA_Dummy: type=AAACalRegn03Rt01GroupA_Dummy
      AAACalRegn03Rt01GroupA_Dummy_{1..4}: type=AAACalRegn03Rt01GroupA_Dummy
      AAACalRegn03Rt01GroupB_Dummy: type=AAACalRegn03Rt01GroupB_Dummy
      AAACalRegn03Rt01GroupB_Dummy_{1..4}: type=AAACalRegn03Rt01GroupB_Dummy
      Assi: type=Assi
      AssiHiFrq: type=AssiHiFrq
      AssiPahFwl: type=AssiPahFwl
      AssiSumLim: type=AssiSumLim
      BattVltg: type=BattVltg
      BattVltgCorrln: type=BattVltgCorrln
      CalRegn01Cmn: type=CalRegn01Cmn
      CalRegn01CmnGroupB: type=CalRegn01CmnGroupB
      CalRegn01CmnGroupC: type=CalRegn01CmnGroupC
      CalRegn01Inin00: type=CalRegn01Inin00
      CalRegn01Inin00GroupB: type=CalRegn01Inin00GroupB
      CalRegn01Inin00GroupC: type=CalRegn01Inin00GroupC
      CalRegn01Rt{00..04}: type=CalRegn01Rt{00..04}
      CalRegn02Cmn: type=CalRegn02Cmn
      CalRegn02CmnGroupA: type=CalRegn02CmnGroupA
      CalRegn02CmnGroupB: type=CalRegn02CmnGroupB
      CalRegn02CmnGroupC: type=CalRegn02CmnGroupC
      CalRegn02Inin00: type=CalRegn02Inin00
      CalRegn02Inin00GroupA: type=CalRegn02Inin00GroupA
      CalRegn02Inin00GroupC: type=CalRegn02Inin00GroupC
      CalRegn02Rt{00..04}GroupC: type=CalRegn02Rt{00..04}GroupC
      CalRegn03Cmn: type=CalRegn03Cmn
      CalRegn03CmnGroupA: type=CalRegn03CmnGroupA
      CalRegn03CmnGroupB: type=CalRegn03CmnGroupB
      CalRegn03CmnGroupC: type=CalRegn03CmnGroupC
      CalRegn03Inin00: type=CalRegn03Inin00
      CalRegn03Inin00GroupA: type=CalRegn03Inin00GroupA
      CalRegn03Inin00GroupB: type=CalRegn03Inin00GroupB
      CalRegn03Inin00GroupC: type=CalRegn03Inin00GroupC
      CalRegn03Rt00: type=CalRegn03Rt00
      CalRegn03Rt00GroupA: type=CalRegn03Rt00GroupA
      CalRegn03Rt00GroupB: type=CalRegn03Rt00GroupB
      CalRegn03Rt01: type=CalRegn03Rt01
      CalRegn03Rt01GroupA: type=CalRegn03Rt01GroupA
      CalRegn03Rt01GroupB: type=CalRegn03Rt01GroupB
      CalRegn03Rt02: type=CalRegn03Rt02
      CalRegn03Rt02GroupA: type=CalRegn03Rt02GroupA
      CalRegn03Rt02GroupB: type=CalRegn03Rt02GroupB
      CalRegn03Rt03: type=CalRegn03Rt03
      CalRegn03Rt03GroupA: type=CalRegn03Rt03GroupA
      CalRegn03Rt03GroupB: type=CalRegn03Rt03GroupB
      CalRegn03Rt04: type=CalRegn03Rt04
      CalRegn03Rt04GroupA: type=CalRegn03Rt04GroupA
      CalRegn03Rt04GroupB: type=CalRegn03Rt04GroupB
      CDD_Adc0CfgAndUse: type=CDD_Adc0CfgAndUse
      CDD_Adc1CfgAndUse: type=CDD_Adc1CfgAndUse
      CDD_AdcDiagc: type=CDD_AdcDiagc
      CDD_ChkPtAppl10: type=CDD_ChkPtAppl10
      CDD_ChkPtAppl6: type=CDD_ChkPtAppl6
      CDD_CurrMeas: type=CDD_CurrMeas
      CDD_CurrMeasArbn: type=CDD_CurrMeasArbn
      CDD_DataAndAdrPar: type=CDD_DataAndAdrPar
      CDD_DmaCfgAndUse: type=CDD_DmaCfgAndUse
      CDD_EcmOutpAndDiagc: type=CDD_EcmOutpAndDiagc
      CDD_ExcpnHndlg: type=CDD_ExcpnHndlg
      CDD_FlsMem: type=CDD_FlsMem
      CDD_GMLANSdl: type=CDD_GMLANSdl
      CDD_GmT1xxMcuCfg: type=CDD_GmT1xxMcuCfg
      CDD_GuardCfgAndDiagc: type=CDD_GuardCfgAndDiagc
      CDD_HwTq{0..3}Meas: type=CDD_HwTq{0..3}Meas
      CDD_McuCoreCfgAndDiagc: type=CDD_McuCoreCfgAndDiagc
      CDD_McuDiagc: type=CDD_McuDiagc
      CDD_MotAg0Meas: type=CDD_MotAg0Meas
      CDD_MotAg1Meas: type=CDD_MotAg1Meas
      CDD_MotAgArbn: type=CDD_MotAgArbn
      CDD_MotAgCmp: type=CDD_MotAgCmp
      CDD_MotCtrlMgr: type=CDD_MotCtrlMgr
      CDD_MotCurrRegVltgLimr: type=CDD_MotCurrRegVltgLimr
      CDD_MotRplCoggCmd: type=CDD_MotRplCoggCmd
      CDD_MotVel: type=CDD_MotVel
      CDD_NvMProxy: type=CDD_NvMProxy
      CDD_NxtrTi: type=CDD_NxtrTi
      CDD_RamMem: type=CDD_RamMem
      CDD_SinVltgGenn: type=CDD_SinVltgGenn
      CDD_SnsrMeasStrt: type=CDD_SnsrMeasStrt
      CDD_SyncCrc: type=CDD_SyncCrc
      CDD_Tauj0CfgAndUse: type=CDD_Tauj0CfgAndUse
      CDD_Tauj1CfgAndUse: type=CDD_Tauj1CfgAndUse
      CDD_TSG31CfgAndUse: type=CDD_TSG31CfgAndUse
      CDD_VrfyCritReg: type=CDD_VrfyCritReg
      CDD_XcpIf: type=CDD_XcpIf
      CmnMfgSrv: type=CmnMfgSrv
      CmnMfgSrvIf: type=CmnMfgSrvIf
      CmplncErr: type=CmplncErr
      CurrMeasCorrln: type=CurrMeasCorrln
      CustDiagc: type=CustDiagc
      Dampg: type=Dampg
      DampgPahFwl: type=DampgPahFwl
      DiagcMgr: type=DiagcMgr
      DiagcMgrProxyAppl10: type=DiagcMgrProxyAppl10
      DiagcMgrProxyAppl6: type=DiagcMgrProxyAppl6
      DiagcMgrStub: type=DiagcMgrStub
      DutyCycThermProtn: type=DutyCycThermProtn
      EcuTMeas: type=EcuTMeas
      EotLrng: type=EotLrng
      EotProtn: type=EotProtn
      EotProtnFwl: type=EotProtnFwl
      FltInj: type=FltInj
      GateDrv0Ctrl: type=GateDrv0Ctrl
      GateDrv1Ctrl: type=GateDrv1Ctrl
      GmFctDiArbn: type=GmFctDiArbn
      GmMsg0C5BusHiSpd: type=GmMsg0C5BusHiSpd
      GmMsg0C9BusHiSpd: type=GmMsg0C9BusHiSpd
      GmMsg148BusHiSpd: type=GmMsg148BusHiSpd
      GmMsg17DBusHiSpd: type=GmMsg17DBusHiSpd
      GmMsg180BusChassisExp: type=GmMsg180BusChassisExp
      GmMsg180BusHiSpd: type=GmMsg180BusHiSpd
      GmMsg182BusChassisExp: type=GmMsg182BusChassisExp
      GmMsg184BusHiSpd: type=GmMsg184BusHiSpd
      GmMsg1CABusChassisExp: type=GmMsg1CABusChassisExp
      GmMsg1E5BusChassisExp: type=GmMsg1E5BusChassisExp
      GmMsg1E5BusHiSpd: type=GmMsg1E5BusHiSpd
      GmMsg1E9BusHiSpd: type=GmMsg1E9BusHiSpd
      GmMsg1F1BusHiSpd: type=GmMsg1F1BusHiSpd
      GmMsg1F5BusHiSpd: type=GmMsg1F5BusHiSpd
      GmMsg214BusHiSpd: type=GmMsg214BusHiSpd
      GmMsg232BusHiSpd: type=GmMsg232BusHiSpd
      GmMsg335BusChassisExp: type=GmMsg335BusChassisExp
      GmMsg337BusChassisExp: type=GmMsg337BusChassisExp
      GmMsg348BusChassisExp: type=GmMsg348BusChassisExp
      GmMsg348BusHiSpd: type=GmMsg348BusHiSpd
      GmMsg34ABusChassisExp: type=GmMsg34ABusChassisExp
      GmMsg34ABusHiSpd: type=GmMsg34ABusHiSpd
      GmMsg3F1BusHiSpd: type=GmMsg3F1BusHiSpd
      GmMsg4D1BusHiSpd: type=GmMsg4D1BusHiSpd
      GmMsg500BusHiSpd: type=GmMsg500BusHiSpd
      GmMsg778BusHiSpd: type=GmMsg778BusHiSpd
      GmOvrlStMgr: type=GmOvrlStMgr
      GmRoadWhlInQlfr: type=GmRoadWhlInQlfr
      GmStrtStop: type=GmStrtStop
      GmTqArbn: type=GmTqArbn
      GmVehPwrMod: type=GmVehPwrMod
      GmVehSpdArbn: type=GmVehSpdArbn
      HiLoadStallLimr: type=HiLoadStallLimr
      HowDetn: type=HowDetn
      HwAg0Meas: type=HwAg0Meas
      HwAg1Meas: type=HwAg1Meas
      HwAgArbn: type=HwAgArbn
      HwAgCorrln: type=HwAgCorrln
      HwAgSnsrls: type=HwAgSnsrls
      HwAgSysArbn: type=HwAgSysArbn
      HwAgTrajGenn: type=HwAgTrajGenn
      HwAgTrakgServo: type=HwAgTrakgServo
      HwAgVehCentrTrim: type=HwAgVehCentrTrim
      HwTqArbn: type=HwTqArbn
      HwTqCorrln: type=HwTqCorrln
      HysCmp: type=HysCmp
      InertiaCmpVel: type=InertiaCmpVel
      IoHwAb: type=IoHwAb
      LimrCdng: type=LimrCdng
      LoaMgr: type=LoaMgr
      MotAg2Meas: type=MotAg2Meas
      MotAgCorrln: type=MotAgCorrln
      MotCtrlPrmEstimn: type=MotCtrlPrmEstimn
      MotCurrPeakEstimn: type=MotCurrPeakEstimn
      MotCurrRegCfg: type=MotCurrRegCfg
      MotDrvDiagc: type=MotDrvDiagc
      MotQuadDetn: type=MotQuadDetn
      MotRefMdl: type=MotRefMdl
      MotRplCoggCfg: type=MotRplCoggCfg
      MotTqCmdSca: type=MotTqCmdSca
      MotTqTranlDampg: type=MotTqTranlDampg
      MotVelCtrl: type=MotVelCtrl
      NxtrCalIds: type=NxtrCalIds
      NxtrSwIds: type=NxtrSwIds
      PartNr: type=PartNr
      PolarityCfg: type=PolarityCfg
      ProgMfgSrv: type=ProgMfgSrv
      PullCmpActv: type=PullCmpActv
      PwrDiscnct: type=PwrDiscnct
      PwrLimr: type=PwrLimr
      PwrpkCmpbltyChk: type=PwrpkCmpbltyChk
      PwrSply: type=PwrSply
      PwrUpSeq: type=PwrUpSeq
      Rtn: type=Rtn
      RtnPahFwl: type=RtnPahFwl
      SerlComInpProxy: type=SerlComInpProxy
      SerlComOutpProxy: type=SerlComOutpProxy
      SnsrOffsCorrn: type=SnsrOffsCorrn
      SnsrOffsLrng: type=SnsrOffsLrng
      StabyCmp: type=StabyCmp
      StHlthSigNormn: type=StHlthSigNormn
      StHlthSigStc: type=StHlthSigStc
      StOutpCtrl: type=StOutpCtrl
      Swp: type=Swp
      SysFricLrng: type=SysFricLrng
      SysStMod: type=SysStMod
      TEstimn: type=TEstimn
      TmplMonr: type=TmplMonr
      TqLoa: type=TqLoa
      TqOscn: type=TqOscn
      TunSelnAuthy: type=TunSelnAuthy
      TunSelnMngt: type=TunSelnMngt
      VehSigCdng: type=VehSigCdng
      VehSpdLimr: type=VehSpdLimr
      WhlImbRejctn: type=WhlImbRejctn
    connect Assi.AssiCmdBas -> AssiPahFwl.AssiCmdBas
    connect Assi.AssiCmdBas -> Dampg.AssiCmdBas
    connect Assi.AssiCmdBas -> HysCmp.AssiCmdBas
    connect Assi.AssiCmdBas -> InertiaCmpVel.AssiCmdBas
    connect AssiHiFrq.AssiHiFrqCmd -> AssiPahFwl.AssiHiFrqCmd
    connect AssiPahFwl.AssiPahLimrActv -> DampgPahFwl.AssiPahLimrActv
    connect AssiPahFwl.AssiCmdSum -> StabyCmp.AssiCmdSum
    connect AssiPahFwl.AssiPahLimrActv -> StabyCmp.AssiPahLimrActv
    connect AssiSumLim.SetManTqCmd -> CmnMfgSrv.SetManTqCmd
    connect AssiSumLim.MotTqCmd -> CustDiagc.MotTqCmd
    connect AssiSumLim.MotTqCmdLimdPreStall -> HiLoadStallLimr.MotTqCmdLimdPreStall
    connect AssiSumLim.SetManTqCmd -> MotVelCtrl.SetManTqCmd
    connect AssiSumLim.MotTqCmd -> Swp.MotTqCmd
    connect BattVltg.BrdgVltg -> CDD_CurrMeas.BrdgVltg
    connect BattVltg.BrdgVltg -> CDD_MotCtrlMgr.BrdgVltg
    connect BattVltg.BrdgVltg -> DiagcMgr.BrdgVltg
    connect BattVltg.BrdgVltg -> MotRefMdl.BrdgVltg
    connect BattVltg.BrdgVltg -> PwrLimr.BrdgVltg
    connect BattVltgCorrln.BattSwdVltgCorrlnSts -> BattVltg.BattSwdVltgCorrlnSts
    connect CalRegn01Cmn.SysGlbPrmVehSpdBilnrSeln -> Assi.SysGlbPrmVehSpd
    connect CalRegn01Cmn.SysGlbPrmVehSpdBilnrSeln -> Assi.SysGlbPrmVehSpdBilnrSeln
    connect CalRegn01Cmn.SysGlbPrmVehSpdBilnrSeln -> AssiHiFrq.SysGlbPrmVehSpdBilnrSeln
    connect CalRegn01Cmn.AssiPahFwlDiRcvr -> AssiPahFwl.AssiPahFwlDiRcvr
    connect CalRegn01Cmn.AssiPahFwlVehSpd -> AssiPahFwl.AssiPahFwlVehSpd
    connect CalRegn01Cmn.BasAssiPahFwlOverLimDiagcFailStep -> AssiPahFwl.BasAssiPahFwlOverLimDiagcFailStep
    connect CalRegn01Cmn.BasAssiPahFwlOverLimDiagcPassStep -> AssiPahFwl.BasAssiPahFwlOverLimDiagcPassStep
    connect CalRegn01Cmn.HiFrqAssiPahFwlOverLimDiagcFailStep -> AssiPahFwl.HiFrqAssiPahFwlOverLimDiagcFailStep
    connect CalRegn01Cmn.HiFrqAssiPahFwlOverLimDiagcPassStep -> AssiPahFwl.HiFrqAssiPahFwlOverLimDiagcPassStep
    connect CalRegn01Cmn.AssiSumLimNtc0x0C4FailStep -> AssiSumLim.AssiSumLimNtc0x0C4FailStep
    connect CalRegn01Cmn.AssiSumLimNtc0x0C4PassStep -> AssiSumLim.AssiSumLimNtc0x0C4PassStep
    connect CalRegn01Cmn.AssiSumLimPullCmpLim -> AssiSumLim.AssiSumLimPullCmpLim
    connect CalRegn01Cmn.BattVltgCorrlnSysMinVltg -> BattVltg.BattVltgCorrlnSysMinVltg
    connect CalRegn01Cmn.BattVltgSwdMax -> BattVltg.BattVltgSwdMax
    connect CalRegn01Cmn.BrdgVltgMax -> BattVltg.BrdgVltgMax
    connect CalRegn01Cmn.BattVltgCorrlnAllwdVltgDif -> BattVltgCorrln.BattVltgCorrlnAllwdVltgDif
    connect CalRegn01Cmn.BattVltgCorrlnBattLoVltg -> BattVltgCorrln.BattVltgCorrlnBattLoVltg
    connect CalRegn01Cmn.BattVltgCorrlnBattOverVltg -> BattVltgCorrln.BattVltgCorrlnBattOverVltg
    connect CalRegn01Cmn.BattVltgCorrlnBattUnderVltg -> BattVltgCorrln.BattVltgCorrlnBattUnderVltg
    connect CalRegn01Cmn.BattVltgCorrlnNtc0x03C0x0440x04CFailStep -> BattVltgCorrln.BattVltgCorrlnNtc0x03C0x0440x04CFailStep
    connect CalRegn01Cmn.BattVltgCorrlnNtc0x03C0x0440x04CPassStep -> BattVltgCorrln.BattVltgCorrlnNtc0x03C0x0440x04CPassStep
    connect CalRegn01Cmn.BattVltgCorrlnNtc0x03DFailStep -> BattVltgCorrln.BattVltgCorrlnNtc0x03DFailStep
    connect CalRegn01Cmn.BattVltgCorrlnNtc0x03DPassStep -> BattVltgCorrln.BattVltgCorrlnNtc0x03DPassStep
    connect CalRegn01Cmn.BattVltgCorrlnNtc0x0B0FailStep -> BattVltgCorrln.BattVltgCorrlnNtc0x0B0FailStep
    connect CalRegn01Cmn.BattVltgCorrlnNtc0x0B0PassStep -> BattVltgCorrln.BattVltgCorrlnNtc0x0B0PassStep
    connect CalRegn01Cmn.BattVltgCorrlnNtc0x0B1FailStep -> BattVltgCorrln.BattVltgCorrlnNtc0x0B1FailStep
    connect CalRegn01Cmn.BattVltgCorrlnNtc0x0B1PassStep -> BattVltgCorrln.BattVltgCorrlnNtc0x0B1PassStep
    connect CalRegn01Cmn.BattVltgCorrlnNtc0x0B5FailStep -> BattVltgCorrln.BattVltgCorrlnNtc0x0B5FailStep
    connect CalRegn01Cmn.BattVltgCorrlnNtc0x0B5PassStep -> BattVltgCorrln.BattVltgCorrlnNtc0x0B5PassStep
    connect CalRegn01Cmn.BattVltgCorrlnRcvrlBattLoVltg -> BattVltgCorrln.BattVltgCorrlnRcvrlBattLoVltg
    connect CalRegn01Cmn.BattVltgCorrlnRcvrlBattOverVltg -> BattVltgCorrln.BattVltgCorrlnRcvrlBattOverVltg
    connect CalRegn01Cmn.BattVltgCorrlnRcvrlBattUnderVltg -> BattVltgCorrln.BattVltgCorrlnRcvrlBattUnderVltg
    connect CalRegn01Cmn.BattVltgCorrlnSysMinVltg -> BattVltgCorrln.BattVltgCorrlnSysMinVltg
    connect CalRegn01Cmn.BattVltgSwdMax -> BattVltgCorrln.BattVltgSwdMax
    connect CalRegn01Cmn.AdcDiagcNtc0x032FailStep -> CDD_AdcDiagc.AdcDiagcNtc0x032FailStep
    connect CalRegn01Cmn.AdcDiagcNtc0x032PassStep -> CDD_AdcDiagc.AdcDiagcNtc0x032PassStep
    connect CalRegn01Cmn.AdcDiagcNtc0x033FailStep -> CDD_AdcDiagc.AdcDiagcNtc0x033FailStep
    connect CalRegn01Cmn.AdcDiagcNtc0x033PassStep -> CDD_AdcDiagc.AdcDiagcNtc0x033PassStep
    connect CalRegn01Cmn.CurrMeasEolFixdPwmPerd -> CDD_CurrMeas.CurrMeasEolFixdPwmPerd
    connect CalRegn01Cmn.CurrMeasEolGainMax -> CDD_CurrMeas.CurrMeasEolGainMax
    connect CalRegn01Cmn.CurrMeasEolGainMin -> CDD_CurrMeas.CurrMeasEolGainMin
    connect CalRegn01Cmn.CurrMeasEolGainNrOfSample -> CDD_CurrMeas.CurrMeasEolGainNrOfSample
    connect CalRegn01Cmn.CurrMeasEolGainNumer -> CDD_CurrMeas.CurrMeasEolGainNumer
    connect CalRegn01Cmn.CurrMeasEolMaxMotVel -> CDD_CurrMeas.CurrMeasEolMaxMotVel
    connect CalRegn01Cmn.CurrMeasEolOffsHiBrdgVltgMin -> CDD_CurrMeas.CurrMeasEolOffsHiBrdgVltgMin
    connect CalRegn01Cmn.CurrMeasEolOffsHiCmuOffs -> CDD_CurrMeas.CurrMeasEolOffsHiCmuOffs
    connect CalRegn01Cmn.CurrMeasEolOffsLoCmuOffs -> CDD_CurrMeas.CurrMeasEolOffsLoCmuOffs
    connect CalRegn01Cmn.CurrMeasEolOffsMax -> CDD_CurrMeas.CurrMeasEolOffsMax
    connect CalRegn01Cmn.CurrMeasEolOffsMin -> CDD_CurrMeas.CurrMeasEolOffsMin
    connect CalRegn01Cmn.CurrMeasEolOffsNrOfSample -> CDD_CurrMeas.CurrMeasEolOffsNrOfSample
    connect CalRegn01Cmn.CurrMeasEolTranCntrThd -> CDD_CurrMeas.CurrMeasEolTranCntrThd
    connect CalRegn01Cmn.CurrMeasMinRqrdPhaOnTi -> CDD_CurrMeas.CurrMeasMinRqrdPhaOnTi
    connect CalRegn01Cmn.CurrMeasMotAgCompuDly -> CDD_CurrMeas.CurrMeasMotAgCompuDly
    connect CalRegn01Cmn.CurrMeasMotCurrAdcVlyWrmIninMax -> CDD_CurrMeas.CurrMeasMotCurrAdcVlyWrmIninMax
    connect CalRegn01Cmn.CurrMeasMotCurrAdcVlyWrmIninMin -> CDD_CurrMeas.CurrMeasMotCurrAdcVlyWrmIninMin
    connect CalRegn01Cmn.CurrMeasNtc0x05DFailStep -> CDD_CurrMeas.CurrMeasNtc0x05DFailStep
    connect CalRegn01Cmn.CurrMeasNtc0x05DPassStep -> CDD_CurrMeas.CurrMeasNtc0x05DPassStep
    connect CalRegn01Cmn.CurrMeasNtc0x06DFailStep -> CDD_CurrMeas.CurrMeasNtc0x06DFailStep
    connect CalRegn01Cmn.CurrMeasNtc0x06DPassStep -> CDD_CurrMeas.CurrMeasNtc0x06DPassStep
    connect CalRegn01Cmn.CurrMeasArbnMaxStallCntr -> CDD_CurrMeasArbn.CurrMeasArbnMaxStallCntr
    connect CalRegn01Cmn.HwTq2MeasHwTq2PrtclFltFailStep -> CDD_HwTq2Meas.HwTq2MeasHwTq2PrtclFltFailStep
    connect CalRegn01Cmn.HwTq2MeasHwTq2PrtclFltPassStep -> CDD_HwTq2Meas.HwTq2MeasHwTq2PrtclFltPassStep
    connect CalRegn01Cmn.HwTq3MeasHwTq3PrtclFltFailStep -> CDD_HwTq3Meas.HwTq3MeasHwTq3PrtclFltFailStep
    connect CalRegn01Cmn.HwTq3MeasHwTq3PrtclFltPassStep -> CDD_HwTq3Meas.HwTq3MeasHwTq3PrtclFltPassStep
    connect CalRegn01Cmn.MotCurrRegCfgCurrLoopSecOrderTrfFctEna -> CDD_MotCurrRegVltgLimr.MotCurrRegCfgCurrLoopSecOrderTrfFctEna
    connect CalRegn01Cmn.MotCurrRegCfgMotRVirtDax -> CDD_MotCurrRegVltgLimr.MotCurrRegCfgMotRVirtDax
    connect CalRegn01Cmn.MotCurrRegCfgMotRVirtQax -> CDD_MotCurrRegVltgLimr.MotCurrRegCfgMotRVirtQax
    connect CalRegn01Cmn.MotCurrRegVltgLimrCurrLoaScarSlewRate -> CDD_MotCurrRegVltgLimr.MotCurrRegVltgLimrCurrLoaScarSlewRate
    connect CalRegn01Cmn.MotCurrRegVltgLimrDaxAntiWdupCoeff -> CDD_MotCurrRegVltgLimr.MotCurrRegVltgLimrDaxAntiWdupCoeff
    connect CalRegn01Cmn.MotCurrRegVltgLimrDualEcuLoaScarSlewRate -> CDD_MotCurrRegVltgLimr.MotCurrRegVltgLimrDualEcuLoaScarSlewRate
    connect CalRegn01Cmn.MotCurrRegVltgLimrIvtrLoaScarSlewRate -> CDD_MotCurrRegVltgLimr.MotCurrRegVltgLimrIvtrLoaScarSlewRate
    connect CalRegn01Cmn.MotCurrRegVltgLimrMotCurrPredEna -> CDD_MotCurrRegVltgLimr.MotCurrRegVltgLimrMotCurrPredEna
    connect CalRegn01Cmn.MotCurrRegVltgLimrMotCurrPredTi -> CDD_MotCurrRegVltgLimr.MotCurrRegVltgLimrMotCurrPredTi
    connect CalRegn01Cmn.MotCurrRegVltgLimrMotCurrQaxRefMdfnRplEna -> CDD_MotCurrRegVltgLimr.MotCurrRegVltgLimrMotCurrQaxRefMdfnRplEna
    connect CalRegn01Cmn.MotCurrRegVltgLimrMotVltgBrdgFilEna -> CDD_MotCurrRegVltgLimr.MotCurrRegVltgLimrMotVltgBrdgFilEna
    connect CalRegn01Cmn.MotCurrRegVltgLimrMotVltgBrdgLpFilFrq -> CDD_MotCurrRegVltgLimr.MotCurrRegVltgLimrMotVltgBrdgLpFilFrq
    connect CalRegn01Cmn.MotCurrRegVltgLimrMotVltgDaxIntglHiLim -> CDD_MotCurrRegVltgLimr.MotCurrRegVltgLimrMotVltgDaxIntglHiLim
    connect CalRegn01Cmn.MotCurrRegVltgLimrMotVltgDaxIntglLoLim -> CDD_MotCurrRegVltgLimr.MotCurrRegVltgLimrMotVltgDaxIntglLoLim
    connect CalRegn01Cmn.MotCurrRegVltgLimrMotVltgQaxFfFilEna -> CDD_MotCurrRegVltgLimr.MotCurrRegVltgLimrMotVltgQaxFfFilEna
    connect CalRegn01Cmn.MotCurrRegVltgLimrMotVltgQaxFfLpFilFrq -> CDD_MotCurrRegVltgLimr.MotCurrRegVltgLimrMotVltgQaxFfLpFilFrq
    connect CalRegn01Cmn.MotCurrRegVltgLimrMotVltgQaxIntglHiLim -> CDD_MotCurrRegVltgLimr.MotCurrRegVltgLimrMotVltgQaxIntglHiLim
    connect CalRegn01Cmn.MotCurrRegVltgLimrMotVltgQaxIntglLoLim -> CDD_MotCurrRegVltgLimr.MotCurrRegVltgLimrMotVltgQaxIntglLoLim
    connect CalRegn01Cmn.MotCurrRegVltgLimrQaxAntiWdupCoeff -> CDD_MotCurrRegVltgLimr.MotCurrRegVltgLimrQaxAntiWdupCoeff
    connect CalRegn01Cmn.MotCurrRegVltgLimrQaxAntiWdupScagDi -> CDD_MotCurrRegVltgLimr.MotCurrRegVltgLimrQaxAntiWdupScagDi
    connect CalRegn01Cmn.MotRefMdlFbCtrlDi -> CDD_MotCurrRegVltgLimr.MotRefMdlFbCtrlDi
    connect CalRegn01Cmn.MotRefMdlIvtrDeadTiBrdgVltgSca -> CDD_MotCurrRegVltgLimr.MotRefMdlIvtrDeadTiBrdgVltgSca
    connect CalRegn01Cmn.MotRplCoggCmdHrmncOrder{1..3}Elec -> CDD_MotRplCoggCmd.MotRplCoggCmdHrmncOrder{1..3}Elec
    connect CalRegn01Cmn.SinVltgGennDthrLpFilCoeff -> CDD_SinVltgGenn.SinVltgGennDthrLpFilCoeff
    connect CalRegn01Cmn.CurrMeasEolFixdPwmPerd -> CDD_TSG31CfgAndUse.CurrMeasEolFixdPwmPerd
    connect CalRegn01Cmn.CurrMeasEolOffsHiCmuOffs -> CDD_TSG31CfgAndUse.CurrMeasEolOffsHiCmuOffs
    connect CalRegn01Cmn.CurrMeasEolOffsLoCmuOffs -> CDD_TSG31CfgAndUse.CurrMeasEolOffsLoCmuOffs
    connect CalRegn01Cmn.TSG31CfgAndUseAdcStrtOfCnvn2Offs -> CDD_TSG31CfgAndUse.TSG31CfgAndUseAdcStrtOfCnvn2Offs
    connect CalRegn01Cmn.TSG31CfgAndUseAdcStrtOfCnvnMotCtrlPeakOffs -> CDD_TSG31CfgAndUse.TSG31CfgAndUseAdcStrtOfCnvnMotCtrlPeakOffs
    connect CalRegn01Cmn.TSG31CfgAndUseAdcStrtOfCnvnMotCtrlVlyOffs -> CDD_TSG31CfgAndUse.TSG31CfgAndUseAdcStrtOfCnvnMotCtrlVlyOffs
    connect CalRegn01Cmn.TSG31CfgAndUseMtrAg0SPIStart -> CDD_TSG31CfgAndUse.TSG31CfgAndUseMtrAg0SPIStart
    connect CalRegn01Cmn.TSG31CfgAndUsePwmDbnd -> CDD_TSG31CfgAndUse.TSG31CfgAndUsePwmDbnd
    connect CalRegn01Cmn.CmnMfgSrvSecuAcsAtmptTiOut -> CmnMfgSrv.CmnMfgSrvSecuAcsAtmptTiOut
    connect CalRegn01Cmn.CmnMfgSrvSecuAcsMaxNrAtmpt -> CmnMfgSrv.CmnMfgSrvSecuAcsMaxNrAtmpt
    connect CalRegn01Cmn.CmplncErrHwAgNonLinCmplncDepTblY -> CmplncErr.CmplncErrHwAgNonLinCmplncDepTblY
    connect CalRegn01Cmn.CmplncErrHwAgNonLinCmplncIndTblX -> CmplncErr.CmplncErrHwAgNonLinCmplncIndTblX
    connect CalRegn01Cmn.CmplncErrMotAgNonLinCmplncDepTblY -> CmplncErr.CmplncErrMotAgNonLinCmplncDepTblY
    connect CalRegn01Cmn.CmplncErrMotAgNonLinCmplncIndTblX -> CmplncErr.CmplncErrMotAgNonLinCmplncIndTblX
    connect CalRegn01Cmn.CurrMeasCorrlnMaxErrCurr -> CurrMeasCorrln.CurrMeasCorrlnMaxErrCurr
    connect CalRegn01Cmn.CurrMeasCorrlnMaxStallCntr -> CurrMeasCorrln.CurrMeasCorrlnMaxStallCntr
    connect CalRegn01Cmn.CurrMeasCorrlnNtc0x04DFailStep -> CurrMeasCorrln.CurrMeasCorrlnNtc0x04DFailStep
    connect CalRegn01Cmn.CurrMeasCorrlnNtc0x04DPassStep -> CurrMeasCorrln.CurrMeasCorrlnNtc0x04DPassStep
    connect CalRegn01Cmn.CurrMeasCorrlnNtc0x04EFailStep -> CurrMeasCorrln.CurrMeasCorrlnNtc0x04EFailStep
    connect CalRegn01Cmn.CurrMeasCorrlnNtc0x04EPassStep -> CurrMeasCorrln.CurrMeasCorrlnNtc0x04EPassStep
    connect CalRegn01Cmn.SysGlbPrmVehSpdBilnrSeln -> Dampg.SysGlbPrmVehSpdBilnrSeln
    connect CalRegn01Cmn.DampgPahFwlAssiAddlDampgX -> DampgPahFwl.DampgPahFwlAssiAddlDampgX
    connect CalRegn01Cmn.DampgPahFwlAssiAddlDampgY -> DampgPahFwl.DampgPahFwlAssiAddlDampgY
    connect CalRegn01Cmn.DampgPahFwlDampgCmdAddlDampgX -> DampgPahFwl.DampgPahFwlDampgCmdAddlDampgX
    connect CalRegn01Cmn.DampgPahFwlDampgCmdAddlDampgY -> DampgPahFwl.DampgPahFwlDampgCmdAddlDampgY
    connect CalRegn01Cmn.DampgPahFwlDampgCmdFwlOverLimDiagcFailStep -> DampgPahFwl.DampgPahFwlDampgCmdFwlOverLimDiagcFailStep
    connect CalRegn01Cmn.DampgPahFwlDampgCmdFwlOverLimDiagcPassStep -> DampgPahFwl.DampgPahFwlDampgCmdFwlOverLimDiagcPassStep
    connect CalRegn01Cmn.DampgPahFwlDftDampgX -> DampgPahFwl.DampgPahFwlDftDampgX
    connect CalRegn01Cmn.DampgPahFwlInertiaCmpCmdFwlOverLimDiagcFailStep -> DampgPahFwl.DampgPahFwlInertiaCmpCmdFwlOverLimDiagcFailStep
    connect CalRegn01Cmn.DampgPahFwlInertiaCmpCmdFwlOverLimDiagcPassStep -> DampgPahFwl.DampgPahFwlInertiaCmpCmdFwlOverLimDiagcPassStep
    connect CalRegn01Cmn.DampgPahFwlVehSpd -> DampgPahFwl.DampgPahFwlVehSpd
    connect CalRegn01Cmn.DutyCycThermProtnAbsltCtrlTTblX -> DutyCycThermProtn.DutyCycThermProtnAbsltCtrlTTblX
    connect CalRegn01Cmn.DutyCycThermProtnAbsltCtrlTTqTblY -> DutyCycThermProtn.DutyCycThermProtnAbsltCtrlTTqTblY
    connect CalRegn01Cmn.DutyCycThermProtnAbsltCuTTblX -> DutyCycThermProtn.DutyCycThermProtnAbsltCuTTblX
    connect CalRegn01Cmn.DutyCycThermProtnAbsltCuTTqTblY -> DutyCycThermProtn.DutyCycThermProtnAbsltCuTTqTblY
    connect CalRegn01Cmn.DutyCycThermProtnAbsltMotVelBreakPt -> DutyCycThermProtn.DutyCycThermProtnAbsltMotVelBreakPt
    connect CalRegn01Cmn.DutyCycThermProtnAbsltTTqSlewHiLim -> DutyCycThermProtn.DutyCycThermProtnAbsltTTqSlewHiLim
    connect CalRegn01Cmn.DutyCycThermProtnAbsltTTqSlewLoLim -> DutyCycThermProtn.DutyCycThermProtnAbsltTTqSlewLoLim
    connect CalRegn01Cmn.DutyCycThermProtnCtrlT -> DutyCycThermProtn.DutyCycThermProtnCtrlT
    connect CalRegn01Cmn.DutyCycThermProtnCtrlTSeln -> DutyCycThermProtn.DutyCycThermProtnCtrlTSeln
    connect CalRegn01Cmn.DutyCycThermProtnDutyCycFildThd -> DutyCycThermProtn.DutyCycThermProtnDutyCycFildThd
    connect CalRegn01Cmn.DutyCycThermProtnIgnOffCtrlEna -> DutyCycThermProtn.DutyCycThermProtnIgnOffCtrlEna
    connect CalRegn01Cmn.DutyCycThermProtnIgnOffMsgWaitTi -> DutyCycThermProtn.DutyCycThermProtnIgnOffMsgWaitTi
    connect CalRegn01Cmn.DutyCycThermProtnLstTblValNonStall -> DutyCycThermProtn.DutyCycThermProtnLstTblValNonStall
    connect CalRegn01Cmn.DutyCycThermProtnLstTblValStall -> DutyCycThermProtn.DutyCycThermProtnLstTblValStall
    connect CalRegn01Cmn.DutyCycThermProtnMotPrTSeln -> DutyCycThermProtn.DutyCycThermProtnMotPrTSeln
    connect CalRegn01Cmn.DutyCycThermProtnMplr1NonStallTblY -> DutyCycThermProtn.DutyCycThermProtnMplr1NonStallTblY
    connect CalRegn01Cmn.DutyCycThermProtnMplr1StallTblY -> DutyCycThermProtn.DutyCycThermProtnMplr1StallTblY
    connect CalRegn01Cmn.DutyCycThermProtnMplr2NonStallTblY -> DutyCycThermProtn.DutyCycThermProtnMplr2NonStallTblY
    connect CalRegn01Cmn.DutyCycThermProtnMplr2StallTblY -> DutyCycThermProtn.DutyCycThermProtnMplr2StallTblY
    connect CalRegn01Cmn.DutyCycThermProtnMplr3NonStallTblY -> DutyCycThermProtn.DutyCycThermProtnMplr3NonStallTblY
    connect CalRegn01Cmn.DutyCycThermProtnMplr3StallTblY -> DutyCycThermProtn.DutyCycThermProtnMplr3StallTblY
    connect CalRegn01Cmn.DutyCycThermProtnMplr4NonStallTblY -> DutyCycThermProtn.DutyCycThermProtnMplr4NonStallTblY
    connect CalRegn01Cmn.DutyCycThermProtnMplr4StallTblY -> DutyCycThermProtn.DutyCycThermProtnMplr4StallTblY
    connect CalRegn01Cmn.DutyCycThermProtnMplr5NonStallTblY -> DutyCycThermProtn.DutyCycThermProtnMplr5NonStallTblY
    connect CalRegn01Cmn.DutyCycThermProtnMplr5StallTblY -> DutyCycThermProtn.DutyCycThermProtnMplr5StallTblY
    connect CalRegn01Cmn.DutyCycThermProtnMplr6NonStallTblY -> DutyCycThermProtn.DutyCycThermProtnMplr6NonStallTblY
    connect CalRegn01Cmn.DutyCycThermProtnMplr6StallTblY -> DutyCycThermProtn.DutyCycThermProtnMplr6StallTblY
    connect CalRegn01Cmn.DutyCycThermProtnMplrTblX -> DutyCycThermProtn.DutyCycThermProtnMplrTblX
    connect CalRegn01Cmn.DutyCycThermProtnMplrTSeln -> DutyCycThermProtn.DutyCycThermProtnMplrTSeln
    connect CalRegn01Cmn.DutyCycThermProtnSlowFilTSeln -> DutyCycThermProtn.DutyCycThermProtnSlowFilTSeln
    connect CalRegn01Cmn.DutyCycThermProtnThermLoadLimTblX -> DutyCycThermProtn.DutyCycThermProtnThermLoadLimTblX
    connect CalRegn01Cmn.DutyCycThermProtnThermLoadLimTblY -> DutyCycThermProtn.DutyCycThermProtnThermLoadLimTblY
    connect CalRegn01Cmn.DutyCycThermProtnTqCmdSlewDwn -> DutyCycThermProtn.DutyCycThermProtnTqCmdSlewDwn
    connect CalRegn01Cmn.DutyCycThermProtnTqCmdSlewUp -> DutyCycThermProtn.DutyCycThermProtnTqCmdSlewUp
    connect CalRegn01Cmn.EcuTMeasDftT -> EcuTMeas.EcuTMeasDftT
    connect CalRegn01Cmn.EcuTMeasFilTau -> EcuTMeas.EcuTMeasFilTau
    connect CalRegn01Cmn.EcuTMeasNtc0x045FailStep -> EcuTMeas.EcuTMeasNtc0x045FailStep
    connect CalRegn01Cmn.EcuTMeasNtc0x045PassStep -> EcuTMeas.EcuTMeasNtc0x045PassStep
    connect CalRegn01Cmn.EcuTMeasRngDiagcMax -> EcuTMeas.EcuTMeasRngDiagcMax
    connect CalRegn01Cmn.EcuTMeasRngDiagcMin -> EcuTMeas.EcuTMeasRngDiagcMin
    connect CalRegn01Cmn.EcuTMeasScag -> EcuTMeas.EcuTMeasScag
    connect CalRegn01Cmn.EcuTMeasScagOffs -> EcuTMeas.EcuTMeasScagOffs
    connect CalRegn01Cmn.EotLrngHwAgOverTrvlCnt -> EotLrng.EotLrngHwAgOverTrvlCnt
    connect CalRegn01Cmn.EotProtnFwlEotDampgActvBndX -> EotProtnFwl.EotProtnFwlEotDampgActvBndX
    connect CalRegn01Cmn.EotProtnFwlInactvLim -> EotProtnFwl.EotProtnFwlInactvLim
    connect CalRegn01Cmn.EotProtnFwlVehSpd -> EotProtnFwl.EotProtnFwlVehSpd
    connect CalRegn01Cmn.GateDrv0CtrlNtcNr0x050FailStep -> GateDrv0Ctrl.GateDrv0CtrlNtcNr0x050FailStep
    connect CalRegn01Cmn.GateDrv0CtrlNtcNr0x050PassStep -> GateDrv0Ctrl.GateDrv0CtrlNtcNr0x050PassStep
    connect CalRegn01Cmn.GateDrv0CtrlNtcNr0x051FailStep -> GateDrv0Ctrl.GateDrv0CtrlNtcNr0x051FailStep
    connect CalRegn01Cmn.GateDrv0CtrlNtcNr0x051PassStep -> GateDrv0Ctrl.GateDrv0CtrlNtcNr0x051PassStep
    connect CalRegn01Cmn.GateDrv0CtrlNtcNr0x055FailStep -> GateDrv0Ctrl.GateDrv0CtrlNtcNr0x055FailStep
    connect CalRegn01Cmn.GateDrv0CtrlNtcNr0x055PassStep -> GateDrv0Ctrl.GateDrv0CtrlNtcNr0x055PassStep
    connect CalRegn01Cmn.GateDrv0CtrlUnit0Cfg{2..4}WrVal -> GateDrv0Ctrl.GateDrv0CtrlUnit0Cfg{2..4}WrVal
    connect CalRegn01Cmn.GateDrv0CtrlUnit0Cfg7WrVal -> GateDrv0Ctrl.GateDrv0CtrlUnit0Cfg7WrVal
    connect CalRegn01Cmn.GateDrv1CtrlNtcNr0x060FailStep -> GateDrv1Ctrl.GateDrv1CtrlNtcNr0x060FailStep
    connect CalRegn01Cmn.GateDrv1CtrlNtcNr0x060PassStep -> GateDrv1Ctrl.GateDrv1CtrlNtcNr0x060PassStep
    connect CalRegn01Cmn.GateDrv1CtrlNtcNr0x061FailStep -> GateDrv1Ctrl.GateDrv1CtrlNtcNr0x061FailStep
    connect CalRegn01Cmn.GateDrv1CtrlNtcNr0x061PassStep -> GateDrv1Ctrl.GateDrv1CtrlNtcNr0x061PassStep
    connect CalRegn01Cmn.GateDrv1CtrlNtcNr0x065FailStep -> GateDrv1Ctrl.GateDrv1CtrlNtcNr0x065FailStep
    connect CalRegn01Cmn.GateDrv1CtrlNtcNr0x065PassStep -> GateDrv1Ctrl.GateDrv1CtrlNtcNr0x065PassStep
    connect CalRegn01Cmn.GateDrv1CtrlUnit1Cfg{2..4}WrVal -> GateDrv1Ctrl.GateDrv1CtrlUnit1Cfg{2..4}WrVal
    connect CalRegn01Cmn.GateDrv1CtrlUnit1Cfg7WrVal -> GateDrv1Ctrl.GateDrv1CtrlUnit1Cfg7WrVal
    connect CalRegn01Cmn.GmFctDiArbnEotHwAgThd -> GmFctDiArbn.GmFctDiArbnEotHwAgThd
    connect CalRegn01Cmn.GmFctDiArbnEotTi -> GmFctDiArbn.GmFctDiArbnEotTi
    connect CalRegn01Cmn.GmFctDiArbnOnCentrHwAgThd -> GmFctDiArbn.GmFctDiArbnOnCentrHwAgThd
    connect CalRegn01Cmn.GmFctDiArbnOnCentrHwTqThd -> GmFctDiArbn.GmFctDiArbnOnCentrHwTqThd
    connect CalRegn01Cmn.GmFctDiArbnOnCentrTi -> GmFctDiArbn.GmFctDiArbnOnCentrTi
    connect CalRegn01Cmn.GmFctDiArbnSrvTi -> GmFctDiArbn.GmFctDiArbnSrvTi
    connect CalRegn01Cmn.GmMsg0C5BusHiSpdInvldTiOut -> GmMsg0C5BusHiSpd.GmMsg0C5BusHiSpdInvldTiOut
    connect CalRegn01Cmn.GmMsg0C5BusHiSpdMissTiOut -> GmMsg0C5BusHiSpd.GmMsg0C5BusHiSpdMissTiOut
    connect CalRegn01Cmn.GmMsg0C5BusHiSpdRstTiOut -> GmMsg0C5BusHiSpd.GmMsg0C5BusHiSpdRstTiOut
    connect CalRegn01Cmn.GmMsg0C5BusHiSpdSeqNrTiOut -> GmMsg0C5BusHiSpd.GmMsg0C5BusHiSpdSeqNrTiOut
    connect CalRegn01Cmn.GmMsg0C9BusHiSpdInvldTiOut -> GmMsg0C9BusHiSpd.GmMsg0C9BusHiSpdInvldTiOut
    connect CalRegn01Cmn.GmMsg0C9BusHiSpdMissTiOut -> GmMsg0C9BusHiSpd.GmMsg0C9BusHiSpdMissTiOut
    connect CalRegn01Cmn.GmMsg0C9BusHiSpdVehSpdThd -> GmMsg0C9BusHiSpd.GmMsg0C9BusHiSpdVehSpdThd
    connect CalRegn01Cmn.GmMsg17DBusHiSpdInvldTiOut -> GmMsg17DBusHiSpd.GmMsg17DBusHiSpdInvldTiOut
    connect CalRegn01Cmn.GmMsg17DBusHiSpdMissTiOut -> GmMsg17DBusHiSpd.GmMsg17DBusHiSpdMissTiOut
    connect CalRegn01Cmn.GmMsg180BusChassisExpInvldProtnValTiOut -> GmMsg180BusChassisExp.GmMsg180BusChassisExpInvldProtnValTiOut
    connect CalRegn01Cmn.GmMsg180BusChassisExpMissTiOut -> GmMsg180BusChassisExp.GmMsg180BusChassisExpMissTiOut
    connect CalRegn01Cmn.GmMsg180BusChassisExpRollgCntrInvldTiOut -> GmMsg180BusChassisExp.GmMsg180BusChassisExpRollgCntrInvldTiOut
    connect CalRegn01Cmn.GmMsg180BusChassisExpTqPolarity -> GmMsg180BusChassisExp.GmMsg180BusChassisExpTqPolarity
    connect CalRegn01Cmn.GmMsg180BusHiSpdCrcInvldTiOut -> GmMsg180BusHiSpd.GmMsg180BusHiSpdCrcInvldTiOut
    connect CalRegn01Cmn.GmMsg180BusHiSpdMissTiOut -> GmMsg180BusHiSpd.GmMsg180BusHiSpdMissTiOut
    connect CalRegn01Cmn.GmMsg180BusHiSpdRollgCntrInvldTiOut -> GmMsg180BusHiSpd.GmMsg180BusHiSpdRollgCntrInvldTiOut
    connect CalRegn01Cmn.GmMsg180BusHiSpdTqPolarity -> GmMsg180BusHiSpd.GmMsg180BusHiSpdTqPolarity
    connect CalRegn01Cmn.GmMsg182BusChassisExpInvldTiOut -> GmMsg182BusChassisExp.GmMsg182BusChassisExpInvldTiOut
    connect CalRegn01Cmn.GmMsg182BusChassisExpMissTiOut -> GmMsg182BusChassisExp.GmMsg182BusChassisExpMissTiOut
    connect CalRegn01Cmn.GmMsg184BusHiSpdTqPolarity -> GmMsg184BusHiSpd.GmMsg184BusHiSpdTqPolarity
    connect CalRegn01Cmn.LoaMgrHwTqIdptSigFltThd -> GmMsg184BusHiSpd.LoaMgrHwTqIdptSigFltThd
    connect CalRegn01Cmn.GmMsg1CaBusChassisExpTqPolarity -> GmMsg1CABusChassisExp.GmMsg1CaBusChassisExpTqPolarity
    connect CalRegn01Cmn.GmMsg1E9BusHiSpdAbsFaildTiOut -> GmMsg1E9BusHiSpd.GmMsg1E9BusHiSpdAbsFaildTiOut
    connect CalRegn01Cmn.GmMsg1E9BusHiSpdLatADft -> GmMsg1E9BusHiSpd.GmMsg1E9BusHiSpdLatADft
    connect CalRegn01Cmn.GmMsg1E9BusHiSpdLatAInvldTiOut -> GmMsg1E9BusHiSpd.GmMsg1E9BusHiSpdLatAInvldTiOut
    connect CalRegn01Cmn.GmMsg1E9BusHiSpdMissTiOut -> GmMsg1E9BusHiSpd.GmMsg1E9BusHiSpdMissTiOut
    connect CalRegn01Cmn.GmMsg1E9BusHiSpdTcsDisadTiOut -> GmMsg1E9BusHiSpd.GmMsg1E9BusHiSpdTcsDisadTiOut
    connect CalRegn01Cmn.GmMsg1E9BusHiSpdVehDynCtrlStTiOut -> GmMsg1E9BusHiSpd.GmMsg1E9BusHiSpdVehDynCtrlStTiOut
    connect CalRegn01Cmn.GmMsg1E9BusHiSpdVehStabyEnhmtActvVldTiOut -> GmMsg1E9BusHiSpd.GmMsg1E9BusHiSpdVehStabyEnhmtActvVldTiOut
    connect CalRegn01Cmn.GmMsg1E9BusHiSpdYawRateDft -> GmMsg1E9BusHiSpd.GmMsg1E9BusHiSpdYawRateDft
    connect CalRegn01Cmn.GmMsg1E9BusHiSpdYawRateInvldTiOut -> GmMsg1E9BusHiSpd.GmMsg1E9BusHiSpdYawRateInvldTiOut
    connect CalRegn01Cmn.GmMsg1F1BusHiSpdMissTiOut -> GmMsg1F1BusHiSpd.GmMsg1F1BusHiSpdMissTiOut
    connect CalRegn01Cmn.GmMsg1F5BusHiSpdInvldTiOut -> GmMsg1F5BusHiSpd.GmMsg1F5BusHiSpdInvldTiOut
    connect CalRegn01Cmn.GmMsg1F5BusHiSpdMissTiOut -> GmMsg1F5BusHiSpd.GmMsg1F5BusHiSpdMissTiOut
    connect CalRegn01Cmn.GmMsg214BusHiSpdAbsActvProtdInvldTiOut -> GmMsg214BusHiSpd.GmMsg214BusHiSpdAbsActvProtdInvldTiOut
    connect CalRegn01Cmn.GmMsg214BusHiSpdAbsActvProtdProtnValInvldTiOut -> GmMsg214BusHiSpd.GmMsg214BusHiSpdAbsActvProtdProtnValInvldTiOut
    connect CalRegn01Cmn.GmMsg214BusHiSpdAbsActvProtdRollgCntrInvldTiOut -> GmMsg214BusHiSpd.GmMsg214BusHiSpdAbsActvProtdRollgCntrInvldTiOut
    connect CalRegn01Cmn.GmMsg214BusHiSpdMissTiOut -> GmMsg214BusHiSpd.GmMsg214BusHiSpdMissTiOut
    connect CalRegn01Cmn.GmMsg214BusHiSpdRdntVehStabyEnhmtActvInvldTiOut -> GmMsg214BusHiSpd.GmMsg214BusHiSpdRdntVehStabyEnhmtActvInvldTiOut
    connect CalRegn01Cmn.GmMsg214BusHiSpdRdntVehStabyEnhmtActvRollgCntrInvldTiOut -> GmMsg214BusHiSpd.GmMsg214BusHiSpdRdntVehStabyEnhmtActvRollgCntrInvldTiOut
    connect CalRegn01Cmn.GmMsg232BusHiSpdMissTiOut -> GmMsg232BusHiSpd.GmMsg232BusHiSpdMissTiOut
    connect CalRegn01Cmn.LoaMgrHwTqIdptSigFltThd -> GmMsg335BusChassisExp.LoaMgrHwTqIdptSigFltThd
    connect CalRegn01Cmn.GmMsg337BusChassisExpInvldDiagcTiOut -> GmMsg337BusChassisExp.GmMsg337BusChassisExpInvldDiagcTiOut
    connect CalRegn01Cmn.GmMsg337BusChassisExpInvldProtnValTiOut -> GmMsg337BusChassisExp.GmMsg337BusChassisExpInvldProtnValTiOut
    connect CalRegn01Cmn.GmMsg337BusChassisExpInvldRollgCntrTiOut -> GmMsg337BusChassisExp.GmMsg337BusChassisExpInvldRollgCntrTiOut
    connect CalRegn01Cmn.GmMsg337BusChassisExpMissTiOut -> GmMsg337BusChassisExp.GmMsg337BusChassisExpMissTiOut
    connect CalRegn01Cmn.GmMsg337BusChassisExpTarAgPolarity -> GmMsg337BusChassisExp.GmMsg337BusChassisExpTarAgPolarity
    connect CalRegn01Cmn.GmMsg348BusChassisExpInvldTiOut -> GmMsg348BusChassisExp.GmMsg348BusChassisExpInvldTiOut
    connect CalRegn01Cmn.GmMsg348BusChassisExpMissTiOut -> GmMsg348BusChassisExp.GmMsg348BusChassisExpMissTiOut
    connect CalRegn01Cmn.GmMsg348BusChassisExpStuckTiOut -> GmMsg348BusChassisExp.GmMsg348BusChassisExpStuckTiOut
    connect CalRegn01Cmn.GmMsg348BusHiSpdInvldTiOut -> GmMsg348BusHiSpd.GmMsg348BusHiSpdInvldTiOut
    connect CalRegn01Cmn.GmMsg348BusHiSpdMissTiOut -> GmMsg348BusHiSpd.GmMsg348BusHiSpdMissTiOut
    connect CalRegn01Cmn.GmMsg348BusHiSpdStuckTiOut -> GmMsg348BusHiSpd.GmMsg348BusHiSpdStuckTiOut
    connect CalRegn01Cmn.GmMsg34ABusChassisExpInvldTiOut -> GmMsg34ABusChassisExp.GmMsg34ABusChassisExpInvldTiOut
    connect CalRegn01Cmn.GmMsg34ABusChassisExpMissTiOut -> GmMsg34ABusChassisExp.GmMsg34ABusChassisExpMissTiOut
    connect CalRegn01Cmn.GmMsg34ABusChassisExpStuckTiOut -> GmMsg34ABusChassisExp.GmMsg34ABusChassisExpStuckTiOut
    connect CalRegn01Cmn.GmMsg34ABusHiSpdInvldTiOut -> GmMsg34ABusHiSpd.GmMsg34ABusHiSpdInvldTiOut
    connect CalRegn01Cmn.GmMsg34ABusHiSpdMissTiOut -> GmMsg34ABusHiSpd.GmMsg34ABusHiSpdMissTiOut
    connect CalRegn01Cmn.GmMsg34ABusHiSpdStuckTiOut -> GmMsg34ABusHiSpd.GmMsg34ABusHiSpdStuckTiOut
    connect CalRegn01Cmn.GmMsg3F1BusHiSpdAmbTDft -> GmMsg3F1BusHiSpd.GmMsg3F1BusHiSpdAmbTDft
    connect CalRegn01Cmn.GmMsg3F1BusHiSpdInvldTiOut -> GmMsg3F1BusHiSpd.GmMsg3F1BusHiSpdInvldTiOut
    connect CalRegn01Cmn.GmMsg3F1BusHiSpdMissTiOut -> GmMsg3F1BusHiSpd.GmMsg3F1BusHiSpdMissTiOut
    connect CalRegn01Cmn.GmMsg4D1BusHiSpdEngOilTDft -> GmMsg4D1BusHiSpd.GmMsg4D1BusHiSpdEngOilTDft
    connect CalRegn01Cmn.GmMsg4D1BusHiSpdInvldTiOut -> GmMsg4D1BusHiSpd.GmMsg4D1BusHiSpdInvldTiOut
    connect CalRegn01Cmn.GmMsg4D1BusHiSpdMissTiOut -> GmMsg4D1BusHiSpd.GmMsg4D1BusHiSpdMissTiOut
    connect CalRegn01Cmn.GmMsg500BusHiSpdMissTiOut -> GmMsg500BusHiSpd.GmMsg500BusHiSpdMissTiOut
    connect CalRegn01Cmn.GmMsg500BusHiSpdWhlPlsPerRevDft -> GmMsg500BusHiSpd.GmMsg500BusHiSpdWhlPlsPerRevDft
    connect CalRegn01Cmn.GmMsg500BusHiSpdWhlRotlStsTiStampReslDft -> GmMsg500BusHiSpd.GmMsg500BusHiSpdWhlRotlStsTiStampReslDft
    connect CalRegn01Cmn.SysGlbPrmVehSpdBilnrSeln -> GmTqArbn.SysGlbPrmVehSpdBilnrSeln
    connect CalRegn01Cmn.HwAgArbnHwAgMaxStall -> HwAgArbn.HwAgArbnHwAgMaxStall
    connect CalRegn01Cmn.HwAgCorrlnHwAgAbsltDif -> HwAgCorrln.HwAgCorrlnHwAgAbsltDif
    connect CalRegn01Cmn.HwAgCorrlnHwAgMaxStall -> HwAgCorrln.HwAgCorrlnHwAgMaxStall
    connect CalRegn01Cmn.HwAgCorrlnNtc0x092FailStep -> HwAgCorrln.HwAgCorrlnNtc0x092FailStep
    connect CalRegn01Cmn.HwAgCorrlnNtc0x092PassStep -> HwAgCorrln.HwAgCorrlnNtc0x092PassStep
    connect CalRegn01Cmn.HwAgSnsrlsCorrdPinionAgHwConf -> HwAgSnsrls.HwAgSnsrlsCorrdPinionAgHwConf
    connect CalRegn01Cmn.HwAgSnsrlsFCentrHwConf -> HwAgSnsrls.HwAgSnsrlsFCentrHwConf
    connect CalRegn01Cmn.HwAgSnsrlsPinionTqFilFrq -> HwAgSnsrls.HwAgSnsrlsPinionTqFilFrq
    connect CalRegn01Cmn.HwAgSnsrlsRelHwAgFil1Frq -> HwAgSnsrls.HwAgSnsrlsRelHwAgFil1Frq
    connect CalRegn01Cmn.HwAgSnsrlsRelHwAgFil2Frq -> HwAgSnsrls.HwAgSnsrlsRelHwAgFil2Frq
    connect CalRegn01Cmn.HwAgSnsrlsSmotngCoeff -> HwAgSnsrls.HwAgSnsrlsSmotngCoeff
    connect CalRegn01Cmn.HwAgSnsrlsSmotngStepThd -> HwAgSnsrls.HwAgSnsrlsSmotngStepThd
    connect CalRegn01Cmn.HwAgSnsrlsStordPinionConf -> HwAgSnsrls.HwAgSnsrlsStordPinionConf
    connect CalRegn01Cmn.HwAgSnsrlsStordPinionConfThd -> HwAgSnsrls.HwAgSnsrlsStordPinionConfThd
    connect CalRegn01Cmn.HwAgSnsrlsVehDynDifThd -> HwAgSnsrls.HwAgSnsrlsVehDynDifThd
    connect CalRegn01Cmn.HwAgSnsrlsVehDynHwConf -> HwAgSnsrls.HwAgSnsrlsVehDynHwConf
    connect CalRegn01Cmn.HwAgSnsrlsVehDynMotVelThd -> HwAgSnsrls.HwAgSnsrlsVehDynMotVelThd
    connect CalRegn01Cmn.HwAgSnsrlsVehDynPinionTqThd -> HwAgSnsrls.HwAgSnsrlsVehDynPinionTqThd
    connect CalRegn01Cmn.HwAgSnsrlsVehDynTmr1Thd -> HwAgSnsrls.HwAgSnsrlsVehDynTmr1Thd
    connect CalRegn01Cmn.HwAgSnsrlsVehDynTmr2Thd -> HwAgSnsrls.HwAgSnsrlsVehDynTmr2Thd
    connect CalRegn01Cmn.HwAgSnsrlsWhlFrqThd -> HwAgSnsrls.HwAgSnsrlsWhlFrqThd
    connect CalRegn01Cmn.HwAgSnsrlsWhlSpdHwAgCoeff1 -> HwAgSnsrls.HwAgSnsrlsWhlSpdHwAgCoeff1
    connect CalRegn01Cmn.HwAgSnsrlsWhlSpdHwAgCoeff2 -> HwAgSnsrls.HwAgSnsrlsWhlSpdHwAgCoeff2
    connect CalRegn01Cmn.HwAgSnsrlsWhlSpdHwAgThd -> HwAgSnsrls.HwAgSnsrlsWhlSpdHwAgThd
    connect CalRegn01Cmn.HwAgSnsrlsWhlSpdHwConf -> HwAgSnsrls.HwAgSnsrlsWhlSpdHwConf
    connect CalRegn01Cmn.HwAgSnsrlsWhlSpdRatThd -> HwAgSnsrls.HwAgSnsrlsWhlSpdRatThd
    connect CalRegn01Cmn.HwAgSnsrlsWhlSpdTmrThd -> HwAgSnsrls.HwAgSnsrlsWhlSpdTmrThd
    connect CalRegn01Cmn.HwAgSnsrlsWhlSpdVehSpdThd -> HwAgSnsrls.HwAgSnsrlsWhlSpdVehSpdThd
    connect CalRegn01Cmn.HwAgSysArbnHwAgConf1Snsr -> HwAgSysArbn.HwAgSysArbnHwAgConf1Snsr
    connect CalRegn01Cmn.HwAgSysArbnHwAgConf2Snsr -> HwAgSysArbn.HwAgSysArbnHwAgConf2Snsr
    connect CalRegn01Cmn.HwAgSysArbnHwAgConfNoSnsr -> HwAgSysArbn.HwAgSysArbnHwAgConfNoSnsr
    connect CalRegn01Cmn.HwAgSysArbnHwAgCorrdCorrlnThd -> HwAgSysArbn.HwAgSysArbnHwAgCorrdCorrlnThd
    connect CalRegn01Cmn.HwAgSysArbnHwAgCorrlnFailDebStep -> HwAgSysArbn.HwAgSysArbnHwAgCorrlnFailDebStep
    connect CalRegn01Cmn.HwAgSysArbnHwAgCorrlnPassDebStep -> HwAgSysArbn.HwAgSysArbnHwAgCorrlnPassDebStep
    connect CalRegn01Cmn.HwAgSysArbnHwAgCorrlnRng -> HwAgSysArbn.HwAgSysArbnHwAgCorrlnRng
    connect CalRegn01Cmn.HwAgSysArbnHwAgSlewRate -> HwAgSysArbn.HwAgSysArbnHwAgSlewRate
    connect CalRegn01Cmn.HwAgSysArbnHwAgSnsrlsCorrlnThd -> HwAgSysArbn.HwAgSysArbnHwAgSnsrlsCorrlnThd
    connect CalRegn01Cmn.HwAgSysArbnHwAgSnsrlsKineThd -> HwAgSysArbn.HwAgSysArbnHwAgSnsrlsKineThd
    connect CalRegn01Cmn.HwAgSysArbnHwAgToMotAgCorrlnElpdTiLim -> HwAgSysArbn.HwAgSysArbnHwAgToMotAgCorrlnElpdTiLim
    connect CalRegn01Cmn.HwAgSysArbnSerlComHwAgCorrdConf -> HwAgSysArbn.HwAgSysArbnSerlComHwAgCorrdConf
    connect CalRegn01Cmn.HwAgSysArbnSerlComHwAgSnsrlsConf -> HwAgSysArbn.HwAgSysArbnSerlComHwAgSnsrlsConf
    connect CalRegn01Cmn.HwAgSysArbnSlewRateTmr -> HwAgSysArbn.HwAgSysArbnSlewRateTmr
    connect CalRegn01Cmn.HwAgTrajGennAgMax -> HwAgTrajGenn.HwAgTrajGennAgMax
    connect CalRegn01Cmn.HwAgTrajGennAMax -> HwAgTrajGenn.HwAgTrajGennAMax
    connect CalRegn01Cmn.HwAgTrajGennVelMax -> HwAgTrajGenn.HwAgTrajGennVelMax
    connect CalRegn01Cmn.HwTqArbnMaxStallTqA -> HwTqArbn.HwTqArbnMaxStallTqA
    connect CalRegn01Cmn.HwTqArbnMaxStallTqB -> HwTqArbn.HwTqArbnMaxStallTqB
    connect CalRegn01Cmn.HwTqArbnMaxStallTqC -> HwTqArbn.HwTqArbnMaxStallTqC
    connect CalRegn01Cmn.HwTqArbnMaxStallTqD -> HwTqArbn.HwTqArbnMaxStallTqD
    connect CalRegn01Cmn.HwTqCorrlnChACmnModCmpLpFilActvnThd -> HwTqCorrln.HwTqCorrlnChACmnModCmpLpFilActvnThd
    connect CalRegn01Cmn.HwTqCorrlnChACmnModCmpLpFilFrq -> HwTqCorrln.HwTqCorrlnChACmnModCmpLpFilFrq
    connect CalRegn01Cmn.HwTqCorrlnChACmnModCmpLpFilOutpLim -> HwTqCorrln.HwTqCorrlnChACmnModCmpLpFilOutpLim
    connect CalRegn01Cmn.HwTqCorrlnChAImdtCorrlnChkFailThd -> HwTqCorrln.HwTqCorrlnChAImdtCorrlnChkFailThd
    connect CalRegn01Cmn.HwTqCorrlnChAImdtCorrlnChkPassThd -> HwTqCorrln.HwTqCorrlnChAImdtCorrlnChkPassThd
    connect CalRegn01Cmn.HwTqCorrlnChAStabStClrFltThd -> HwTqCorrln.HwTqCorrlnChAStabStClrFltThd
    connect CalRegn01Cmn.HwTqCorrlnChAStabStLpFilFrq -> HwTqCorrln.HwTqCorrlnChAStabStLpFilFrq
    connect CalRegn01Cmn.HwTqCorrlnChAStabStSetFltThd -> HwTqCorrln.HwTqCorrlnChAStabStSetFltThd
    connect CalRegn01Cmn.HwTqCorrlnChATqSumMaxLim -> HwTqCorrln.HwTqCorrlnChATqSumMaxLim
    connect CalRegn01Cmn.HwTqCorrlnChATraLpFilX -> HwTqCorrln.HwTqCorrlnChATraLpFilX
    connect CalRegn01Cmn.HwTqCorrlnChATraLpFilY -> HwTqCorrln.HwTqCorrlnChATraLpFilY
    connect CalRegn01Cmn.HwTqCorrlnChATraSumClrFltThd -> HwTqCorrln.HwTqCorrlnChATraSumClrFltThd
    connect CalRegn01Cmn.HwTqCorrlnChATraSumSetFltThd -> HwTqCorrln.HwTqCorrlnChATraSumSetFltThd
    connect CalRegn01Cmn.HwTqCorrlnChBCmnModCmpLpFilActvnThd -> HwTqCorrln.HwTqCorrlnChBCmnModCmpLpFilActvnThd
    connect CalRegn01Cmn.HwTqCorrlnChBCmnModCmpLpFilFrq -> HwTqCorrln.HwTqCorrlnChBCmnModCmpLpFilFrq
    connect CalRegn01Cmn.HwTqCorrlnChBCmnModCmpLpFilOutpLim -> HwTqCorrln.HwTqCorrlnChBCmnModCmpLpFilOutpLim
    connect CalRegn01Cmn.HwTqCorrlnChBImdtCorrlnChkFailThd -> HwTqCorrln.HwTqCorrlnChBImdtCorrlnChkFailThd
    connect CalRegn01Cmn.HwTqCorrlnChBImdtCorrlnChkPassThd -> HwTqCorrln.HwTqCorrlnChBImdtCorrlnChkPassThd
    connect CalRegn01Cmn.HwTqCorrlnChBStabStClrFltThd -> HwTqCorrln.HwTqCorrlnChBStabStClrFltThd
    connect CalRegn01Cmn.HwTqCorrlnChBStabStLpFilFrq -> HwTqCorrln.HwTqCorrlnChBStabStLpFilFrq
    connect CalRegn01Cmn.HwTqCorrlnChBStabStSetFltThd -> HwTqCorrln.HwTqCorrlnChBStabStSetFltThd
    connect CalRegn01Cmn.HwTqCorrlnChBTqSumMaxLim -> HwTqCorrln.HwTqCorrlnChBTqSumMaxLim
    connect CalRegn01Cmn.HwTqCorrlnChBTraLpFilX -> HwTqCorrln.HwTqCorrlnChBTraLpFilX
    connect CalRegn01Cmn.HwTqCorrlnChBTraLpFilY -> HwTqCorrln.HwTqCorrlnChBTraLpFilY
    connect CalRegn01Cmn.HwTqCorrlnChBTraSumClrFltThd -> HwTqCorrln.HwTqCorrlnChBTraSumClrFltThd
    connect CalRegn01Cmn.HwTqCorrlnChBTraSumSetFltThd -> HwTqCorrln.HwTqCorrlnChBTraSumSetFltThd
    connect CalRegn01Cmn.HwTqCorrlnMaxStallTqA -> HwTqCorrln.HwTqCorrlnMaxStallTqA
    connect CalRegn01Cmn.HwTqCorrlnMaxStallTqB -> HwTqCorrln.HwTqCorrlnMaxStallTqB
    connect CalRegn01Cmn.HwTqCorrlnMaxStallTqC -> HwTqCorrln.HwTqCorrlnMaxStallTqC
    connect CalRegn01Cmn.HwTqCorrlnMaxStallTqD -> HwTqCorrln.HwTqCorrlnMaxStallTqD
    connect CalRegn01Cmn.SysGlbPrmVehSpdBilnrSeln -> HysCmp.SysGlbPrmVehSpdBilnrSeln
    connect CalRegn01Cmn.SysGlbPrmVehSpdBilnrSeln -> InertiaCmpVel.SysGlbPrmVehSpdBilnrSeln
    connect CalRegn01Cmn.LoaMgrCurrIvtrMtgtnRate -> LoaMgr.LoaMgrCurrIvtrMtgtnRate
    connect CalRegn01Cmn.LoaMgrCurrIvtrMtgtnSca -> LoaMgr.LoaMgrCurrIvtrMtgtnSca
    connect CalRegn01Cmn.LoaMgrCurrIvtrMtgtnScaZeroEna -> LoaMgr.LoaMgrCurrIvtrMtgtnScaZeroEna
    connect CalRegn01Cmn.LoaMgrCurrMeasIdptSig{0..2}Resp -> LoaMgr.LoaMgrCurrMeasIdptSig{0..2}Resp
    connect CalRegn01Cmn.LoaMgrCurrMeasIdptSigFltThd -> LoaMgr.LoaMgrCurrMeasIdptSigFltThd
    connect CalRegn01Cmn.LoaMgrCurrMeasMtgtnRate -> LoaMgr.LoaMgrCurrMeasMtgtnRate
    connect CalRegn01Cmn.LoaMgrCurrMeasMtgtnSca -> LoaMgr.LoaMgrCurrMeasMtgtnSca
    connect CalRegn01Cmn.LoaMgrCurrMeasMtgtnScaZeroEna -> LoaMgr.LoaMgrCurrMeasMtgtnScaZeroEna
    connect CalRegn01Cmn.LoaMgrFadeOutStRate -> LoaMgr.LoaMgrFadeOutStRate
    connect CalRegn01Cmn.LoaMgrHwTqIdptSig0NoTqLoaResp -> LoaMgr.LoaMgrHwTqIdptSig0NoTqLoaResp
    connect CalRegn01Cmn.LoaMgrHwTqIdptSig1NoTqLoaResp -> LoaMgr.LoaMgrHwTqIdptSig1NoTqLoaResp
    connect CalRegn01Cmn.LoaMgrHwTqIdptSig2Resp -> LoaMgr.LoaMgrHwTqIdptSig2Resp
    connect CalRegn01Cmn.LoaMgrHwTqIdptSig4Resp -> LoaMgr.LoaMgrHwTqIdptSig4Resp
    connect CalRegn01Cmn.LoaMgrHwTqIdptSigFltThd -> LoaMgr.LoaMgrHwTqIdptSigFltThd
    connect CalRegn01Cmn.LoaMgrHwTqLoaAvlResp -> LoaMgr.LoaMgrHwTqLoaAvlResp
    connect CalRegn01Cmn.LoaMgrIvtrIdptSig{0..2}Resp -> LoaMgr.LoaMgrIvtrIdptSig{0..2}Resp
    connect CalRegn01Cmn.LoaMgrIvtrIdptSigFltThd -> LoaMgr.LoaMgrIvtrIdptSigFltThd
    connect CalRegn01Cmn.LoaMgrIvtrMtgtnRate -> LoaMgr.LoaMgrIvtrMtgtnRate
    connect CalRegn01Cmn.LoaMgrIvtrMtgtnSca -> LoaMgr.LoaMgrIvtrMtgtnSca
    connect CalRegn01Cmn.LoaMgrIvtrMtgtnScaZeroEna -> LoaMgr.LoaMgrIvtrMtgtnScaZeroEna
    connect CalRegn01Cmn.LoaMgrLimdStRate -> LoaMgr.LoaMgrLimdStRate
    connect CalRegn01Cmn.LoaMgrLimdStSca -> LoaMgr.LoaMgrLimdStSca
    connect CalRegn01Cmn.LoaMgrMotAgAvlSnsrlsResp -> LoaMgr.LoaMgrMotAgAvlSnsrlsResp
    connect CalRegn01Cmn.LoaMgrMotAgIdptSig0NoSnsrlsResp -> LoaMgr.LoaMgrMotAgIdptSig0NoSnsrlsResp
    connect CalRegn01Cmn.LoaMgrMotAgIdptSig1NoSnsrlsResp -> LoaMgr.LoaMgrMotAgIdptSig1NoSnsrlsResp
    connect CalRegn01Cmn.LoaMgrMotAgIdptSig2Resp -> LoaMgr.LoaMgrMotAgIdptSig2Resp
    connect CalRegn01Cmn.LoaMgrMotAgIdptSig3Resp -> LoaMgr.LoaMgrMotAgIdptSig3Resp
    connect CalRegn01Cmn.LoaMgrMotAgIdptSigFltThd -> LoaMgr.LoaMgrMotAgIdptSigFltThd
    connect CalRegn01Cmn.LoaMgrMotAgMtgtnRate -> LoaMgr.LoaMgrMotAgMtgtnRate
    connect CalRegn01Cmn.LoaMgrMotAgMtgtnSca -> LoaMgr.LoaMgrMotAgMtgtnSca
    connect CalRegn01Cmn.LoaMgrMotAgMtgtnScaZeroEna -> LoaMgr.LoaMgrMotAgMtgtnScaZeroEna
    connect CalRegn01Cmn.MotAg2MeasOffs -> MotAg2Meas.MotAg2MeasOffs
    connect CalRegn01Cmn.MotCtrlPrmEstimnFetRNom -> MotCtrlPrmEstimn.MotCtrlPrmEstimnFetRNom
    connect CalRegn01Cmn.MotCtrlPrmEstimnFetThermCoeff -> MotCtrlPrmEstimn.MotCtrlPrmEstimnFetThermCoeff
    connect CalRegn01Cmn.MotCtrlPrmEstimnMagThermCoeff -> MotCtrlPrmEstimn.MotCtrlPrmEstimnMagThermCoeff
    connect CalRegn01Cmn.MotCtrlPrmEstimnMotBackEmfConHiLim -> MotCtrlPrmEstimn.MotCtrlPrmEstimnMotBackEmfConHiLim
    connect CalRegn01Cmn.MotCtrlPrmEstimnMotBackEmfConLoLim -> MotCtrlPrmEstimn.MotCtrlPrmEstimnMotBackEmfConLoLim
    connect CalRegn01Cmn.MotCtrlPrmEstimnMotBackEmfConNom -> MotCtrlPrmEstimn.MotCtrlPrmEstimnMotBackEmfConNom
    connect CalRegn01Cmn.MotCtrlPrmEstimnMotBackEmfConSatnScaIvtrLoaMtgtn -> MotCtrlPrmEstimn.MotCtrlPrmEstimnMotBackEmfConSatnScaIvtrLoaMtgtn
    connect CalRegn01Cmn.MotCtrlPrmEstimnMotBackEmfConSatnX -> MotCtrlPrmEstimn.MotCtrlPrmEstimnMotBackEmfConSatnX
    connect CalRegn01Cmn.MotCtrlPrmEstimnMotBackEmfConSatnY -> MotCtrlPrmEstimn.MotCtrlPrmEstimnMotBackEmfConSatnY
    connect CalRegn01Cmn.MotCtrlPrmEstimnMotCurrDaxInduSatnBilnrSeln -> MotCtrlPrmEstimn.MotCtrlPrmEstimnMotCurrDaxInduSatnBilnrSeln
    connect CalRegn01Cmn.MotCtrlPrmEstimnMotCurrQaxInduSatnX -> MotCtrlPrmEstimn.MotCtrlPrmEstimnMotCurrQaxInduSatnX
    connect CalRegn01Cmn.MotCtrlPrmEstimnMotInduDaxHiLim -> MotCtrlPrmEstimn.MotCtrlPrmEstimnMotInduDaxHiLim
    connect CalRegn01Cmn.MotCtrlPrmEstimnMotInduDaxIvtrLoaMtgtn -> MotCtrlPrmEstimn.MotCtrlPrmEstimnMotInduDaxIvtrLoaMtgtn
    connect CalRegn01Cmn.MotCtrlPrmEstimnMotInduDaxLoLim -> MotCtrlPrmEstimn.MotCtrlPrmEstimnMotInduDaxLoLim
    connect CalRegn01Cmn.MotCtrlPrmEstimnMotInduDaxNom -> MotCtrlPrmEstimn.MotCtrlPrmEstimnMotInduDaxNom
    connect CalRegn01Cmn.MotCtrlPrmEstimnMotInduDaxSatnScaY -> MotCtrlPrmEstimn.MotCtrlPrmEstimnMotInduDaxSatnScaY
    connect CalRegn01Cmn.MotCtrlPrmEstimnMotInduQaxHiLim -> MotCtrlPrmEstimn.MotCtrlPrmEstimnMotInduQaxHiLim
    connect CalRegn01Cmn.MotCtrlPrmEstimnMotInduQaxIvtrLoaMtgtn -> MotCtrlPrmEstimn.MotCtrlPrmEstimnMotInduQaxIvtrLoaMtgtn
    connect CalRegn01Cmn.MotCtrlPrmEstimnMotInduQaxLoLim -> MotCtrlPrmEstimn.MotCtrlPrmEstimnMotInduQaxLoLim
    connect CalRegn01Cmn.MotCtrlPrmEstimnMotInduQaxNom -> MotCtrlPrmEstimn.MotCtrlPrmEstimnMotInduQaxNom
    connect CalRegn01Cmn.MotCtrlPrmEstimnMotInduQaxSatnScaY -> MotCtrlPrmEstimn.MotCtrlPrmEstimnMotInduQaxSatnScaY
    connect CalRegn01Cmn.MotCtrlPrmEstimnMotRHiLim -> MotCtrlPrmEstimn.MotCtrlPrmEstimnMotRHiLim
    connect CalRegn01Cmn.MotCtrlPrmEstimnMotRLoLim -> MotCtrlPrmEstimn.MotCtrlPrmEstimnMotRLoLim
    connect CalRegn01Cmn.MotCtrlPrmEstimnMotRNom -> MotCtrlPrmEstimn.MotCtrlPrmEstimnMotRNom
    connect CalRegn01Cmn.MotCtrlPrmEstimnMotWidgThermCoeff -> MotCtrlPrmEstimn.MotCtrlPrmEstimnMotWidgThermCoeff
    connect CalRegn01Cmn.MotCtrlPrmEstimnTNom -> MotCtrlPrmEstimn.MotCtrlPrmEstimnTNom
    connect CalRegn01Cmn.MotCurrPeakEstimnCurrFilFrq -> MotCurrPeakEstimn.MotCurrPeakEstimnCurrFilFrq
    connect CalRegn01Cmn.MotCurrPeakEstimnCurrPeakEstimdFilFrq -> MotCurrPeakEstimn.MotCurrPeakEstimnCurrPeakEstimdFilFrq
    connect CalRegn01Cmn.MotCurrRegCfgCtrlrDynGainVehSpdCutOff -> MotCurrRegCfg.MotCurrRegCfgCtrlrDynGainVehSpdCutOff
    connect CalRegn01Cmn.MotCurrRegCfgCurrLoopSecOrderTrfFctEna -> MotCurrRegCfg.MotCurrRegCfgCurrLoopSecOrderTrfFctEna
    connect CalRegn01Cmn.MotCurrRegCfgIntglGainSampleTi -> MotCurrRegCfg.MotCurrRegCfgIntglGainSampleTi
    connect CalRegn01Cmn.MotCurrRegCfgMotAgCompuDly -> MotCurrRegCfg.MotCurrRegCfgMotAgCompuDly
    connect CalRegn01Cmn.MotCurrRegCfgMotClsdLoopBwDaxY -> MotCurrRegCfg.MotCurrRegCfgMotClsdLoopBwDaxY
    connect CalRegn01Cmn.MotCurrRegCfgMotClsdLoopBwQaxY -> MotCurrRegCfg.MotCurrRegCfgMotClsdLoopBwQaxY
    connect CalRegn01Cmn.MotCurrRegCfgMotCtrlPrmSelnX -> MotCurrRegCfg.MotCurrRegCfgMotCtrlPrmSelnX
    connect CalRegn01Cmn.MotCurrRegCfgMotDampgRatDax -> MotCurrRegCfg.MotCurrRegCfgMotDampgRatDax
    connect CalRegn01Cmn.MotCurrRegCfgMotDampgRatQax -> MotCurrRegCfg.MotCurrRegCfgMotDampgRatQax
    connect CalRegn01Cmn.MotCurrRegCfgMotNatFrqDaxY -> MotCurrRegCfg.MotCurrRegCfgMotNatFrqDaxY
    connect CalRegn01Cmn.MotCurrRegCfgMotNatFrqQaxY -> MotCurrRegCfg.MotCurrRegCfgMotNatFrqQaxY
    connect CalRegn01Cmn.MotCurrRegCfgMotRVirtDax -> MotCurrRegCfg.MotCurrRegCfgMotRVirtDax
    connect CalRegn01Cmn.MotCurrRegCfgMotRVirtQax -> MotCurrRegCfg.MotCurrRegCfgMotRVirtQax
    connect CalRegn01Cmn.MotCurrRegCfgMotVelFilFrq -> MotCurrRegCfg.MotCurrRegCfgMotVelFilFrq
    connect CalRegn01Cmn.MotRefMdlFbCtrlDi -> MotCurrRegCfg.MotRefMdlFbCtrlDi
    connect CalRegn01Cmn.MotDrvDiagcErrFilFrq -> MotDrvDiagc.MotDrvDiagcErrFilFrq
    connect CalRegn01Cmn.MotDrvDiagcErrOffs -> MotDrvDiagc.MotDrvDiagcErrOffs
    connect CalRegn01Cmn.MotDrvDiagcErrThd -> MotDrvDiagc.MotDrvDiagcErrThd
    connect CalRegn01Cmn.MotQuadDetnMotDirHysInsts -> MotQuadDetn.MotQuadDetnMotDirHysInsts
    connect CalRegn01Cmn.MotRefMdlCurrDaxBoostGain -> MotRefMdl.MotRefMdlCurrDaxBoostGain
    connect CalRegn01Cmn.MotRefMdlCurrDaxBoostTqScaX -> MotRefMdl.MotRefMdlCurrDaxBoostTqScaX
    connect CalRegn01Cmn.MotRefMdlCurrDaxBoostTqScaY -> MotRefMdl.MotRefMdlCurrDaxBoostTqScaY
    connect CalRegn01Cmn.MotRefMdlCurrDaxQaxRefDelta -> MotRefMdl.MotRefMdlCurrDaxQaxRefDelta
    connect CalRegn01Cmn.MotRefMdlCurrItrnTolr -> MotRefMdl.MotRefMdlCurrItrnTolr
    connect CalRegn01Cmn.MotRefMdlFbCtrlDi -> MotRefMdl.MotRefMdlFbCtrlDi
    connect CalRegn01Cmn.MotRefMdlIvtrDeadTiBrdgVltgSca -> MotRefMdl.MotRefMdlIvtrDeadTiBrdgVltgSca
    connect CalRegn01Cmn.MotRefMdlMinCurrItrnLim -> MotRefMdl.MotRefMdlMinCurrItrnLim
    connect CalRegn01Cmn.MotRefMdlMotCurrDaxMaxSca -> MotRefMdl.MotRefMdlMotCurrDaxMaxSca
    connect CalRegn01Cmn.MotRefMdlMotVelLpFilFrq -> MotRefMdl.MotRefMdlMotVelLpFilFrq
    connect CalRegn01Cmn.MotRefMdlMotVltgDerivtvTiCon -> MotRefMdl.MotRefMdlMotVltgDerivtvTiCon
    connect CalRegn01Cmn.MotRefMdlQuad13VltgSdlX -> MotRefMdl.MotRefMdlQuad13VltgSdlX
    connect CalRegn01Cmn.MotRefMdlQuad13VltgSdlY -> MotRefMdl.MotRefMdlQuad13VltgSdlY
    connect CalRegn01Cmn.MotRefMdlQuad24VltgSdlX -> MotRefMdl.MotRefMdlQuad24VltgSdlX
    connect CalRegn01Cmn.MotRefMdlQuad24VltgSdlY -> MotRefMdl.MotRefMdlQuad24VltgSdlY
    connect CalRegn01Cmn.MotRefMdlRefLocnItrnLim -> MotRefMdl.MotRefMdlRefLocnItrnLim
    connect CalRegn01Cmn.MotRefMdlTqItrnLim -> MotRefMdl.MotRefMdlTqItrnLim
    connect CalRegn01Cmn.MotRefMdlTqItrnTolr -> MotRefMdl.MotRefMdlTqItrnTolr
    connect CalRegn01Cmn.MotRefMdlVltgModDynCmpEna -> MotRefMdl.MotRefMdlVltgModDynCmpEna
    connect CalRegn01Cmn.MotRefMdlVltgOverRThdSca -> MotRefMdl.MotRefMdlVltgOverRThdSca
    connect CalRegn01Cmn.MotCtrlPrmEstimnMotBackEmfConNom -> MotRplCoggCfg.MotCtrlPrmEstimnMotBackEmfConNom
    connect CalRegn01Cmn.MotRplCoggCfgMotAgTiDly -> MotRplCoggCfg.MotRplCoggCfgMotAgTiDly
    connect CalRegn01Cmn.MotRplCoggCfgMotCurrDaxRplBilnrSeln -> MotRplCoggCfg.MotRplCoggCfgMotCurrDaxRplBilnrSeln
    connect CalRegn01Cmn.MotRplCoggCfgMotCurrQaxRpl -> MotRplCoggCfg.MotRplCoggCfgMotCurrQaxRpl
    connect CalRegn01Cmn.MotRplCoggCfgMotTqCmdCurrRgltrBwCmpMgnY -> MotRplCoggCfg.MotRplCoggCfgMotTqCmdCurrRgltrBwCmpMgnY
    connect CalRegn01Cmn.MotRplCoggCfgMotTqCmdCurrRgltrBwCmpPhaY -> MotRplCoggCfg.MotRplCoggCfgMotTqCmdCurrRgltrBwCmpPhaY
    connect CalRegn01Cmn.MotRplCoggCfgMotTqCmdCurrRgltrBwCmpX -> MotRplCoggCfg.MotRplCoggCfgMotTqCmdCurrRgltrBwCmpX
    connect CalRegn01Cmn.MotRplCoggCfgMotTqRplOrder1X -> MotRplCoggCfg.MotRplCoggCfgMotTqRplOrder1X
    connect CalRegn01Cmn.MotRplCoggCfgMotTqRplOrder1Y -> MotRplCoggCfg.MotRplCoggCfgMotTqRplOrder1Y
    connect CalRegn01Cmn.MotRplCoggCfgMotTqRplOrder2X -> MotRplCoggCfg.MotRplCoggCfgMotTqRplOrder2X
    connect CalRegn01Cmn.MotRplCoggCfgMotTqRplOrder2Y -> MotRplCoggCfg.MotRplCoggCfgMotTqRplOrder2Y
    connect CalRegn01Cmn.MotRplCoggCfgMotTqRplOrder3X -> MotRplCoggCfg.MotRplCoggCfgMotTqRplOrder3X
    connect CalRegn01Cmn.MotRplCoggCfgMotTqRplOrder3Y -> MotRplCoggCfg.MotRplCoggCfgMotTqRplOrder3Y
    connect CalRegn01Cmn.MotRplCoggCfgMotVelBilnrSeln -> MotRplCoggCfg.MotRplCoggCfgMotVelBilnrSeln
    connect CalRegn01Cmn.MotRplCoggCmdHrmncOrder{1..3}Elec -> MotRplCoggCfg.MotRplCoggCmdHrmncOrder{1..3}Elec
    connect CalRegn01Cmn.MotTqCmdScaMax -> MotTqCmdSca.MotTqCmdScaMax
    connect CalRegn01Cmn.MotTqCmdScaMin -> MotTqCmdSca.MotTqCmdScaMin
    connect CalRegn01Cmn.MotTqTranlDampgVehSpdBlndY -> MotTqTranlDampg.MotTqTranlDampgVehSpdBlndY
    connect CalRegn01Cmn.NxtrCalIdsCal0DevlpAuthor -> NxtrCalIds.NxtrCalIdsCal0DevlpAuthor
    connect CalRegn01Cmn.NxtrCalIdsCal0DevlpDesc -> NxtrCalIds.NxtrCalIdsCal0DevlpDescr
    connect CalRegn01Cmn.NxtrCalIdsCal0DevlpRelNr -> NxtrCalIds.NxtrCalIdsCal0DevlpRelNr
    connect CalRegn01Cmn.NxtrCalIdsCal0DevlpRelSt -> NxtrCalIds.NxtrCalIdsCal0DevlpRelSt
    connect CalRegn01Cmn.NxtrCalIdsCal0DevlpTiStamp -> NxtrCalIds.NxtrCalIdsCal0DevlpTiStamp
    connect CalRegn01Cmn.NxtrCalIdsCal0DevlpVers -> NxtrCalIds.NxtrCalIdsCal0DevlpVers
    connect CalRegn01Cmn.PartNrCmpdVehPartnProdtStruct -> PartNr.PartNrCmpdVehPartnProdtStruct
    connect CalRegn01Cmn.BattVltgSwdMax -> PwrDiscnct.BattVltgSwdMax
    connect CalRegn01Cmn.PwrDiscnctOpenThd -> PwrDiscnct.PwrDiscnctOpenThd
    connect CalRegn01Cmn.PwrLimrAssiRednLpFilFrq -> PwrLimr.PwrLimrAssiRednLpFilFrq
    connect CalRegn01Cmn.PwrLimrBackEmfConStdT -> PwrLimr.PwrLimrBackEmfConStdT
    connect CalRegn01Cmn.PwrLimrBrdgVltgAdjSlew -> PwrLimr.PwrLimrBrdgVltgAdjSlew
    connect CalRegn01Cmn.PwrLimrBrdgVltgAltFltAdj -> PwrLimr.PwrLimrBrdgVltgAltFltAdj
    connect CalRegn01Cmn.PwrLimrFilAssiRednThd -> PwrLimr.PwrLimrFilAssiRednThd
    connect CalRegn01Cmn.PwrLimrLoVoltAssiRcvrThd -> PwrLimr.PwrLimrLoVoltAssiRcvrThd
    connect CalRegn01Cmn.PwrLimrLoVoltAssiRcvrTi -> PwrLimr.PwrLimrLoVoltAssiRcvrTi
    connect CalRegn01Cmn.PwrLimrMotEnvlpX -> PwrLimr.PwrLimrMotEnvlpX
    connect CalRegn01Cmn.PwrLimrMotEnvlpY -> PwrLimr.PwrLimrMotEnvlpY
    connect CalRegn01Cmn.PwrLimrMotVelLpFilFrq -> PwrLimr.PwrLimrMotVelLpFilFrq
    connect CalRegn01Cmn.PwrLimrSpdAdjSlewDec -> PwrLimr.PwrLimrSpdAdjSlewDec
    connect CalRegn01Cmn.PwrLimrSpdAdjSlewEna -> PwrLimr.PwrLimrSpdAdjSlewEna
    connect CalRegn01Cmn.PwrLimrSpdAdjSlewInc -> PwrLimr.PwrLimrSpdAdjSlewInc
    connect CalRegn01Cmn.PwrLimrStdOperMotEnvlpX -> PwrLimr.PwrLimrStdOperMotEnvlpX
    connect CalRegn01Cmn.PwrLimrStdOperMotEnvlpY -> PwrLimr.PwrLimrStdOperMotEnvlpY
    connect CalRegn01Cmn.PwrLimrVltgDptMotVelOffsX -> PwrLimr.PwrLimrVltgDptMotVelOffsX
    connect CalRegn01Cmn.PwrLimrVltgDptMotVelOffsY -> PwrLimr.PwrLimrVltgDptMotVelOffsY
    connect CalRegn01Cmn.PwrSplyNtc0x07BFailStep -> PwrSply.PwrSplyNtc0x07BFailStep
    connect CalRegn01Cmn.PwrSplyNtc0x07BPassStep -> PwrSply.PwrSplyNtc0x07BPassStep
    connect CalRegn01Cmn.PwrSplyNtc0x07CFailStep -> PwrSply.PwrSplyNtc0x07CFailStep
    connect CalRegn01Cmn.PwrSplyNtc0x07CPassStep -> PwrSply.PwrSplyNtc0x07CPassStep
    connect CalRegn01Cmn.PwrSplyNtc0x07DFailStep -> PwrSply.PwrSplyNtc0x07DFailStep
    connect CalRegn01Cmn.PwrSplyNtc0x07DPassStep -> PwrSply.PwrSplyNtc0x07DPassStep
    connect CalRegn01Cmn.SnsrOffsLrngSampleCntForHwTqLrngRst -> SnsrOffsLrng.SnsrOffsLrngSampleCntForHwTqLrngRst
    connect CalRegn01Cmn.CurrMeasCorrlnMaxErrCurr -> StHlthSigNormn.CurrMeasCorrlnMaxErrCurr
    connect CalRegn01Cmn.DutyCycThermProtnDutyCycFildThd -> StHlthSigNormn.DutyCycThermProtnDutyCycFildThd
    connect CalRegn01Cmn.EcuTMeasRngDiagcMax -> StHlthSigNormn.EcuTMeasRngDiagcMax
    connect CalRegn01Cmn.EcuTMeasRngDiagcMin -> StHlthSigNormn.EcuTMeasRngDiagcMin
    connect CalRegn01Cmn.HwTqCorrlnChATraSumSetFltThd -> StHlthSigNormn.HwTqCorrlnChATraSumSetFltThd
    connect CalRegn01Cmn.HwTqCorrlnChBTraSumSetFltThd -> StHlthSigNormn.HwTqCorrlnChBTraSumSetFltThd
    connect CalRegn01Cmn.MotDrvDiagcErrThd -> StHlthSigNormn.MotDrvDiagcErrThd
    connect CalRegn01Cmn.StHlthSigNormnAbsltMotPosDifStHlthDiagThd -> StHlthSigNormn.StHlthSigNormnAbsltMotPosDifStHlthDiagThd
    connect CalRegn01Cmn.StHlthSigNormnCurrMotSumStHlthDiagThd -> StHlthSigNormn.StHlthSigNormnCurrMotSumStHlthDiagThd
    connect CalRegn01Cmn.StHlthSigNormnDigTqStHlthDiagThd -> StHlthSigNormn.StHlthSigNormnDigTqStHlthDiagThd
    connect CalRegn01Cmn.StHlthSigNormnDutyCycFltLimThd -> StHlthSigNormn.StHlthSigNormnDutyCycFltLimThd
    connect CalRegn01Cmn.StHlthSigNormnIdptSigStHlthSca -> StHlthSigNormn.StHlthSigNormnIdptSigStHlthSca
    connect CalRegn01Cmn.StHlthSigNormnMaxFricThd -> StHlthSigNormn.StHlthSigNormnMaxFricThd
    connect CalRegn01Cmn.StHlthSigNormnMinRackTrvlLim -> StHlthSigNormn.StHlthSigNormnMinRackTrvlLim
    connect CalRegn01Cmn.StHlthSigNormnMotPosStHlthDiagThd -> StHlthSigNormn.StHlthSigNormnMotPosStHlthDiagThd
    connect CalRegn01Cmn.StHlthSigNormnMotVelCal -> StHlthSigNormn.StHlthSigNormnMotVelCal
    connect CalRegn01Cmn.StHlthSigNormnPhaInfoStHlthDiagThd -> StHlthSigNormn.StHlthSigNormnPhaInfoStHlthDiagThd
    connect CalRegn01Cmn.StHlthSigNormnStHlthCorrlnErr -> StHlthSigNormn.StHlthSigNormnStHlthCorrlnErr
    connect CalRegn01Cmn.StHlthSigNormnStHlthCurrMotSum -> StHlthSigNormn.StHlthSigNormnStHlthCurrMotSum
    connect CalRegn01Cmn.StHlthSigNormnStHlthPhaInfo -> StHlthSigNormn.StHlthSigNormnStHlthPhaInfo
    connect CalRegn01Cmn.StHlthSigNormnValMaxStHlthErr -> StHlthSigNormn.StHlthSigNormnValMaxStHlthErr
    connect CalRegn01Cmn.StHlthSigNormnValMinStHlthErr -> StHlthSigNormn.StHlthSigNormnValMinStHlthErr
    connect CalRegn01Cmn.StHlthSigNormnWhlImbRejctnThd -> StHlthSigNormn.StHlthSigNormnWhlImbRejctnThd
    connect CalRegn01Cmn.TqOscnAmpLimY -> TqOscn.TqOscnAmpLimY
    connect CalRegn01Cmn.TqOscnFallRampRateCal -> TqOscn.TqOscnFallRampRateCal
    connect CalRegn01Cmn.TqOscnFrqIn -> TqOscn.TqOscnFrqIn
    connect CalRegn01Cmn.TqOscnRisngRampRateCal -> TqOscn.TqOscnRisngRampRateCal
    connect CalRegn01Cmn.TqOscnUseRampRateCal -> TqOscn.TqOscnUseRampRateCal
    connect CalRegn01Cmn.TunSelnAuthyTunSelnRtDiCmd -> TunSelnAuthy.TunSelnAuthyTunSelnRtDiCmd
    connect CalRegn01Cmn.VehSigCdngDftLatA -> VehSigCdng.VehSigCdngDftLatA
    connect CalRegn01Cmn.VehSigCdngDftLgtA -> VehSigCdng.VehSigCdngDftLgtA
    connect CalRegn01Cmn.VehSigCdngDftVehSpd -> VehSigCdng.VehSigCdngDftVehSpd
    connect CalRegn01Cmn.VehSigCdngDftYawRate -> VehSigCdng.VehSigCdngDftYawRate
    connect CalRegn01Cmn.VehSigCdngLatADifThd -> VehSigCdng.VehSigCdngLatADifThd
    connect CalRegn01Cmn.VehSigCdngLatAFilFrq -> VehSigCdng.VehSigCdngLatAFilFrq
    connect CalRegn01Cmn.VehSigCdngLtgADifThd -> VehSigCdng.VehSigCdngLtgADifThd
    connect CalRegn01Cmn.VehSigCdngVehSpdDifThd -> VehSigCdng.VehSigCdngVehSpdDifThd
    connect CalRegn01Cmn.VehSigCdngVehYawSlewRate -> VehSigCdng.VehSigCdngVehYawSlewRate
    connect CalRegn01Cmn.VehSigCdngYawRateDifThd -> VehSigCdng.VehSigCdngYawRateDifThd
    connect CalRegn01Cmn.VehSpdLimrMaxAssiX -> VehSpdLimr.VehSpdLimrMaxAssiX
    connect CalRegn01Cmn.VehSpdLimrMaxAssiY -> VehSpdLimr.VehSpdLimrMaxAssiY
    connect CalRegn01Cmn.VehSpdLimrPosMaxOffs1 -> VehSpdLimr.VehSpdLimrPosMaxOffs1
    connect CalRegn01Cmn.VehSpdLimrPosMaxOffs2 -> VehSpdLimr.VehSpdLimrPosMaxOffs2
    connect CalRegn01Cmn.WhlImbRejctnFrqDiagcLpFil -> WhlImbRejctn.WhlImbRejctnFrqDiagcLpFil
    connect CalRegn01CmnGroupB.WhlImbRejctnDcTrendFltRcvryDly -> WhlImbRejctn.WhlImbRejctnDcTrendFltRcvryDly
    connect CalRegn01CmnGroupB.WhlImbRejctnFrqDiagcEna -> WhlImbRejctn.WhlImbRejctnFrqDiagcEna
    connect CalRegn01CmnGroupB.WhlImbRejctnFrqDiagcFltRcvryDly -> WhlImbRejctn.WhlImbRejctnFrqDiagcFltRcvryDly
    connect CalRegn01CmnGroupB.WhlImbRejctnFrqDiagcUgrPoleMgn -> WhlImbRejctn.WhlImbRejctnFrqDiagcUgrPoleMgn
    connect CalRegn01CmnGroupB.WhlImbRejctnMaxMgnFltRcvryDly -> WhlImbRejctn.WhlImbRejctnMaxMgnFltRcvryDly
    connect CalRegn01CmnGroupB.WhlImbRejctnWhlSpdCorrlnFltRcvryDly -> WhlImbRejctn.WhlImbRejctnWhlSpdCorrlnFltRcvryDly
    connect CalRegn01CmnGroupC.HwAgVehCentrTrimHwAgLim -> HwAgVehCentrTrim.HwAgVehCentrTrimHwAgLim
    connect CalRegn01CmnGroupC.HwAgVehCentrTrimVehSpdMaxThd -> HwAgVehCentrTrim.HwAgVehCentrTrimVehSpdMaxThd
    connect CalRegn01Inin00.AssiPahFwlCmdSplitLpFilFrq -> AssiPahFwl.AssiPahFwlCmdSplitLpFilFrq
    connect CalRegn01Inin00.AssiPahFwlDftAssiX -> AssiPahFwl.AssiPahFwlDftAssiX
    connect CalRegn01Inin00.AssiPahFwlDftAssiY -> AssiPahFwl.AssiPahFwlDftAssiY
    connect CalRegn01Inin00.AssiPahFwlFwlActvLpFilFrq -> AssiPahFwl.AssiPahFwlFwlActvLpFilFrq
    connect CalRegn01Inin00.AssiPahFwlHiFrqUpprLimY -> AssiPahFwl.AssiPahFwlHiFrqUpprLimY
    connect CalRegn01Inin00.AssiPahFwlHysCmpLim -> AssiPahFwl.AssiPahFwlHysCmpLim
    connect CalRegn01Inin00.AssiPahFwlRestoreThd -> AssiPahFwl.AssiPahFwlRestoreThd
    connect CalRegn01Inin00.AssiPahFwlUpprLimX -> AssiPahFwl.AssiPahFwlUpprLimX
    connect CalRegn01Inin00.AssiPahFwlUpprLimY -> AssiPahFwl.AssiPahFwlUpprLimY
    connect CalRegn01Inin00.SysGlbPrmMotPoleCnt -> CDD_CurrMeas.SysGlbPrmMotPoleCnt
    connect CalRegn01Inin00.HwTq0MeasHwTq0PrtclFltFailStep -> CDD_HwTq0Meas.HwTq0MeasHwTq0PrtclFltFailStep
    connect CalRegn01Inin00.HwTq0MeasHwTq0PrtclFltPassStep -> CDD_HwTq0Meas.HwTq0MeasHwTq0PrtclFltPassStep
    connect CalRegn01Inin00.HwTq1MeasHwTq1PrtclFltFailStep -> CDD_HwTq1Meas.HwTq1MeasHwTq1PrtclFltFailStep
    connect CalRegn01Inin00.HwTq1MeasHwTq1PrtclFltPassStep -> CDD_HwTq1Meas.HwTq1MeasHwTq1PrtclFltPassStep
    connect CalRegn01Inin00.McuDiagc2MilliSecCntrCompThd -> CDD_McuDiagc.McuDiagc2MilliSecCntrCompThd
    connect CalRegn01Inin00.McuDiagcFltFailStep -> CDD_McuDiagc.McuDiagcFltFailStep
    connect CalRegn01Inin00.McuDiagcFltPassStep -> CDD_McuDiagc.McuDiagcFltPassStep
    connect CalRegn01Inin00.SysGlbPrmMotPoleCnt -> CDD_MotAgCmp.SysGlbPrmMotPoleCnt
    connect CalRegn01Inin00.SnsrMeasStrtTrigDly -> CDD_SnsrMeasStrt.SnsrMeasStrtTrigDly
    connect CalRegn01Inin00.DampgPahFwlActvFwlLpFilFrq -> DampgPahFwl.DampgPahFwlActvFwlLpFilFrq
    connect CalRegn01Inin00.DampgPahFwlDampgCmdLpFilFrq -> DampgPahFwl.DampgPahFwlDampgCmdLpFilFrq
    connect CalRegn01Inin00.DampgPahFwlDampgCmdUpprLimX -> DampgPahFwl.DampgPahFwlDampgCmdUpprLimX
    connect CalRegn01Inin00.DampgPahFwlDampgCmdUpprLimY -> DampgPahFwl.DampgPahFwlDampgCmdUpprLimY
    connect CalRegn01Inin00.DampgPahFwlDftDampgY -> DampgPahFwl.DampgPahFwlDftDampgY
    connect CalRegn01Inin00.DampgPahFwlInertiaCmpLpFilFrq -> DampgPahFwl.DampgPahFwlInertiaCmpLpFilFrq
    connect CalRegn01Inin00.DampgPahFwlInertiaCmpUpprLimX -> DampgPahFwl.DampgPahFwlInertiaCmpUpprLimX
    connect CalRegn01Inin00.DampgPahFwlInertiaCmpUpprLimY -> DampgPahFwl.DampgPahFwlInertiaCmpUpprLimY
    connect CalRegn01Inin00.EotProtnFwlActvCmdLowrBnd -> EotProtnFwl.EotProtnFwlActvCmdLowrBnd
    connect CalRegn01Inin00.EotProtnFwlActvCmdUpprBnd -> EotProtnFwl.EotProtnFwlActvCmdUpprBnd
    connect CalRegn01Inin00.GmVehPwrModOperRampRate -> GmVehPwrMod.GmVehPwrModOperRampRate
    connect CalRegn01Inin00.HiLoadStallLimrMotTqCmdFilFrq -> HiLoadStallLimr.HiLoadStallLimrMotTqCmdFilFrq
    connect CalRegn01Inin00.HiLoadStallLimrMotVelMgnThd -> HiLoadStallLimr.HiLoadStallLimrMotVelMgnThd
    connect CalRegn01Inin00.HiLoadStallLimrStallMotTqCmdLimX -> HiLoadStallLimr.HiLoadStallLimrStallMotTqCmdLimX
    connect CalRegn01Inin00.HiLoadStallLimrStallMotTqCmdLimY -> HiLoadStallLimr.HiLoadStallLimrStallMotTqCmdLimY
    connect CalRegn01Inin00.HiLoadStallLimrStallMotTqLimSlewRate -> HiLoadStallLimr.HiLoadStallLimrStallMotTqLimSlewRate
    connect CalRegn01Inin00.HwAg0MeasHwAg0IfFltFailStep -> HwAg0Meas.HwAg0MeasHwAg0IfFltFailStep
    connect CalRegn01Inin00.HwAg0MeasHwAg0IfFltPassStep -> HwAg0Meas.HwAg0MeasHwAg0IfFltPassStep
    connect CalRegn01Inin00.HwAg0MeasHwAg0Snsr0PrtclFltFailStep -> HwAg0Meas.HwAg0MeasHwAg0Snsr0PrtclFltFailStep
    connect CalRegn01Inin00.HwAg0MeasHwAg0Snsr0PrtclFltPassStep -> HwAg0Meas.HwAg0MeasHwAg0Snsr0PrtclFltPassStep
    connect CalRegn01Inin00.HwAg0MeasHwAg0Snsr1PrtclFltFailStep -> HwAg0Meas.HwAg0MeasHwAg0Snsr1PrtclFltFailStep
    connect CalRegn01Inin00.HwAg0MeasHwAg0Snsr1PrtclFltPassStep -> HwAg0Meas.HwAg0MeasHwAg0Snsr1PrtclFltPassStep
    connect CalRegn01Inin00.HwAg0MeasSnsr0Rev -> HwAg0Meas.HwAg0MeasSnsr0Rev
    connect CalRegn01Inin00.HwAg0MeasSnsr1Rev -> HwAg0Meas.HwAg0MeasSnsr1Rev
    connect CalRegn01Inin00.HwAg0MeasStep -> HwAg0Meas.HwAg0MeasStep
    connect CalRegn01Inin00.HwAg0MeasVrnrErrThd -> HwAg0Meas.HwAg0MeasVrnrErrThd
    connect CalRegn01Inin00.HwAg1MeasHwAg1IfFltFailStep -> HwAg1Meas.HwAg1MeasHwAg1IfFltFailStep
    connect CalRegn01Inin00.HwAg1MeasHwAg1IfFltPassStep -> HwAg1Meas.HwAg1MeasHwAg1IfFltPassStep
    connect CalRegn01Inin00.HwAg1MeasHwAg1Snsr0PrtclFltFailStep -> HwAg1Meas.HwAg1MeasHwAg1Snsr0PrtclFltFailStep
    connect CalRegn01Inin00.HwAg1MeasHwAg1Snsr0PrtclFltPassStep -> HwAg1Meas.HwAg1MeasHwAg1Snsr0PrtclFltPassStep
    connect CalRegn01Inin00.HwAg1MeasHwAg1Snsr1PrtclFltFailStep -> HwAg1Meas.HwAg1MeasHwAg1Snsr1PrtclFltFailStep
    connect CalRegn01Inin00.HwAg1MeasHwAg1Snsr1PrtclFltPassStep -> HwAg1Meas.HwAg1MeasHwAg1Snsr1PrtclFltPassStep
    connect CalRegn01Inin00.HwAg1MeasSnsr0Rev -> HwAg1Meas.HwAg1MeasSnsr0Rev
    connect CalRegn01Inin00.HwAg1MeasSnsr1Rev -> HwAg1Meas.HwAg1MeasSnsr1Rev
    connect CalRegn01Inin00.HwAg1MeasStep -> HwAg1Meas.HwAg1MeasStep
    connect CalRegn01Inin00.HwAg1MeasVrnrErrThd -> HwAg1Meas.HwAg1MeasVrnrErrThd
    connect CalRegn01Inin00.HwAgSnsrlsVehDynVehSpdThd -> HwAgSnsrls.HwAgSnsrlsVehDynVehSpdThd
    connect CalRegn01Inin00.HwAgSnsrlsVehDynYawRateThd -> HwAgSnsrls.HwAgSnsrlsVehDynYawRateThd
    connect CalRegn01Inin00.HwAgSnsrlsYawRateFilFrq -> HwAgSnsrls.HwAgSnsrlsYawRateFilFrq
    connect CalRegn01Inin00.HwAgSysArbnTqSnsrVelFilFrq -> HwAgSysArbn.HwAgSysArbnTqSnsrVelFilFrq
    connect CalRegn01Inin00.SysGlbPrmTorsBarStfn -> HwAgSysArbn.SysGlbPrmTorsBarStfn
    connect CalRegn01Inin00.SysGlbPrmTorsBarStfn -> InertiaCmpVel.SysGlbPrmTorsBarStfn
    connect CalRegn01Inin00.LimrCdngGainDecSlew -> LimrCdng.LimrCdngGainDecSlew
    connect CalRegn01Inin00.LimrCdngGainIncSlewX -> LimrCdng.LimrCdngGainIncSlewX
    connect CalRegn01Inin00.LimrCdngGainIncSlewY -> LimrCdng.LimrCdngGainIncSlewY
    connect CalRegn01Inin00.LimrCdngTqDecSlew -> LimrCdng.LimrCdngTqDecSlew
    connect CalRegn01Inin00.LimrCdngTqIncSlewX -> LimrCdng.LimrCdngTqIncSlewX
    connect CalRegn01Inin00.LimrCdngTqIncSlewY -> LimrCdng.LimrCdngTqIncSlewY
    connect CalRegn01Inin00.SysGlbPrmMotPoleCnt -> MotAgCorrln.SysGlbPrmMotPoleCnt
    connect CalRegn01Inin00.SysGlbPrmMotPoleCnt -> MotCurrRegCfg.SysGlbPrmMotPoleCnt
    connect CalRegn01Inin00.SysGlbPrmMotPoleCnt -> MotRefMdl.SysGlbPrmMotPoleCnt
    connect CalRegn01Inin00.SysGlbPrmMotPoleCnt -> MotRplCoggCfg.SysGlbPrmMotPoleCnt
    connect CalRegn01Inin00.MotTqTranlDampgCmdLim -> MotTqTranlDampg.MotTqTranlDampgCmdLim
    connect CalRegn01Inin00.MotTqTranlDampgDampgCoeff -> MotTqTranlDampg.MotTqTranlDampgDampgCoeff
    connect CalRegn01Inin00.MotTqTranlDampgRampEnd -> MotTqTranlDampg.MotTqTranlDampgRampEnd
    connect CalRegn01Inin00.MotTqTranlDampgTmrPt1 -> MotTqTranlDampg.MotTqTranlDampgTmrPt1
    connect CalRegn01Inin00.MotTqTranlDampgTmrPt2 -> MotTqTranlDampg.MotTqTranlDampgTmrPt2
    connect CalRegn01Inin00.MotTqTranlDampgVehSpdBlndX -> MotTqTranlDampg.MotTqTranlDampgVehSpdBlndX
    connect CalRegn01Inin00.MotTqTranlDampgVelThd -> MotTqTranlDampg.MotTqTranlDampgVelThd
    connect CalRegn01Inin00.PwrDiscnctNtc0x042FailStep -> PwrDiscnct.PwrDiscnctNtc0x042FailStep
    connect CalRegn01Inin00.PwrDiscnctNtc0x042PassStep -> PwrDiscnct.PwrDiscnctNtc0x042PassStep
    connect CalRegn01Inin00.PwrDiscnctNtc0x04AFailStep -> PwrDiscnct.PwrDiscnctNtc0x04AFailStep
    connect CalRegn01Inin00.PwrDiscnctNtc0x04APassStep -> PwrDiscnct.PwrDiscnctNtc0x04APassStep
    connect CalRegn01Inin00.RtnPahFwlUpprBndTblX -> RtnPahFwl.RtnPahFwlUpprBndTblX
    connect CalRegn01Inin00.RtnPahFwlUpprBndTblY -> RtnPahFwl.RtnPahFwlUpprBndTblY
    connect CalRegn01Inin00.RtnPahFwlVehSpd -> RtnPahFwl.RtnPahFwlVehSpd
    connect CalRegn01Inin00.StHlthSigNormnHiCtrlrT -> StHlthSigNormn.StHlthSigNormnHiCtrlrT
    connect CalRegn01Inin00.StHlthSigNormnLoCtrlrT -> StHlthSigNormn.StHlthSigNormnLoCtrlrT
    connect CalRegn01Inin00.SysGlbPrmMotPoleCnt -> StHlthSigNormn.SysGlbPrmMotPoleCnt
    connect CalRegn01Inin00.SysFricLrngAvrgFricFrq -> SysFricLrng.SysFricLrngAvrgFricFrq
    connect CalRegn01Inin00.SysFricLrngBasLineEolFric -> SysFricLrng.SysFricLrngBasLineEolFric
    connect CalRegn01Inin00.SysFricLrngBasLineFric -> SysFricLrng.SysFricLrngBasLineFric
    connect CalRegn01Inin00.SysFricLrngBasLineHys -> SysFricLrng.SysFricLrngBasLineHys
    connect CalRegn01Inin00.SysFricLrngBasLineRngCntr -> SysFricLrng.SysFricLrngBasLineRngCntr
    connect CalRegn01Inin00.SysFricLrngDataPrepLpFilFrq -> SysFricLrng.SysFricLrngDataPrepLpFilFrq
    connect CalRegn01Inin00.SysFricLrngEolFricDifHiLim -> SysFricLrng.SysFricLrngEolFricDifHiLim
    connect CalRegn01Inin00.SysFricLrngEolFricDifLoLim -> SysFricLrng.SysFricLrngEolFricDifLoLim
    connect CalRegn01Inin00.SysFricLrngEolFricDifScagFac -> SysFricLrng.SysFricLrngEolFricDifScagFac
    connect CalRegn01Inin00.SysFricLrngFricChgWght -> SysFricLrng.SysFricLrngFricChgWght
    connect CalRegn01Inin00.SysFricLrngFricDiagcThd -> SysFricLrng.SysFricLrngFricDiagcThd
    connect CalRegn01Inin00.SysFricLrngFricDiagcTiThd -> SysFricLrng.SysFricLrngFricDiagcTiThd
    connect CalRegn01Inin00.SysFricLrngFricHysHwAgPt -> SysFricLrng.SysFricLrngFricHysHwAgPt
    connect CalRegn01Inin00.SysFricLrngFricOffs -> SysFricLrng.SysFricLrngFricOffs
    connect CalRegn01Inin00.SysFricLrngFricOffsHiLim -> SysFricLrng.SysFricLrngFricOffsHiLim
    connect CalRegn01Inin00.SysFricLrngFricOffsLoLim -> SysFricLrng.SysFricLrngFricOffsLoLim
    connect CalRegn01Inin00.SysFricLrngFricOffsLpFilFrq -> SysFricLrng.SysFricLrngFricOffsLpFilFrq
    connect CalRegn01Inin00.SysFricLrngGain -> SysFricLrng.SysFricLrngGain
    connect CalRegn01Inin00.SysFricLrngHwPosnAuthyThd -> SysFricLrng.SysFricLrngHwPosnAuthyThd
    connect CalRegn01Inin00.SysFricLrngHwVelConstrLim -> SysFricLrng.SysFricLrngHwVelConstrLim
    connect CalRegn01Inin00.SysFricLrngHwVelHiLim -> SysFricLrng.SysFricLrngHwVelHiLim
    connect CalRegn01Inin00.SysFricLrngHwVelLoLim -> SysFricLrng.SysFricLrngHwVelLoLim
    connect CalRegn01Inin00.SysFricLrngIgnCycFricChgLim -> SysFricLrng.SysFricLrngIgnCycFricChgLim
    connect CalRegn01Inin00.SysFricLrngIvsTrsmRatX -> SysFricLrng.SysFricLrngIvsTrsmRatX
    connect CalRegn01Inin00.SysFricLrngIvsTrsmRatY -> SysFricLrng.SysFricLrngIvsTrsmRatY
    connect CalRegn01Inin00.SysFricLrngLatAHiLim -> SysFricLrng.SysFricLrngLatAHiLim
    connect CalRegn01Inin00.SysFricLrngLatALoLim -> SysFricLrng.SysFricLrngLatALoLim
    connect CalRegn01Inin00.SysFricLrngMaskVehSpd -> SysFricLrng.SysFricLrngMaskVehSpd
    connect CalRegn01Inin00.SysFricLrngRngCntrThd -> SysFricLrng.SysFricLrngRngCntrThd
    connect CalRegn01Inin00.SysFricLrngThd -> SysFricLrng.SysFricLrngThd
    connect CalRegn01Inin00.SysFricLrngTHiLim -> SysFricLrng.SysFricLrngTHiLim
    connect CalRegn01Inin00.SysFricLrngTLoLim -> SysFricLrng.SysFricLrngTLoLim
    connect CalRegn01Inin00.SysFricLrngVehSpd -> SysFricLrng.SysFricLrngVehSpd
    connect CalRegn01Inin00.TEstimnAmbPwrMplr -> TEstimn.TEstimnAmbPwrMplr
    connect CalRegn01Inin00.TEstimnAmbTSca -> TEstimn.TEstimnAmbTSca
    connect CalRegn01Inin00.TEstimnAssiMechAmbLpFilFrq -> TEstimn.TEstimnAssiMechAmbLpFilFrq
    connect CalRegn01Inin00.TEstimnAssiMechAmbMplr -> TEstimn.TEstimnAssiMechAmbMplr
    connect CalRegn01Inin00.TEstimnAssiMechCorrLim -> TEstimn.TEstimnAssiMechCorrLim
    connect CalRegn01Inin00.TEstimnAssiMechDampgSca -> TEstimn.TEstimnAssiMechDampgSca
    connect CalRegn01Inin00.TEstimnAssiMechDftT -> TEstimn.TEstimnAssiMechDftT
    connect CalRegn01Inin00.TEstimnAssiMechLLFilCoeffA1 -> TEstimn.TEstimnAssiMechLLFilCoeffA1
    connect CalRegn01Inin00.TEstimnAssiMechLLFilCoeffB0 -> TEstimn.TEstimnAssiMechLLFilCoeffB0
    connect CalRegn01Inin00.TEstimnAssiMechLLFilCoeffB1 -> TEstimn.TEstimnAssiMechLLFilCoeffB1
    connect CalRegn01Inin00.TEstimnAssiMechSlew -> TEstimn.TEstimnAssiMechSlew
    connect CalRegn01Inin00.TEstimnCorrnTAssiMech -> TEstimn.TEstimnCorrnTAssiMech
    connect CalRegn01Inin00.TEstimnCorrnTCu -> TEstimn.TEstimnCorrnTCu
    connect CalRegn01Inin00.TEstimnCorrnTMag -> TEstimn.TEstimnCorrnTMag
    connect CalRegn01Inin00.TEstimnCorrnTSi -> TEstimn.TEstimnCorrnTSi
    connect CalRegn01Inin00.TEstimnCuAmbLpFilFrq -> TEstimn.TEstimnCuAmbLpFilFrq
    connect CalRegn01Inin00.TEstimnCuAmbMplr -> TEstimn.TEstimnCuAmbMplr
    connect CalRegn01Inin00.TEstimnCuCorrnLim -> TEstimn.TEstimnCuCorrnLim
    connect CalRegn01Inin00.TEstimnCuLLFilCoeffA1 -> TEstimn.TEstimnCuLLFilCoeffA1
    connect CalRegn01Inin00.TEstimnCuLLFilCoeffB0 -> TEstimn.TEstimnCuLLFilCoeffB0
    connect CalRegn01Inin00.TEstimnCuLLFilCoeffB1 -> TEstimn.TEstimnCuLLFilCoeffB1
    connect CalRegn01Inin00.TEstimnEngTSca -> TEstimn.TEstimnEngTSca
    connect CalRegn01Inin00.TEstimnMagAmbLpFilFrq -> TEstimn.TEstimnMagAmbLpFilFrq
    connect CalRegn01Inin00.TEstimnMagCorrnLim -> TEstimn.TEstimnMagCorrnLim
    connect CalRegn01Inin00.TEstimnMagLLFilCoeffA1 -> TEstimn.TEstimnMagLLFilCoeffA1
    connect CalRegn01Inin00.TEstimnMagLLFilCoeffB0 -> TEstimn.TEstimnMagLLFilCoeffB0
    connect CalRegn01Inin00.TEstimnMagLLFilCoeffB1 -> TEstimn.TEstimnMagLLFilCoeffB1
    connect CalRegn01Inin00.TEstimnSiAmbLpFilFrq -> TEstimn.TEstimnSiAmbLpFilFrq
    connect CalRegn01Inin00.TEstimnSiAmbMplr -> TEstimn.TEstimnSiAmbMplr
    connect CalRegn01Inin00.TEstimnSiCorrnLim -> TEstimn.TEstimnSiCorrnLim
    connect CalRegn01Inin00.TEstimnSiLLFilCoeffA1 -> TEstimn.TEstimnSiLLFilCoeffA1
    connect CalRegn01Inin00.TEstimnSiLLFilCoeffB0 -> TEstimn.TEstimnSiLLFilCoeffB0
    connect CalRegn01Inin00.TEstimnSiLLFilCoeffB1 -> TEstimn.TEstimnSiLLFilCoeffB1
    connect CalRegn01Inin00.TEstimnWghtAvrgTDi -> TEstimn.TEstimnWghtAvrgTDi
    connect CalRegn01Inin00.TunSelnAuthyVehSpdX -> TunSelnAuthy.TunSelnAuthyVehSpdX
    connect CalRegn01Inin00.VehSigCdngLatASlewRate -> VehSigCdng.VehSigCdngLatASlewRate
    connect CalRegn01Inin00.VehSigCdngLtgASlewRate -> VehSigCdng.VehSigCdngLtgASlewRate
    connect CalRegn01Inin00.VehSigCdngVehSpdSlewRate -> VehSigCdng.VehSigCdngVehSpdSlewRate
    connect CalRegn01Inin00.WhlImbRejctnDcTrendFltRcvryThd -> WhlImbRejctn.WhlImbRejctnDcTrendFltRcvryThd
    connect CalRegn01Inin00GroupB.GmRoadWhlInQlfrMaxAllwblFrq -> GmRoadWhlInQlfr.GmRoadWhlInQlfrMaxAllwblFrq
    connect CalRegn01Inin00GroupB.GmRoadWhlInQlfrMaxFrqChg -> GmRoadWhlInQlfr.GmRoadWhlInQlfrMaxFrqChg
    connect CalRegn01Inin00GroupB.WhlImbRejctnDcTrendFltRcvryNegStep -> WhlImbRejctn.WhlImbRejctnDcTrendFltRcvryNegStep
    connect CalRegn01Inin00GroupB.WhlImbRejctnDcTrendFltRcvryPosStep -> WhlImbRejctn.WhlImbRejctnDcTrendFltRcvryPosStep
    connect CalRegn01Inin00GroupB.WhlImbRejctnFrqDiagcAmpThd -> WhlImbRejctn.WhlImbRejctnFrqDiagcAmpThd
    connect CalRegn01Inin00GroupB.WhlImbRejctnFrqDiagcFltRcvryNegStep -> WhlImbRejctn.WhlImbRejctnFrqDiagcFltRcvryNegStep
    connect CalRegn01Inin00GroupB.WhlImbRejctnFrqDiagcFltRcvryPosStep -> WhlImbRejctn.WhlImbRejctnFrqDiagcFltRcvryPosStep
    connect CalRegn01Inin00GroupB.WhlImbRejctnFrqDiagcFltRcvryThd -> WhlImbRejctn.WhlImbRejctnFrqDiagcFltRcvryThd
    connect CalRegn01Inin00GroupB.WhlImbRejctnFrqDiagcThd -> WhlImbRejctn.WhlImbRejctnFrqDiagcThd
    connect CalRegn01Inin00GroupB.WhlImbRejctnFrqDiagcTout -> WhlImbRejctn.WhlImbRejctnFrqDiagcTout
    connect CalRegn01Inin00GroupB.WhlImbRejctnMaxMgnFltNegStep -> WhlImbRejctn.WhlImbRejctnMaxMgnFltNegStep
    connect CalRegn01Inin00GroupB.WhlImbRejctnMaxMgnFltPosStep -> WhlImbRejctn.WhlImbRejctnMaxMgnFltPosStep
    connect CalRegn01Inin00GroupB.WhlImbRejctnMaxMgnFltRcvryNegStep -> WhlImbRejctn.WhlImbRejctnMaxMgnFltRcvryNegStep
    connect CalRegn01Inin00GroupB.WhlImbRejctnMaxMgnFltRcvryPosStep -> WhlImbRejctn.WhlImbRejctnMaxMgnFltRcvryPosStep
    connect CalRegn01Inin00GroupB.WhlImbRejctnMaxMgnFltRcvryThd -> WhlImbRejctn.WhlImbRejctnMaxMgnFltRcvryThd
    connect CalRegn01Inin00GroupB.WhlImbRejctnMaxMgnFltThd -> WhlImbRejctn.WhlImbRejctnMaxMgnFltThd
    connect CalRegn01Inin00GroupB.WhlImbRejctnWhlSpdCorrlnFltRcvryNegStep -> WhlImbRejctn.WhlImbRejctnWhlSpdCorrlnFltRcvryNegStep
    connect CalRegn01Inin00GroupB.WhlImbRejctnWhlSpdCorrlnFltRcvryPosStep -> WhlImbRejctn.WhlImbRejctnWhlSpdCorrlnFltRcvryPosStep
    connect CalRegn01Inin00GroupB.WhlImbRejctnWhlSpdCorrlnFltRcvryThd -> WhlImbRejctn.WhlImbRejctnWhlSpdCorrlnFltRcvryThd
    connect CalRegn01Inin00GroupC.EotProtnFwlEotDampgActvBndY -> EotProtnFwl.EotProtnFwlEotDampgActvBndY
    connect CalRegn01Inin00GroupC.GmVehPwrModHwTqMinKeepAssi -> GmVehPwrMod.GmVehPwrModHwTqMinKeepAssi
    connect CalRegn01Inin00GroupC.GmVehPwrModHwTqMinKeepTmr -> GmVehPwrMod.GmVehPwrModHwTqMinKeepTmr
    connect CalRegn01Inin00GroupC.GmVehPwrModVehSpdAssiOnMin -> GmVehPwrMod.GmVehPwrModVehSpdAssiOnMin
    connect CalRegn01Inin00GroupC.GmVehPwrModVehSpdMinKeepAssi -> GmVehPwrMod.GmVehPwrModVehSpdMinKeepAssi
    connect CalRegn01Rt00.TEstimnMagAmbMplr -> AAACalRegn01Rt01_Dummy.TEstimnMagAmbMplr
    connect CalRegn01Rt00.TunSelnAuthyHwTqY -> AAACalRegn01Rt01_Dummy.TunSelnAuthyHwTqY
    connect CalRegn01Rt00.TunSelnAuthyHwVelY -> AAACalRegn01Rt01_Dummy.TunSelnAuthyHwVelY
    connect CalRegn01Rt00.TEstimnMagAmbMplr -> TEstimn.TEstimnMagAmbMplr
    connect CalRegn01Rt00.TunSelnAuthyHwTqY -> TunSelnAuthy.TunSelnAuthyHwTqY
    connect CalRegn01Rt00.TunSelnAuthyHwVelY -> TunSelnAuthy.TunSelnAuthyHwVelY
    connect CalRegn01Rt01.TEstimnMagAmbMplr -> AAACalRegn01Rt01_Dummy_1.TEstimnMagAmbMplr
    connect CalRegn01Rt01.TunSelnAuthyHwTqY -> AAACalRegn01Rt01_Dummy_1.TunSelnAuthyHwTqY
    connect CalRegn01Rt01.TunSelnAuthyHwVelY -> AAACalRegn01Rt01_Dummy_1.TunSelnAuthyHwVelY
    connect CalRegn01Rt02.TEstimnMagAmbMplr -> AAACalRegn01Rt01_Dummy_2.TEstimnMagAmbMplr
    connect CalRegn01Rt02.TunSelnAuthyHwTqY -> AAACalRegn01Rt01_Dummy_2.TunSelnAuthyHwTqY
    connect CalRegn01Rt02.TunSelnAuthyHwVelY -> AAACalRegn01Rt01_Dummy_2.TunSelnAuthyHwVelY
    connect CalRegn01Rt03.TEstimnMagAmbMplr -> AAACalRegn01Rt01_Dummy_3.TEstimnMagAmbMplr
    connect CalRegn01Rt03.TunSelnAuthyHwTqY -> AAACalRegn01Rt01_Dummy_3.TunSelnAuthyHwTqY
    connect CalRegn01Rt03.TunSelnAuthyHwVelY -> AAACalRegn01Rt01_Dummy_3.TunSelnAuthyHwVelY
    connect CalRegn01Rt04.TEstimnMagAmbMplr -> AAACalRegn01Rt01_Dummy_4.TEstimnMagAmbMplr
    connect CalRegn01Rt04.TunSelnAuthyHwTqY -> AAACalRegn01Rt01_Dummy_4.TunSelnAuthyHwTqY
    connect CalRegn01Rt04.TunSelnAuthyHwVelY -> AAACalRegn01Rt01_Dummy_4.TunSelnAuthyHwVelY
    connect CalRegn02Cmn.DiagcMgrFltResp -> CustDiagc.DiagcMgrFltResp
    connect CalRegn02Cmn.InertiaCmpVelDecelGainEnaCal -> CustDiagc.InertiaCmpVelDecelGainEnaCal
    connect CalRegn02Cmn.DiagcMgrFltResp -> DiagcMgr.DiagcMgrFltResp
    connect CalRegn02Cmn.DiagcMgrFltResp -> DiagcMgrProxyAppl10.DiagcMgrFltResp
    connect CalRegn02Cmn.DiagcMgrFltResp -> DiagcMgrProxyAppl6.DiagcMgrFltResp
    connect CalRegn02Cmn.InertiaCmpVelDecelGainEnaCal -> InertiaCmpVel.InertiaCmpVelDecelGainEnaCal
    connect CalRegn02Cmn.NxtrCalIdsCal1DevlpAuthor -> NxtrCalIds.NxtrCalIdsCal1DevlpAuthor
    connect CalRegn02Cmn.NxtrCalIdsCal1DevlpDesc -> NxtrCalIds.NxtrCalIdsCal1DevlpDescr
    connect CalRegn02Cmn.NxtrCalIdsCal1DevlpRelNr -> NxtrCalIds.NxtrCalIdsCal1DevlpRelNr
    connect CalRegn02Cmn.NxtrCalIdsCal1DevlpRelSt -> NxtrCalIds.NxtrCalIdsCal1DevlpRelSt
    connect CalRegn02Cmn.NxtrCalIdsCal1DevlpTiStamp -> NxtrCalIds.NxtrCalIdsCal1DevlpTiStamp
    connect CalRegn02Cmn.NxtrCalIdsCal1DevlpVers -> NxtrCalIds.NxtrCalIdsCal1DevlpVers
    connect CalRegn02Cmn.SnsrOffsCorrnHwAgLrndOffsLim -> SnsrOffsCorrn.SnsrOffsCorrnHwAgLrndOffsLim
    connect CalRegn02Cmn.SnsrOffsCorrnHwTqLrndOffsLim -> SnsrOffsCorrn.SnsrOffsCorrnHwTqLrndOffsLim
    connect CalRegn02Cmn.SnsrOffsCorrnOffsEna -> SnsrOffsCorrn.SnsrOffsCorrnOffsEna
    connect CalRegn02Cmn.SnsrOffsCorrnVehYawRateLrndOffsLim -> SnsrOffsCorrn.SnsrOffsCorrnVehYawRateLrndOffsLim
    connect CalRegn02Cmn.SnsrOffsLrngHwAgLrngTi -> SnsrOffsLrng.SnsrOffsLrngHwAgLrngTi
    connect CalRegn02Cmn.SnsrOffsLrngHwTqLrngHwTqZeroOffsThd -> SnsrOffsLrng.SnsrOffsLrngHwTqLrngHwTqZeroOffsThd
    connect CalRegn02Cmn.SnsrOffsLrngHwTqLrngMeasTi -> SnsrOffsLrng.SnsrOffsLrngHwTqLrngMeasTi
    connect CalRegn02Cmn.SnsrOffsLrngHwTqLrngSampleImbThd1 -> SnsrOffsLrng.SnsrOffsLrngHwTqLrngSampleImbThd1
    connect CalRegn02Cmn.SnsrOffsLrngHwTqLrngSampleImbThd2 -> SnsrOffsLrng.SnsrOffsLrngHwTqLrngSampleImbThd2
    connect CalRegn02Cmn.SnsrOffsLrngHwTqLrngSampleThd1 -> SnsrOffsLrng.SnsrOffsLrngHwTqLrngSampleThd1
    connect CalRegn02Cmn.SnsrOffsLrngHwTqLrngSampleThd2 -> SnsrOffsLrng.SnsrOffsLrngHwTqLrngSampleThd2
    connect CalRegn02Cmn.SnsrOffsLrngHwTqLrngTiWghtCoeff -> SnsrOffsLrng.SnsrOffsLrngHwTqLrngTiWghtCoeff
    connect CalRegn02Cmn.SnsrOffsLrngYawLrngTi -> SnsrOffsLrng.SnsrOffsLrngYawLrngTi
    connect CalRegn02CmnGroupA.GmOvrlStMgrApaMfgEna -> CustDiagc.GmOvrlStMgrApaMfgEna
    connect CalRegn02CmnGroupA.GmOvrlStMgrEscMfgEna -> CustDiagc.GmOvrlStMgrEscMfgEna
    connect CalRegn02CmnGroupA.GmOvrlStMgrLkaMfgEna -> CustDiagc.GmOvrlStMgrLkaMfgEna
    connect CalRegn02CmnGroupA.PullCmpActvEna -> CustDiagc.PullCmpActvEna
    connect CalRegn02CmnGroupA.GmOvrlStMgrLkaMfgEna -> GmMsg184BusHiSpd.GmOvrlStMgrLkaMfgEna
    connect CalRegn02CmnGroupA.GmOvrlStMgrApaMfgEna -> GmOvrlStMgr.GmOvrlStMgrApaMfgEna
    connect CalRegn02CmnGroupA.GmOvrlStMgrEscMfgEna -> GmOvrlStMgr.GmOvrlStMgrEscMfgEna
    connect CalRegn02CmnGroupA.GmOvrlStMgrLkaHwTqThd1 -> GmOvrlStMgr.GmOvrlStMgrLkaHwTqThd1
    connect CalRegn02CmnGroupA.GmOvrlStMgrLkaHwTqThd2 -> GmOvrlStMgr.GmOvrlStMgrLkaHwTqThd2
    connect CalRegn02CmnGroupA.GmOvrlStMgrLkaMfgEna -> GmOvrlStMgr.GmOvrlStMgrLkaMfgEna
    connect CalRegn02CmnGroupA.PullCmpActvEna -> PullCmpActv.PullCmpActvEna
    connect CalRegn02CmnGroupA.GmOvrlStMgrApaMfgEna -> SerlComOutpProxy.GmOvrlStMgrApaMfgEna
    connect CalRegn02CmnGroupA.GmOvrlStMgrEscMfgEna -> SerlComOutpProxy.GmOvrlStMgrEscMfgEna
    connect CalRegn02CmnGroupA.GmOvrlStMgrLkaMfgEna -> SerlComOutpProxy.GmOvrlStMgrLkaMfgEna
    connect CalRegn02CmnGroupB.WhlImbRejctnFctEna -> CustDiagc.WhlImbRejctnFctEna
    connect CalRegn02CmnGroupB.WhlImbRejctnFctEna -> WhlImbRejctn.WhlImbRejctnFctEna
    connect CalRegn02CmnGroupC.GmOvrlStMgrApaHaptcEna -> GmOvrlStMgr.GmOvrlStMgrApaHaptcEna
    connect CalRegn02CmnGroupC.GmOvrlStMgrApaHwTqThd -> GmOvrlStMgr.GmOvrlStMgrApaHwTqThd
    connect CalRegn02CmnGroupC.GmOvrlStMgrApaVehSpdHiLim -> GmOvrlStMgr.GmOvrlStMgrApaVehSpdHiLim
    connect CalRegn02CmnGroupC.GmOvrlStMgrEscVehSpdHiLim -> GmOvrlStMgr.GmOvrlStMgrEscVehSpdHiLim
    connect CalRegn02CmnGroupC.GmOvrlStMgrHaptcAmp -> GmOvrlStMgr.GmOvrlStMgrHaptcAmp
    connect CalRegn02CmnGroupC.GmOvrlStMgrHaptcDurn -> GmOvrlStMgr.GmOvrlStMgrHaptcDurn
    connect CalRegn02CmnGroupC.GmOvrlStMgrLkaVehSpdHiLim -> GmOvrlStMgr.GmOvrlStMgrLkaVehSpdHiLim
    connect CalRegn02CmnGroupC.GmOvrlStMgrLkaVehSpdLoLim -> GmOvrlStMgr.GmOvrlStMgrLkaVehSpdLoLim
    connect CalRegn02CmnGroupC.HowDetnHiFrqGainY -> HowDetn.HowDetnHiFrqGainY
    connect CalRegn02CmnGroupC.HowDetnHiFrqRateX -> HowDetn.HowDetnHiFrqRateX
    connect CalRegn02CmnGroupC.HowDetnHiFrqRateY -> HowDetn.HowDetnHiFrqRateY
    connect CalRegn02CmnGroupC.HowDetnLoFrqRateX -> HowDetn.HowDetnLoFrqRateX
    connect CalRegn02CmnGroupC.HowDetnLoFrqRateY -> HowDetn.HowDetnLoFrqRateY
    connect CalRegn02CmnGroupC.HowDetnMinVehSpd -> HowDetn.HowDetnMinVehSpd
    connect CalRegn02CmnGroupC.HowDetnPercOfPrevHowEstim -> HowDetn.HowDetnPercOfPrevHowEstim
    connect CalRegn02CmnGroupC.HowDetnSlewRate -> HowDetn.HowDetnSlewRate
    connect CalRegn02CmnGroupC.HowDetnStThdX -> HowDetn.HowDetnStThdX
    connect CalRegn02CmnGroupC.HowDetnTqHpFilFrq -> HowDetn.HowDetnTqHpFilFrq
    connect CalRegn02CmnGroupC.HowDetnVehSpd -> HowDetn.HowDetnVehSpd
    connect CalRegn02CmnGroupC.SnsrOffsLrngFctEna -> SnsrOffsLrng.SnsrOffsLrngFctEna
    connect CalRegn02CmnGroupC.SnsrOffsLrngHwAgLrngDrvgDstThd -> SnsrOffsLrng.SnsrOffsLrngHwAgLrngDrvgDstThd
    connect CalRegn02CmnGroupC.SnsrOffsLrngHwAgLrngEna -> SnsrOffsLrng.SnsrOffsLrngHwAgLrngEna
    connect CalRegn02CmnGroupC.SnsrOffsLrngHwAgLrngHwVelThd -> SnsrOffsLrng.SnsrOffsLrngHwAgLrngHwVelThd
    connect CalRegn02CmnGroupC.SnsrOffsLrngHwAgLrngSysTqThd -> SnsrOffsLrng.SnsrOffsLrngHwAgLrngSysTqThd
    connect CalRegn02CmnGroupC.SnsrOffsLrngHwAgLrngSysTqThdMed -> SnsrOffsLrng.SnsrOffsLrngHwAgLrngSysTqThdMed
    connect CalRegn02CmnGroupC.SnsrOffsLrngHwAgLrngSysTqThdTrustd -> SnsrOffsLrng.SnsrOffsLrngHwAgLrngSysTqThdTrustd
    connect CalRegn02CmnGroupC.SnsrOffsLrngHwAgLrngSysTqThdWide -> SnsrOffsLrng.SnsrOffsLrngHwAgLrngSysTqThdWide
    connect CalRegn02CmnGroupC.SnsrOffsLrngHwAgLrngVehSpdThd -> SnsrOffsLrng.SnsrOffsLrngHwAgLrngVehSpdThd
    connect CalRegn02CmnGroupC.SnsrOffsLrngHwAgLrngYawOffsDbnd -> SnsrOffsLrng.SnsrOffsLrngHwAgLrngYawOffsDbnd
    connect CalRegn02CmnGroupC.SnsrOffsLrngHwAgLrngYawRateThd -> SnsrOffsLrng.SnsrOffsLrngHwAgLrngYawRateThd
    connect CalRegn02CmnGroupC.SnsrOffsLrngHwAgOffsLim -> SnsrOffsLrng.SnsrOffsLrngHwAgOffsLim
    connect CalRegn02CmnGroupC.SnsrOffsLrngHwTqLrngEna -> SnsrOffsLrng.SnsrOffsLrngHwTqLrngEna
    connect CalRegn02CmnGroupC.SnsrOffsLrngHwTqLrngEnaTiThd -> SnsrOffsLrng.SnsrOffsLrngHwTqLrngEnaTiThd
    connect CalRegn02CmnGroupC.SnsrOffsLrngHwTqLrngHwAgDbnd -> SnsrOffsLrng.SnsrOffsLrngHwTqLrngHwAgDbnd
    connect CalRegn02CmnGroupC.SnsrOffsLrngHwTqLrngHwAgThd -> SnsrOffsLrng.SnsrOffsLrngHwTqLrngHwAgThd
    connect CalRegn02CmnGroupC.SnsrOffsLrngHwTqLrngHwTqThd -> SnsrOffsLrng.SnsrOffsLrngHwTqLrngHwTqThd
    connect CalRegn02CmnGroupC.SnsrOffsLrngHwTqLrngHwVelThd -> SnsrOffsLrng.SnsrOffsLrngHwTqLrngHwVelThd
    connect CalRegn02CmnGroupC.SnsrOffsLrngHwTqLrngMeasTiScar -> SnsrOffsLrng.SnsrOffsLrngHwTqLrngMeasTiScar
    connect CalRegn02CmnGroupC.SnsrOffsLrngHwTqLrngVehSpdThd -> SnsrOffsLrng.SnsrOffsLrngHwTqLrngVehSpdThd
    connect CalRegn02CmnGroupC.SnsrOffsLrngHwTqOffsLim -> SnsrOffsLrng.SnsrOffsLrngHwTqOffsLim
    connect CalRegn02CmnGroupC.SnsrOffsLrngTqInpDetnPwrEstimnThd -> SnsrOffsLrng.SnsrOffsLrngTqInpDetnPwrEstimnThd
    connect CalRegn02CmnGroupC.SnsrOffsLrngTqInpDetnSinGenrAmp -> SnsrOffsLrng.SnsrOffsLrngTqInpDetnSinGenrAmp
    connect CalRegn02CmnGroupC.SnsrOffsLrngTqInpDetnSinGenrFrq -> SnsrOffsLrng.SnsrOffsLrngTqInpDetnSinGenrFrq
    connect CalRegn02CmnGroupC.SnsrOffsLrngTqInpDetnStg1FilGain -> SnsrOffsLrng.SnsrOffsLrngTqInpDetnStg1FilGain
    connect CalRegn02CmnGroupC.SnsrOffsLrngTqInpDetnStg1WinSize -> SnsrOffsLrng.SnsrOffsLrngTqInpDetnStg1WinSize
    connect CalRegn02CmnGroupC.SnsrOffsLrngTqInpDetnStg2FilGainCen -> SnsrOffsLrng.SnsrOffsLrngTqInpDetnStg2FilGainCen
    connect CalRegn02CmnGroupC.SnsrOffsLrngTqInpDetnStg2FilGainDwn -> SnsrOffsLrng.SnsrOffsLrngTqInpDetnStg2FilGainDwn
    connect CalRegn02CmnGroupC.SnsrOffsLrngTqInpDetnStg2FilGainUp -> SnsrOffsLrng.SnsrOffsLrngTqInpDetnStg2FilGainUp
    connect CalRegn02CmnGroupC.SnsrOffsLrngTqInpDetnStg2WinSize -> SnsrOffsLrng.SnsrOffsLrngTqInpDetnStg2WinSize
    connect CalRegn02CmnGroupC.SnsrOffsLrngYawLrngEna -> SnsrOffsLrng.SnsrOffsLrngYawLrngEna
    connect CalRegn02CmnGroupC.SnsrOffsLrngYawLrngHwAgThd -> SnsrOffsLrng.SnsrOffsLrngYawLrngHwAgThd
    connect CalRegn02CmnGroupC.SnsrOffsLrngYawLrngYawAThd -> SnsrOffsLrng.SnsrOffsLrngYawLrngYawAThd
    connect CalRegn02CmnGroupC.SnsrOffsLrngYawOffsFrshTiThd -> SnsrOffsLrng.SnsrOffsLrngYawOffsFrshTiThd
    connect CalRegn02CmnGroupC.SnsrOffsLrngYawRateOffsLim -> SnsrOffsLrng.SnsrOffsLrngYawRateOffsLim
    connect CalRegn02Inin00.GmStrtStopEna -> CustDiagc.GmStrtStopEna
    connect CalRegn02Inin00.GmOvrlStMgrApaHwTqFilFrq -> GmOvrlStMgr.GmOvrlStMgrApaHwTqFilFrq
    connect CalRegn02Inin00.GmOvrlStMgrHwTqFilFrq -> GmOvrlStMgr.GmOvrlStMgrHwTqFilFrq
    connect CalRegn02Inin00.GmOvrlStMgrLkaHwTqFilFrq -> GmOvrlStMgr.GmOvrlStMgrLkaHwTqFilFrq
    connect CalRegn02Inin00.GmOvrlStMgrLkaHwTqTiThd2 -> GmOvrlStMgr.GmOvrlStMgrLkaHwTqTiThd2
    connect CalRegn02Inin00.GmStrtStopEna -> GmStrtStop.GmStrtStopEna
    connect CalRegn02Inin00.GmTqArbnApaAssiScaEna -> GmTqArbn.GmTqArbnApaAssiScaEna
    connect CalRegn02Inin00.GmTqArbnApaDampgScaEna -> GmTqArbn.GmTqArbnApaDampgScaEna
    connect CalRegn02Inin00.GmTqArbnApaRtnScaEna -> GmTqArbn.GmTqArbnApaRtnScaEna
    connect CalRegn02Inin00.GmTqArbnEscMaxTq -> GmTqArbn.GmTqArbnEscMaxTq
    connect CalRegn02Inin00.GmTqArbnLkaOutpOvrlUpprLim -> GmTqArbn.GmTqArbnLkaOutpOvrlUpprLim
    connect CalRegn02Inin00.HowDetnEstimLpFilFrq -> HowDetn.HowDetnEstimLpFilFrq
    connect CalRegn02Inin00.HowDetnStLpFilFrq -> HowDetn.HowDetnStLpFilFrq
    connect CalRegn02Inin00.HowDetnTqFinalLpFilFrq -> HowDetn.HowDetnTqFinalLpFilFrq
    connect CalRegn02Inin00.HowDetnTqInitLpFilFrq -> HowDetn.HowDetnTqInitLpFilFrq
    connect CalRegn02Inin00.SnsrOffsLrngHwVelFilFrq -> SnsrOffsLrng.SnsrOffsLrngHwVelFilFrq
    connect CalRegn02Inin00.SnsrOffsLrngTqAndAgFilFrq -> SnsrOffsLrng.SnsrOffsLrngTqAndAgFilFrq
    connect CalRegn02Inin00.SnsrOffsLrngTqInpDetnHwTqFilFrq -> SnsrOffsLrng.SnsrOffsLrngTqInpDetnHwTqFilFrq
    connect CalRegn02Inin00.SnsrOffsLrngYawACdngFilFrq -> SnsrOffsLrng.SnsrOffsLrngYawACdngFilFrq
    connect CalRegn02Inin00.SnsrOffsLrngYawRateCdngFilFrq -> SnsrOffsLrng.SnsrOffsLrngYawRateCdngFilFrq
    connect CalRegn02Inin00GroupA.GmOvrlStMgrLkaHwTqTiThd1 -> GmOvrlStMgr.GmOvrlStMgrLkaHwTqTiThd1
    connect CalRegn02Inin00GroupC.GmOvrlStMgrApaHwTqTiThd -> GmOvrlStMgr.GmOvrlStMgrApaHwTqTiThd
    connect CalRegn02Inin00GroupC.GmOvrlStMgrHaptcFrq -> GmOvrlStMgr.GmOvrlStMgrHaptcFrq
    connect CalRegn02Inin00GroupC.GmOvrlStMgrHaptcReactnTi -> GmOvrlStMgr.GmOvrlStMgrHaptcReactnTi
    connect CalRegn02Inin00GroupC.GmOvrlStMgrHaptcReqTiThd -> GmOvrlStMgr.GmOvrlStMgrHaptcReqTiThd
    connect CalRegn02Inin00GroupC.GmStrtStopFltRateLim -> GmStrtStop.GmStrtStopFltRateLim
    connect CalRegn02Inin00GroupC.GmStrtStopMod1EngTranThd -> GmStrtStop.GmStrtStopMod1EngTranThd
    connect CalRegn02Inin00GroupC.GmStrtStopMod1Sca -> GmStrtStop.GmStrtStopMod1Sca
    connect CalRegn02Inin00GroupC.GmStrtStopMod1ToStopRateLim -> GmStrtStop.GmStrtStopMod1ToStopRateLim
    connect CalRegn02Inin00GroupC.GmStrtStopMod1VehSpdTranThd -> GmStrtStop.GmStrtStopMod1VehSpdTranThd
    connect CalRegn02Inin00GroupC.GmStrtStopMod2Sca -> GmStrtStop.GmStrtStopMod2Sca
    connect CalRegn02Inin00GroupC.GmStrtStopNormModEngTranThd -> GmStrtStop.GmStrtStopNormModEngTranThd
    connect CalRegn02Inin00GroupC.GmStrtStopNormModVehSpdTranThd -> GmStrtStop.GmStrtStopNormModVehSpdTranThd
    connect CalRegn02Inin00GroupC.GmStrtStopNormRateLim -> GmStrtStop.GmStrtStopNormRateLim
    connect CalRegn02Inin00GroupC.GmStrtStopNormToMod1RateLim -> GmStrtStop.GmStrtStopNormToMod1RateLim
    connect CalRegn02Inin00GroupC.GmStrtStopStopAndMod2RateLim -> GmStrtStop.GmStrtStopStopAndMod2RateLim
    connect CalRegn02Inin00GroupC.GmStrtStopStopMod1HwTqTranThd -> GmStrtStop.GmStrtStopStopMod1HwTqTranThd
    connect CalRegn02Inin00GroupC.GmStrtStopStopMod1HwVelTranThd -> GmStrtStop.GmStrtStopStopMod1HwVelTranThd
    connect CalRegn02Inin00GroupC.GmStrtStopStopMod1Tmr -> GmStrtStop.GmStrtStopStopMod1Tmr
    connect CalRegn02Inin00GroupC.GmStrtStopStopMod1VehSpdTranThd -> GmStrtStop.GmStrtStopStopMod1VehSpdTranThd
    connect CalRegn02Inin00GroupC.GmStrtStopStopMod2HwTqTranThd -> GmStrtStop.GmStrtStopStopMod2HwTqTranThd
    connect CalRegn02Inin00GroupC.GmStrtStopStopMod2HwVelTranThd -> GmStrtStop.GmStrtStopStopMod2HwVelTranThd
    connect CalRegn02Inin00GroupC.GmStrtStopStopMod2Tmr -> GmStrtStop.GmStrtStopStopMod2Tmr
    connect CalRegn02Inin00GroupC.GmStrtStopStopMod2VehSpdTranThd -> GmStrtStop.GmStrtStopStopMod2VehSpdTranThd
    connect CalRegn02Inin00GroupC.GmStrtStopStopModSca -> GmStrtStop.GmStrtStopStopModSca
    connect CalRegn02Inin00GroupC.GmTqArbnApaDiRateX -> GmTqArbn.GmTqArbnApaDiRateX
    connect CalRegn02Inin00GroupC.GmTqArbnLkaSlewEna -> GmTqArbn.GmTqArbnLkaSlewEna
    connect CalRegn02Inin00GroupC.HowDetnOffThd -> HowDetn.HowDetnOffThd
    connect CalRegn02Inin00GroupC.HowDetnOffTi -> HowDetn.HowDetnOffTi
    connect CalRegn02Rt00GroupC.GmOvrlStMgrHwAgTarLimr -> AAACalRegn02Rt01GroupC_Dummy.GmOvrlStMgrHwAgTarLimr
    connect CalRegn02Rt00GroupC.GmOvrlStMgrShiftLvrTiThd -> AAACalRegn02Rt01GroupC_Dummy.GmOvrlStMgrShiftLvrTiThd
    connect CalRegn02Rt00GroupC.GmOvrlStMgrStandStillThd -> AAACalRegn02Rt01GroupC_Dummy.GmOvrlStMgrStandStillThd
    connect CalRegn02Rt00GroupC.GmOvrlStMgrStandStillTiThd -> AAACalRegn02Rt01GroupC_Dummy.GmOvrlStMgrStandStillTiThd
    connect CalRegn02Rt00GroupC.GmTqArbnApaDiRateY -> AAACalRegn02Rt01GroupC_Dummy.GmTqArbnApaDiRateY
    connect CalRegn02Rt00GroupC.GmTqArbnApaEnaRate -> AAACalRegn02Rt01GroupC_Dummy.GmTqArbnApaEnaRate
    connect CalRegn02Rt00GroupC.GmTqArbnApaSmotngHwTqLpFilFrq -> AAACalRegn02Rt01GroupC_Dummy.GmTqArbnApaSmotngHwTqLpFilFrq
    connect CalRegn02Rt00GroupC.GmTqArbnApaSmotngX -> AAACalRegn02Rt01GroupC_Dummy.GmTqArbnApaSmotngX
    connect CalRegn02Rt00GroupC.GmTqArbnApaSmotngY -> AAACalRegn02Rt01GroupC_Dummy.GmTqArbnApaSmotngY
    connect CalRegn02Rt00GroupC.GmTqArbnLkaOutpOvrlX -> AAACalRegn02Rt01GroupC_Dummy.GmTqArbnLkaOutpOvrlX
    connect CalRegn02Rt00GroupC.GmTqArbnLkaOutpOvrlY -> AAACalRegn02Rt01GroupC_Dummy.GmTqArbnLkaOutpOvrlY
    connect CalRegn02Rt00GroupC.GmTqArbnLkaSlewX -> AAACalRegn02Rt01GroupC_Dummy.GmTqArbnLkaSlewX
    connect CalRegn02Rt00GroupC.GmTqArbnLkaSlewY -> AAACalRegn02Rt01GroupC_Dummy.GmTqArbnLkaSlewY
    connect CalRegn02Rt00GroupC.GmOvrlStMgrHwAgTarLimr -> GmOvrlStMgr.GmOvrlStMgrHwAgTarLimr
    connect CalRegn02Rt00GroupC.GmOvrlStMgrShiftLvrTiThd -> GmOvrlStMgr.GmOvrlStMgrShiftLvrTiThd
    connect CalRegn02Rt00GroupC.GmOvrlStMgrStandStillThd -> GmOvrlStMgr.GmOvrlStMgrStandStillThd
    connect CalRegn02Rt00GroupC.GmOvrlStMgrStandStillTiThd -> GmOvrlStMgr.GmOvrlStMgrStandStillTiThd
    connect CalRegn02Rt00GroupC.GmTqArbnApaDiRateY -> GmTqArbn.GmTqArbnApaDiRateY
    connect CalRegn02Rt00GroupC.GmTqArbnApaEnaRate -> GmTqArbn.GmTqArbnApaEnaRate
    connect CalRegn02Rt00GroupC.GmTqArbnApaSmotngHwTqLpFilFrq -> GmTqArbn.GmTqArbnApaSmotngHwTqLpFilFrq
    connect CalRegn02Rt00GroupC.GmTqArbnApaSmotngX -> GmTqArbn.GmTqArbnApaSmotngX
    connect CalRegn02Rt00GroupC.GmTqArbnApaSmotngY -> GmTqArbn.GmTqArbnApaSmotngY
    connect CalRegn02Rt00GroupC.GmTqArbnLkaOutpOvrlX -> GmTqArbn.GmTqArbnLkaOutpOvrlX
    connect CalRegn02Rt00GroupC.GmTqArbnLkaOutpOvrlY -> GmTqArbn.GmTqArbnLkaOutpOvrlY
    connect CalRegn02Rt00GroupC.GmTqArbnLkaSlewX -> GmTqArbn.GmTqArbnLkaSlewX
    connect CalRegn02Rt00GroupC.GmTqArbnLkaSlewY -> GmTqArbn.GmTqArbnLkaSlewY
    connect CalRegn02Rt01GroupC.GmOvrlStMgrHwAgTarLimr -> AAACalRegn02Rt01GroupC_Dummy_1.GmOvrlStMgrHwAgTarLimr
    connect CalRegn02Rt01GroupC.GmOvrlStMgrShiftLvrTiThd -> AAACalRegn02Rt01GroupC_Dummy_1.GmOvrlStMgrShiftLvrTiThd
    connect CalRegn02Rt01GroupC.GmOvrlStMgrStandStillThd -> AAACalRegn02Rt01GroupC_Dummy_1.GmOvrlStMgrStandStillThd
    connect CalRegn02Rt01GroupC.GmOvrlStMgrStandStillTiThd -> AAACalRegn02Rt01GroupC_Dummy_1.GmOvrlStMgrStandStillTiThd
    connect CalRegn02Rt01GroupC.GmTqArbnApaDiRateY -> AAACalRegn02Rt01GroupC_Dummy_1.GmTqArbnApaDiRateY
    connect CalRegn02Rt01GroupC.GmTqArbnApaEnaRate -> AAACalRegn02Rt01GroupC_Dummy_1.GmTqArbnApaEnaRate
    connect CalRegn02Rt01GroupC.GmTqArbnApaSmotngHwTqLpFilFrq -> AAACalRegn02Rt01GroupC_Dummy_1.GmTqArbnApaSmotngHwTqLpFilFrq
    connect CalRegn02Rt01GroupC.GmTqArbnApaSmotngX -> AAACalRegn02Rt01GroupC_Dummy_1.GmTqArbnApaSmotngX
    connect CalRegn02Rt01GroupC.GmTqArbnApaSmotngY -> AAACalRegn02Rt01GroupC_Dummy_1.GmTqArbnApaSmotngY
    connect CalRegn02Rt01GroupC.GmTqArbnLkaOutpOvrlX -> AAACalRegn02Rt01GroupC_Dummy_1.GmTqArbnLkaOutpOvrlX
    connect CalRegn02Rt01GroupC.GmTqArbnLkaOutpOvrlY -> AAACalRegn02Rt01GroupC_Dummy_1.GmTqArbnLkaOutpOvrlY
    connect CalRegn02Rt01GroupC.GmTqArbnLkaSlewX -> AAACalRegn02Rt01GroupC_Dummy_1.GmTqArbnLkaSlewX
    connect CalRegn02Rt01GroupC.GmTqArbnLkaSlewY -> AAACalRegn02Rt01GroupC_Dummy_1.GmTqArbnLkaSlewY
    connect CalRegn02Rt02GroupC.GmOvrlStMgrHwAgTarLimr -> AAACalRegn02Rt01GroupC_Dummy_2.GmOvrlStMgrHwAgTarLimr
    connect CalRegn02Rt02GroupC.GmOvrlStMgrShiftLvrTiThd -> AAACalRegn02Rt01GroupC_Dummy_2.GmOvrlStMgrShiftLvrTiThd
    connect CalRegn02Rt02GroupC.GmOvrlStMgrStandStillThd -> AAACalRegn02Rt01GroupC_Dummy_2.GmOvrlStMgrStandStillThd
    connect CalRegn02Rt02GroupC.GmOvrlStMgrStandStillTiThd -> AAACalRegn02Rt01GroupC_Dummy_2.GmOvrlStMgrStandStillTiThd
    connect CalRegn02Rt02GroupC.GmTqArbnApaDiRateY -> AAACalRegn02Rt01GroupC_Dummy_2.GmTqArbnApaDiRateY
    connect CalRegn02Rt02GroupC.GmTqArbnApaEnaRate -> AAACalRegn02Rt01GroupC_Dummy_2.GmTqArbnApaEnaRate
    connect CalRegn02Rt02GroupC.GmTqArbnApaSmotngHwTqLpFilFrq -> AAACalRegn02Rt01GroupC_Dummy_2.GmTqArbnApaSmotngHwTqLpFilFrq
    connect CalRegn02Rt02GroupC.GmTqArbnApaSmotngX -> AAACalRegn02Rt01GroupC_Dummy_2.GmTqArbnApaSmotngX
    connect CalRegn02Rt02GroupC.GmTqArbnApaSmotngY -> AAACalRegn02Rt01GroupC_Dummy_2.GmTqArbnApaSmotngY
    connect CalRegn02Rt02GroupC.GmTqArbnLkaOutpOvrlX -> AAACalRegn02Rt01GroupC_Dummy_2.GmTqArbnLkaOutpOvrlX
    connect CalRegn02Rt02GroupC.GmTqArbnLkaOutpOvrlY -> AAACalRegn02Rt01GroupC_Dummy_2.GmTqArbnLkaOutpOvrlY
    connect CalRegn02Rt02GroupC.GmTqArbnLkaSlewX -> AAACalRegn02Rt01GroupC_Dummy_2.GmTqArbnLkaSlewX
    connect CalRegn02Rt02GroupC.GmTqArbnLkaSlewY -> AAACalRegn02Rt01GroupC_Dummy_2.GmTqArbnLkaSlewY
    connect CalRegn02Rt03GroupC.GmOvrlStMgrHwAgTarLimr -> AAACalRegn02Rt01GroupC_Dummy_3.GmOvrlStMgrHwAgTarLimr
    connect CalRegn02Rt03GroupC.GmOvrlStMgrShiftLvrTiThd -> AAACalRegn02Rt01GroupC_Dummy_3.GmOvrlStMgrShiftLvrTiThd
    connect CalRegn02Rt03GroupC.GmOvrlStMgrStandStillThd -> AAACalRegn02Rt01GroupC_Dummy_3.GmOvrlStMgrStandStillThd
    connect CalRegn02Rt03GroupC.GmOvrlStMgrStandStillTiThd -> AAACalRegn02Rt01GroupC_Dummy_3.GmOvrlStMgrStandStillTiThd
    connect CalRegn02Rt03GroupC.GmTqArbnApaDiRateY -> AAACalRegn02Rt01GroupC_Dummy_3.GmTqArbnApaDiRateY
    connect CalRegn02Rt03GroupC.GmTqArbnApaEnaRate -> AAACalRegn02Rt01GroupC_Dummy_3.GmTqArbnApaEnaRate
    connect CalRegn02Rt03GroupC.GmTqArbnApaSmotngHwTqLpFilFrq -> AAACalRegn02Rt01GroupC_Dummy_3.GmTqArbnApaSmotngHwTqLpFilFrq
    connect CalRegn02Rt03GroupC.GmTqArbnApaSmotngX -> AAACalRegn02Rt01GroupC_Dummy_3.GmTqArbnApaSmotngX
    connect CalRegn02Rt03GroupC.GmTqArbnApaSmotngY -> AAACalRegn02Rt01GroupC_Dummy_3.GmTqArbnApaSmotngY
    connect CalRegn02Rt03GroupC.GmTqArbnLkaOutpOvrlX -> AAACalRegn02Rt01GroupC_Dummy_3.GmTqArbnLkaOutpOvrlX
    connect CalRegn02Rt03GroupC.GmTqArbnLkaOutpOvrlY -> AAACalRegn02Rt01GroupC_Dummy_3.GmTqArbnLkaOutpOvrlY
    connect CalRegn02Rt03GroupC.GmTqArbnLkaSlewX -> AAACalRegn02Rt01GroupC_Dummy_3.GmTqArbnLkaSlewX
    connect CalRegn02Rt03GroupC.GmTqArbnLkaSlewY -> AAACalRegn02Rt01GroupC_Dummy_3.GmTqArbnLkaSlewY
    connect CalRegn02Rt04GroupC.GmOvrlStMgrHwAgTarLimr -> AAACalRegn02Rt01GroupC_Dummy_4.GmOvrlStMgrHwAgTarLimr
    connect CalRegn02Rt04GroupC.GmOvrlStMgrShiftLvrTiThd -> AAACalRegn02Rt01GroupC_Dummy_4.GmOvrlStMgrShiftLvrTiThd
    connect CalRegn02Rt04GroupC.GmOvrlStMgrStandStillThd -> AAACalRegn02Rt01GroupC_Dummy_4.GmOvrlStMgrStandStillThd
    connect CalRegn02Rt04GroupC.GmOvrlStMgrStandStillTiThd -> AAACalRegn02Rt01GroupC_Dummy_4.GmOvrlStMgrStandStillTiThd
    connect CalRegn02Rt04GroupC.GmTqArbnApaDiRateY -> AAACalRegn02Rt01GroupC_Dummy_4.GmTqArbnApaDiRateY
    connect CalRegn02Rt04GroupC.GmTqArbnApaEnaRate -> AAACalRegn02Rt01GroupC_Dummy_4.GmTqArbnApaEnaRate
    connect CalRegn02Rt04GroupC.GmTqArbnApaSmotngHwTqLpFilFrq -> AAACalRegn02Rt01GroupC_Dummy_4.GmTqArbnApaSmotngHwTqLpFilFrq
    connect CalRegn02Rt04GroupC.GmTqArbnApaSmotngX -> AAACalRegn02Rt01GroupC_Dummy_4.GmTqArbnApaSmotngX
    connect CalRegn02Rt04GroupC.GmTqArbnApaSmotngY -> AAACalRegn02Rt01GroupC_Dummy_4.GmTqArbnApaSmotngY
    connect CalRegn02Rt04GroupC.GmTqArbnLkaOutpOvrlX -> AAACalRegn02Rt01GroupC_Dummy_4.GmTqArbnLkaOutpOvrlX
    connect CalRegn02Rt04GroupC.GmTqArbnLkaOutpOvrlY -> AAACalRegn02Rt01GroupC_Dummy_4.GmTqArbnLkaOutpOvrlY
    connect CalRegn02Rt04GroupC.GmTqArbnLkaSlewX -> AAACalRegn02Rt01GroupC_Dummy_4.GmTqArbnLkaSlewX
    connect CalRegn02Rt04GroupC.GmTqArbnLkaSlewY -> AAACalRegn02Rt01GroupC_Dummy_4.GmTqArbnLkaSlewY
    connect CalRegn03Cmn.AssiHiFrqHpFilFrqY -> AssiHiFrq.AssiHiFrqHpFilFrqY
    connect CalRegn03Cmn.DampgQuadHwTqBacklsh -> Dampg.DampgQuadHwTqBacklsh
    connect CalRegn03Cmn.DampgQuadMotVelBacklsh -> Dampg.DampgQuadMotVelBacklsh
    connect CalRegn03Cmn.EotLrngHwAgOverTrvlEntr -> EotLrng.EotLrngHwAgOverTrvlEntr
    connect CalRegn03Cmn.EotLrngHwAgOverTrvlExit -> EotLrng.EotLrngHwAgOverTrvlExit
    connect CalRegn03Cmn.EotProtnSoftEndStopAuthyThd -> EotProtn.EotProtnSoftEndStopAuthyThd
    connect CalRegn03Cmn.EotProtnSoftEndStopAuthyThd -> EotProtnFwl.EotProtnSoftEndStopAuthyThd
    connect CalRegn03Cmn.HwAgTrakgServoDiRateX -> HwAgTrakgServo.HwAgTrakgServoDiRateX
    connect CalRegn03Cmn.HwAgTrakgServoDiRateY -> HwAgTrakgServo.HwAgTrakgServoDiRateY
    connect CalRegn03Cmn.HwAgTrakgServoEnaRate -> HwAgTrakgServo.HwAgTrakgServoEnaRate
    connect CalRegn03Cmn.HwAgTrakgServoExecRate -> HwAgTrakgServo.HwAgTrakgServoExecRate
    connect CalRegn03Cmn.HwAgTrakgServoHwAgRateLim -> HwAgTrakgServo.HwAgTrakgServoHwAgRateLim
    connect CalRegn03Cmn.HwAgTrakgServoMaxCmdX -> HwAgTrakgServo.HwAgTrakgServoMaxCmdX
    connect CalRegn03Cmn.HwAgTrakgServoMaxCmdY -> HwAgTrakgServo.HwAgTrakgServoMaxCmdY
    connect CalRegn03Cmn.HwAgTrakgServoMaxRamp -> HwAgTrakgServo.HwAgTrakgServoMaxRamp
    connect CalRegn03Cmn.HwAgTrakgServoMinRamp -> HwAgTrakgServo.HwAgTrakgServoMinRamp
    connect CalRegn03Cmn.HwAgTrakgServoPidLim -> HwAgTrakgServo.HwAgTrakgServoPidLim
    connect CalRegn03Cmn.HwAgTrakgServoRampCmpl -> HwAgTrakgServo.HwAgTrakgServoRampCmpl
    connect CalRegn03Cmn.HwAgTrakgServoVehSpdBasd -> HwAgTrakgServo.HwAgTrakgServoVehSpdBasd
    connect CalRegn03Cmn.NxtrCalIdsCal2DevlpAuthor -> NxtrCalIds.NxtrCalIdsCal2DevlpAuthor
    connect CalRegn03Cmn.NxtrCalIdsCal2DevlpDesc -> NxtrCalIds.NxtrCalIdsCal2DevlpDescr
    connect CalRegn03Cmn.NxtrCalIdsCal2DevlpRelNr -> NxtrCalIds.NxtrCalIdsCal2DevlpRelNr
    connect CalRegn03Cmn.NxtrCalIdsCal2DevlpRelSt -> NxtrCalIds.NxtrCalIdsCal2DevlpRelSt
    connect CalRegn03Cmn.NxtrCalIdsCal2DevlpTiStamp -> NxtrCalIds.NxtrCalIdsCal2DevlpTiStamp
    connect CalRegn03Cmn.NxtrCalIdsCal2DevlpVers -> NxtrCalIds.NxtrCalIdsCal2DevlpVers
    connect CalRegn03Cmn.TqLoaDrvrTqNom -> TqLoa.TqLoaDrvrTqNom
    connect CalRegn03Cmn.TqLoaMotTqCmdLim -> TqLoa.TqLoaMotTqCmdLim
    connect CalRegn03Cmn.TqLoaMotVelAndTqBasdScaFacFallRate -> TqLoa.TqLoaMotVelAndTqBasdScaFacFallRate
    connect CalRegn03Cmn.TqLoaMotVelAndTqBasdScaFacMax -> TqLoa.TqLoaMotVelAndTqBasdScaFacMax
    connect CalRegn03Cmn.TqLoaMotVelAndTqBasdScaFacMin -> TqLoa.TqLoaMotVelAndTqBasdScaFacMin
    connect CalRegn03Cmn.TqLoaMotVelAndTqBasdScaFacRiseRate -> TqLoa.TqLoaMotVelAndTqBasdScaFacRiseRate
    connect CalRegn03Cmn.TqLoaMotVelMgnThd -> TqLoa.TqLoaMotVelMgnThd
    connect CalRegn03Cmn.TqLoaTqCmdLimY -> TqLoa.TqLoaTqCmdLimY
    connect CalRegn03Cmn.TqLoaTqCmdMgnThd -> TqLoa.TqLoaTqCmdMgnThd
    connect CalRegn03Cmn.TqLoaVehLatADifScaFacFallRate -> TqLoa.TqLoaVehLatADifScaFacFallRate
    connect CalRegn03Cmn.TqLoaVehLatADifScaFacRiseRate -> TqLoa.TqLoaVehLatADifScaFacRiseRate
    connect CalRegn03Cmn.TqLoaVehLatADifScaFacX -> TqLoa.TqLoaVehLatADifScaFacX
    connect CalRegn03Cmn.TqLoaVehLatADifScaFacY -> TqLoa.TqLoaVehLatADifScaFacY
    connect CalRegn03Cmn.TqLoaVehLatAEstimnFilFrq -> TqLoa.TqLoaVehLatAEstimnFilFrq
    connect CalRegn03Cmn.TqLoaVehLatAGainY -> TqLoa.TqLoaVehLatAGainY
    connect CalRegn03Cmn.TqLoaVehSpdScaFacX -> TqLoa.TqLoaVehSpdScaFacX
    connect CalRegn03Cmn.TqLoaVehSpdScaFacY -> TqLoa.TqLoaVehSpdScaFacY
    connect CalRegn03Cmn.TqLoaVehSpdX -> TqLoa.TqLoaVehSpdX
    connect CalRegn03Cmn.TqLoaVehSteerRat -> TqLoa.TqLoaVehSteerRat
    connect CalRegn03Cmn.TqLoaVehUnderSteerGrdt -> TqLoa.TqLoaVehUnderSteerGrdt
    connect CalRegn03Cmn.TqLoaVehWhlBas -> TqLoa.TqLoaVehWhlBas
    connect CalRegn03Cmn.WhlImbRejctnCmdMgnLp1FilFrq -> WhlImbRejctn.WhlImbRejctnCmdMgnLp1FilFrq
    connect CalRegn03Cmn.WhlImbRejctnCmdMgnLp2FilFrq -> WhlImbRejctn.WhlImbRejctnCmdMgnLp2FilFrq
    connect CalRegn03Cmn.WhlImbRejctnDcTrendLpFil -> WhlImbRejctn.WhlImbRejctnDcTrendLpFil
    connect CalRegn03CmnGroupA.AssiThermScaX -> Assi.AssiThermScaX
    connect CalRegn03CmnGroupA.AssiThermScaY -> Assi.AssiThermScaY
    connect CalRegn03CmnGroupA.DampgHwTqX -> Dampg.DampgHwTqX
    connect CalRegn03CmnGroupA.DampgHwTqY -> Dampg.DampgHwTqY
    connect CalRegn03CmnGroupA.HysCmpEffLossY -> HysCmp.HysCmpEffLossY
    connect CalRegn03CmnGroupA.HysCmpEffOffsY -> HysCmp.HysCmpEffOffsY
    connect CalRegn03CmnGroupA.HysCmpHwTqScaX -> HysCmp.HysCmpHwTqScaX
    connect CalRegn03CmnGroupA.HysCmpHwTqScaY -> HysCmp.HysCmpHwTqScaY
    connect CalRegn03CmnGroupA.HysCmpHysSatnY -> HysCmp.HysCmpHysSatnY
    connect CalRegn03CmnGroupA.HysCmpNegHysCmpScaX -> HysCmp.HysCmpNegHysCmpScaX
    connect CalRegn03CmnGroupA.HysCmpNegHysCmpScaY -> HysCmp.HysCmpNegHysCmpScaY
    connect CalRegn03CmnGroupA.HysCmpNegHysCmpX -> HysCmp.HysCmpNegHysCmpX
    connect CalRegn03CmnGroupA.HysCmpNegHysCmpY -> HysCmp.HysCmpNegHysCmpY
    connect CalRegn03CmnGroupA.HysCmpOutpLim -> HysCmp.HysCmpOutpLim
    connect CalRegn03CmnGroupA.HysCmpRevGain -> HysCmp.HysCmpRevGain
    connect CalRegn03CmnGroupA.HysCmpRiseX -> HysCmp.HysCmpRiseX
    connect CalRegn03CmnGroupA.HysCmpRiseY -> HysCmp.HysCmpRiseY
    connect CalRegn03CmnGroupA.RtnVehSpdSeln -> Rtn.RtnVehSpdSeln
    connect CalRegn03CmnGroupB.EotProtnActvRegnBypMaxThd -> EotProtn.EotProtnActvRegnBypMaxThd
    connect CalRegn03CmnGroupB.EotProtnDeltaTqThd -> EotProtn.EotProtnDeltaTqThd
    connect CalRegn03CmnGroupB.EotProtnMotSpdIncptY -> EotProtn.EotProtnMotSpdIncptY
    connect CalRegn03CmnGroupB.InertiaCmpVelDampgWhlImbRejctnBlndX -> InertiaCmpVel.InertiaCmpVelDampgWhlImbRejctnBlndX
    connect CalRegn03CmnGroupB.InertiaCmpVelDampgWhlImbRejctnBlndY -> InertiaCmpVel.InertiaCmpVelDampgWhlImbRejctnBlndY
    connect CalRegn03CmnGroupB.PullCmpActvCmpLrnTiDecShoTerm -> PullCmpActv.PullCmpActvCmpLrnTiDecShoTerm
    connect CalRegn03CmnGroupB.PullCmpActvCmpLrnTiIncShoTerm -> PullCmpActv.PullCmpActvCmpLrnTiIncShoTerm
    connect CalRegn03CmnGroupB.PullCmpActvCmpLrnTiLongTerm -> PullCmpActv.PullCmpActvCmpLrnTiLongTerm
    connect CalRegn03CmnGroupB.PullCmpActvCmpShoTermRstHwAgThd -> PullCmpActv.PullCmpActvCmpShoTermRstHwAgThd
    connect CalRegn03CmnGroupB.PullCmpActvCmpShoTermRstHwTqThd -> PullCmpActv.PullCmpActvCmpShoTermRstHwTqThd
    connect CalRegn03CmnGroupB.PullCmpActvCmpShoTermRstLatAThd -> PullCmpActv.PullCmpActvCmpShoTermRstLatAThd
    connect CalRegn03CmnGroupB.PullCmpActvCmpShoTermRstYawRateThd -> PullCmpActv.PullCmpActvCmpShoTermRstYawRate
    connect CalRegn03CmnGroupB.PullCmpActvCmpShoTermRstYawRateThd -> PullCmpActv.PullCmpActvCmpShoTermRstYawRateThd
    connect CalRegn03CmnGroupB.PullCmpActvHwTqFilFrqLongTerm -> PullCmpActv.PullCmpActvHwTqFilFrqLongTerm
    connect CalRegn03CmnGroupB.PullCmpActvHwTqFilFrqLrngEna -> PullCmpActv.PullCmpActvHwTqFilFrqLrngEna
    connect CalRegn03CmnGroupB.PullCmpActvHwTqFilFrqShoTerm -> PullCmpActv.PullCmpActvHwTqFilFrqShoTerm
    connect CalRegn03CmnGroupB.PullCmpActvLongTermLim -> PullCmpActv.PullCmpActvLongTermLim
    connect CalRegn03CmnGroupB.PullCmpActvLrngEnaAgConfMinMgn -> PullCmpActv.PullCmpActvLrngEnaAgConfMinMgn
    connect CalRegn03CmnGroupB.PullCmpActvLrngEnaHwAgMaxMgn -> PullCmpActv.PullCmpActvLrngEnaHwAgMaxMgn
    connect CalRegn03CmnGroupB.PullCmpActvLrngEnaHwTqMaxMgn -> PullCmpActv.PullCmpActvLrngEnaHwTqMaxMgn
    connect CalRegn03CmnGroupB.PullCmpActvLrngEnaHwVelMaxMgn -> PullCmpActv.PullCmpActvLrngEnaHwVelMaxMgn
    connect CalRegn03CmnGroupB.PullCmpActvLrngEnaLatAMaxMgn -> PullCmpActv.PullCmpActvLrngEnaLatAMaxMgn
    connect CalRegn03CmnGroupB.PullCmpActvLrngEnaTiThd -> PullCmpActv.PullCmpActvLrngEnaTiThd
    connect CalRegn03CmnGroupB.PullCmpActvLrngEnaVehSpdMaxMgn -> PullCmpActv.PullCmpActvLrngEnaVehSpdMaxMgn
    connect CalRegn03CmnGroupB.PullCmpActvLrngEnaVehSpdMinMgn -> PullCmpActv.PullCmpActvLrngEnaVehSpdMinMgn
    connect CalRegn03CmnGroupB.PullCmpActvLrngEnaVehSpdRateMaxMgn -> PullCmpActv.PullCmpActvLrngEnaVehSpdRateMaxMgn
    connect CalRegn03CmnGroupB.PullCmpActvLrngEnaYawRateMaxMgn -> PullCmpActv.PullCmpActvLrngEnaYawRateMaxMgn
    connect CalRegn03CmnGroupB.PullCmpActvOpstSignTiShoTerm -> PullCmpActv.PullCmpActvOpstSignTiShoTerm
    connect CalRegn03CmnGroupB.PullCmpActvOutpMaxRate -> PullCmpActv.PullCmpActvOutpMaxRate
    connect CalRegn03CmnGroupB.PullCmpActvPullCmpShoTermLim -> PullCmpActv.PullCmpActvPullCmpShoTermLim
    connect CalRegn03CmnGroupB.PullCmpActvPullCmpTotLim -> PullCmpActv.PullCmpActvPullCmpTotLim
    connect CalRegn03CmnGroupB.PullCmpActvPullErrLimLongTerm -> PullCmpActv.PullCmpActvPullErrLimLongTerm
    connect CalRegn03CmnGroupB.PullCmpActvPullErrMgnThd -> PullCmpActv.PullCmpActvPullErrMgnThd
    connect CalRegn03CmnGroupB.PullCmpActvPullErrShoTermLim -> PullCmpActv.PullCmpActvPullErrShoTermLim
    connect CalRegn03CmnGroupB.PullCmpActvShoTermRampTi -> PullCmpActv.PullCmpActvShoTermRampTi
    connect CalRegn03CmnGroupB.PullCmpActvVehSpdScaTblX -> PullCmpActv.PullCmpActvVehSpdScaTblX
    connect CalRegn03CmnGroupB.PullCmpActvVehSpdScaTblY -> PullCmpActv.PullCmpActvVehSpdScaTblY
    connect CalRegn03CmnGroupB.WhlImbRejctnAutScaEna -> WhlImbRejctn.WhlImbRejctnAutScaEna
    connect CalRegn03CmnGroupB.WhlImbRejctnAutScaTar -> WhlImbRejctn.WhlImbRejctnAutScaTar
    connect CalRegn03CmnGroupB.WhlImbRejctnRampDwnTi -> WhlImbRejctn.WhlImbRejctnRampDwnTi
    connect CalRegn03CmnGroupB.WhlImbRejctnScaCncl -> WhlImbRejctn.WhlImbRejctnScaCncl
    connect CalRegn03CmnGroupB.WhlImbRejctnUgrPoleMgn -> WhlImbRejctn.WhlImbRejctnUgrPoleMgn
    connect CalRegn03CmnGroupB.WhlImbRejctnVehSpdEna -> WhlImbRejctn.WhlImbRejctnVehSpdEna
    connect CalRegn03CmnGroupC.GmOvrlStMgrLoaMtgtnHaptcFbOffTi -> GmOvrlStMgr.GmOvrlStMgrLoaMtgtnHaptcFbOffTi
    connect CalRegn03CmnGroupC.GmOvrlStMgrLoaMtgtnHaptcFbOnTi -> GmOvrlStMgr.GmOvrlStMgrLoaMtgtnHaptcFbOnTi
    connect CalRegn03CmnGroupC.GmOvrlStMgrLoaMtgtnHaptcFbTqMax -> GmOvrlStMgr.GmOvrlStMgrLoaMtgtnHaptcFbTqMax
    connect CalRegn03CmnGroupC.GmOvrlStMgrLoaMtgtnHaptcFbTqMin -> GmOvrlStMgr.GmOvrlStMgrLoaMtgtnHaptcFbTqMin
    connect CalRegn03CmnGroupC.GmOvrlStMgrLoaMtgtnHaptcFbVehSpdMax -> GmOvrlStMgr.GmOvrlStMgrLoaMtgtnHaptcFbVehSpdMax
    connect CalRegn03CmnGroupC.GmOvrlStMgrLoaMtgtnHaptcFbVehSpdMin -> GmOvrlStMgr.GmOvrlStMgrLoaMtgtnHaptcFbVehSpdMin
    connect CalRegn03CmnGroupC.GmOvrlStMgrLoaMtgtnHaptcFrq -> GmOvrlStMgr.GmOvrlStMgrLoaMtgtnHaptcFrq
    connect CalRegn03CmnGroupC.GmOvrlStMgrLoaMtgtnTqOscnAmpY -> GmOvrlStMgr.GmOvrlStMgrLoaMtgtnTqOscnAmpY
    connect CalRegn03CmnGroupC.GmOvrlStMgrLoaMtgtnVehSpdX -> GmOvrlStMgr.GmOvrlStMgrLoaMtgtnVehSpdX
    connect CalRegn03Inin00.AssiHiFrqHpFilFrq -> AssiHiFrq.AssiHiFrqHpFilFrq
    connect CalRegn03Inin00.SysGlbPrmSysKineRat -> CDD_MotAgCmp.SysGlbPrmSysKineRat
    connect CalRegn03Inin00.EotLrngRackTrvlMin -> CustDiagc.EotLrngRackTrvlMin
    connect CalRegn03Inin00.DampgHydAssiLim -> Dampg.DampgHydAssiLim
    connect CalRegn03Inin00.DampgHydBasCoeff{1..4} -> Dampg.DampgHydBasCoeff{1..4}
    connect CalRegn03Inin00.DampgHydOutpLim -> Dampg.DampgHydOutpLim
    connect CalRegn03Inin00.DampgMotVelLpFilFrq -> Dampg.DampgMotVelLpFilFrq
    connect CalRegn03Inin00.DampgQuad13Mplr -> Dampg.DampgQuad13Mplr
    connect CalRegn03Inin00.DampgQuad24Mplr -> Dampg.DampgQuad24Mplr
    connect CalRegn03Inin00.DampgQuadHwTqLpFilFrq -> Dampg.DampgQuadHwTqLpFilFrq
    connect CalRegn03Inin00.DampgQuadMotVelLpFilFrq -> Dampg.DampgQuadMotVelLpFilFrq
    connect CalRegn03Inin00.DampgQuadScaLpFilFrq -> Dampg.DampgQuadScaLpFilFrq
    connect CalRegn03Inin00.EotLrngAuthyStrtLrn -> EotLrng.EotLrngAuthyStrtLrn
    connect CalRegn03Inin00.EotLrngEotLrnTmr -> EotLrng.EotLrngEotLrnTmr
    connect CalRegn03Inin00.EotLrngHwTqEotLrn -> EotLrng.EotLrngHwTqEotLrn
    connect CalRegn03Inin00.EotLrngMotVelEotLrn -> EotLrng.EotLrngMotVelEotLrn
    connect CalRegn03Inin00.EotLrngRackTrvlMax -> EotLrng.EotLrngRackTrvlMax
    connect CalRegn03Inin00.EotLrngRackTrvlMin -> EotLrng.EotLrngRackTrvlMin
    connect CalRegn03Inin00.EotLrngRstAuthyMin -> EotLrng.EotLrngRstAuthyMin
    connect CalRegn03Inin00.EotProtnRackTrvlLimrEna -> EotLrng.EotProtnRackTrvlLimrEna
    connect CalRegn03Inin00.EotProtnDftPosn -> EotProtn.EotProtnDftPosn
    connect CalRegn03Inin00.EotProtnEntrStLpFilFrq -> EotProtn.EotProtnEntrStLpFilFrq
    connect CalRegn03Inin00.EotProtnExitStLpFilFrq -> EotProtn.EotProtnExitStLpFilFrq
    connect CalRegn03Inin00.EotProtnHwAgMax -> EotProtn.EotProtnHwAgMax
    connect CalRegn03Inin00.EotProtnHwAgMin -> EotProtn.EotProtnHwAgMin
    connect CalRegn03Inin00.EotProtnHwTqLpFilFrq -> EotProtn.EotProtnHwTqLpFilFrq
    connect CalRegn03Inin00.EotProtnMotSpdIncptSca -> EotProtn.EotProtnMotSpdIncptSca
    connect CalRegn03Inin00.EotProtnMotSpdIncptX -> EotProtn.EotProtnMotSpdIncptX
    connect CalRegn03Inin00.EotProtnPosnRampStep -> EotProtn.EotProtnPosnRampStep
    connect CalRegn03Inin00.EotProtnRackTrvlLimrAuthyThd -> EotProtn.EotProtnRackTrvlLimrAuthyThd
    connect CalRegn03Inin00.EotProtnRackTrvlLimrAuthyThdLimd -> EotProtn.EotProtnRackTrvlLimrAuthyThdLimd
    connect CalRegn03Inin00.EotProtnRackTrvlLimrEna -> EotProtn.EotProtnRackTrvlLimrEna
    connect CalRegn03Inin00.EotProtnRunEotVelImpctAndSoftEndStop -> EotProtn.EotProtnRunEotVelImpctAndSoftEndStop
    connect CalRegn03Inin00.EotProtnSoftEndStopEna -> EotProtn.EotProtnSoftEndStopEna
    connect CalRegn03Inin00.EotProtnHwAgMin -> EotProtnFwl.EotProtnHwAgMin
    connect CalRegn03Inin00.GmOvrlStMgrLoaMtgtnHaptcFbStrtOnTi -> GmOvrlStMgr.GmOvrlStMgrLoaMtgtnHaptcFbStrtOnTi
    connect CalRegn03Inin00.GmOvrlStMgrLoaMtgtnStrtHaptcAmp -> GmOvrlStMgr.GmOvrlStMgrLoaMtgtnStrtHaptcAmp
    connect CalRegn03Inin00.GmOvrlStMgrLoaStIgnCntrThd -> GmOvrlStMgr.GmOvrlStMgrLoaStIgnCntrThd
    connect CalRegn03Inin00.SysGlbPrmSysKineRat -> HwAgSnsrls.SysGlbPrmSysKineRat
    connect CalRegn03Inin00.SysGlbPrmSysTqRat -> HwAgSnsrls.SysGlbPrmSysTqRat
    connect CalRegn03Inin00.SysGlbPrmSysKineRat -> HwAgSysArbn.SysGlbPrmSysKineRat
    connect CalRegn03Inin00.HwAgTrakgServoDftlTermLpFilFrq -> HwAgTrakgServo.HwAgTrakgServoDftlTermLpFilFrq
    connect CalRegn03Inin00.HwAgTrakgServoHwAgLpFilFrq -> HwAgTrakgServo.HwAgTrakgServoHwAgLpFilFrq
    connect CalRegn03Inin00.HwAgTrakgServoHwTqLpFilFrq -> HwAgTrakgServo.HwAgTrakgServoHwTqLpFilFrq
    connect CalRegn03Inin00.HwAgTrakgServoSmotngY -> HwAgTrakgServo.HwAgTrakgServoSmotngY
    connect CalRegn03Inin00.HysCmpAssiCmdLpFilFrq -> HysCmp.HysCmpAssiCmdLpFilFrq
    connect CalRegn03Inin00.HysCmpFinalOutpLpFilFrq -> HysCmp.HysCmpFinalOutpLpFilFrq
    connect CalRegn03Inin00.HysCmpHwTqLpFilFrq -> HysCmp.HysCmpHwTqLpFilFrq
    connect CalRegn03Inin00.SysGlbPrmSysTqRat -> HysCmp.SysGlbPrmSysTqRat
    connect CalRegn03Inin00.InertiaCmpVelMotInertia -> InertiaCmpVel.InertiaCmpVelMotInertia
    connect CalRegn03Inin00.InertiaCmpVelNotchFilStruct -> InertiaCmpVel.InertiaCmpVelNotchFilStruct
    connect CalRegn03Inin00.InertiaCmpVelTqSnsrVelFilFrq -> InertiaCmpVel.InertiaCmpVelTqSnsrVelFilFrq
    connect CalRegn03Inin00.SysGlbPrmSysKineRat -> InertiaCmpVel.SysGlbPrmSysKineRat
    connect CalRegn03Inin00.PullCmpActvYawRateFilFrq -> PullCmpActv.PullCmpActvYawRateFilFrq
    connect CalRegn03Inin00.SysGlbPrmSysTqRat -> PullCmpActv.SysGlbPrmSysTqRat
    connect CalRegn03Inin00.PwrpkCmpbltyChkGearId -> PwrpkCmpbltyChk.PwrpkCmpbltyChkGearId
    connect CalRegn03Inin00.RtnHwAuthyScaX -> Rtn.RtnHwAuthyScaX
    connect CalRegn03Inin00.RtnHwAuthyScaY -> Rtn.RtnHwAuthyScaY
    connect CalRegn03Inin00.RtnHwAuthySlew -> Rtn.RtnHwAuthySlew
    connect CalRegn03Inin00.RtnOffsRng -> Rtn.RtnOffsRng
    connect CalRegn03Inin00.RtnOffsSlew -> Rtn.RtnOffsSlew
    connect CalRegn03Inin00.SysGlbPrmSysTqRat -> SnsrOffsLrng.SysGlbPrmSysTqRat
    connect CalRegn03Inin00.StabyCmpAssiScaBlndX -> StabyCmp.StabyCmpAssiScaBlndX
    connect CalRegn03Inin00.StabyCmpAssiScaBlndY -> StabyCmp.StabyCmpAssiScaBlndY
    connect CalRegn03Inin00.StabyCmpHwTqLpFilFrq -> StabyCmp.StabyCmpHwTqLpFilFrq
    connect CalRegn03Inin00.StabyCmpNotchFil{1..4}Struct -> StabyCmp.StabyCmpNotchFil{1..4}Struct
    connect CalRegn03Inin00.StabyCmpNotchFilBlnd04Y -> StabyCmp.StabyCmpNotchFilBlnd04Y
    connect CalRegn03Inin00.StabyCmpNotchFilBlnd34TqX -> StabyCmp.StabyCmpNotchFilBlnd34TqX
    connect CalRegn03Inin00.StabyCmpNotchFilBlnd34Y -> StabyCmp.StabyCmpNotchFilBlnd34Y
    connect CalRegn03Inin00.EotLrngAuthyStrtLrn -> StHlthSigNormn.EotLrngAuthyStrtLrn
    connect CalRegn03Inin00.WhlImbRejctnBlndCmdMgnLp1FilFrq -> WhlImbRejctn.WhlImbRejctnBlndCmdMgnLp1FilFrq
    connect CalRegn03Inin00.WhlImbRejctnBlndCmdMgnLp2FilFrq -> WhlImbRejctn.WhlImbRejctnBlndCmdMgnLp2FilFrq
    connect CalRegn03Inin00.WhlImbRejctnDistbnMgnLpFil -> WhlImbRejctn.WhlImbRejctnDistbnMgnLpFil
    connect CalRegn03Inin00.WhlImbRejctnWhlSpdLpFil -> WhlImbRejctn.WhlImbRejctnWhlSpdLpFil
    connect CalRegn03Inin00GroupA.DampgTScaX -> Dampg.DampgTScaX
    connect CalRegn03Inin00GroupA.DampgTScaY -> Dampg.DampgTScaY
    connect CalRegn03Inin00GroupA.HysCmpAssiInpLim -> HysCmp.HysCmpAssiInpLim
    connect CalRegn03Inin00GroupA.HysCmpFricTScaX -> HysCmp.HysCmpFricTScaX
    connect CalRegn03Inin00GroupA.HysCmpFricTScaY -> HysCmp.HysCmpFricTScaY
    connect CalRegn03Inin00GroupA.InertiaCmpVelCmdScaY -> InertiaCmpVel.InertiaCmpVelCmdScaY
    connect CalRegn03Inin00GroupA.InertiaCmpVelDampgDecelGain -> InertiaCmpVel.InertiaCmpVelDampgDecelGain
    connect CalRegn03Inin00GroupA.InertiaCmpVelDampgDecelGainFallSlew -> InertiaCmpVel.InertiaCmpVelDampgDecelGainFallSlew
    connect CalRegn03Inin00GroupA.InertiaCmpVelDampgDecelGainRisngSlewX -> InertiaCmpVel.InertiaCmpVelDampgDecelGainRisngSlewX
    connect CalRegn03Inin00GroupA.InertiaCmpVelDampgDecelGainRisngSlewY -> InertiaCmpVel.InertiaCmpVelDampgDecelGainRisngSlewY
    connect CalRegn03Inin00GroupA.InertiaCmpVelDampgGainOffThd -> InertiaCmpVel.InertiaCmpVelDampgGainOffThd
    connect CalRegn03Inin00GroupA.InertiaCmpVelDampgGainOnThd -> InertiaCmpVel.InertiaCmpVelDampgGainOnThd
    connect CalRegn03Inin00GroupA.InertiaCmpVelMotVelBasdOutpScagX -> InertiaCmpVel.InertiaCmpVelMotVelBasdOutpScagX
    connect CalRegn03Inin00GroupA.InertiaCmpVelMotVelBasdOutpScagY -> InertiaCmpVel.InertiaCmpVelMotVelBasdOutpScagY
    connect CalRegn03Inin00GroupA.InertiaCmpVelTqSnsrVelSca -> InertiaCmpVel.InertiaCmpVelTqSnsrVelSca
    connect CalRegn03Inin00GroupA.RtnTScaX -> Rtn.RtnTScaX
    connect CalRegn03Inin00GroupA.RtnTScaY -> Rtn.RtnTScaY
    connect CalRegn03Inin00GroupA.StabyCmpNotchFilBilnrBlndVehSpd -> StabyCmp.StabyCmpNotchFilBilnrBlndVehSpd
    connect CalRegn03Inin00GroupA.StabyCmpNotchFilBlnd02Y -> StabyCmp.StabyCmpNotchFilBlnd02Y
    connect CalRegn03Inin00GroupA.StabyCmpNotchFilBlnd12TqX -> StabyCmp.StabyCmpNotchFilBlnd12TqX
    connect CalRegn03Inin00GroupA.StabyCmpNotchFilBlnd12Y -> StabyCmp.StabyCmpNotchFilBlnd12Y
    connect CalRegn03Inin00GroupB.EotProtnDampgSlew -> EotProtn.EotProtnDampgSlew
    connect CalRegn03Inin00GroupB.EotProtnHwAgGain -> EotProtn.EotProtnHwAgGain
    connect CalRegn03Inin00GroupB.EotProtnHwTqScaX -> EotProtn.EotProtnHwTqScaX
    connect CalRegn03Inin00GroupB.EotProtnMotVelGain -> EotProtn.EotProtnMotVelGain
    connect CalRegn03Inin00GroupB.EotProtnRackTrvlLimrRng -> EotProtn.EotProtnRackTrvlLimrRng
    connect CalRegn03Inin00GroupB.EotProtnRackTrvlLimrRngLimd -> EotProtn.EotProtnRackTrvlLimrRngLimd
    connect CalRegn03Inin00GroupB.EotProtnRackTrvlLimrVehSpdThd -> EotProtn.EotProtnRackTrvlLimrVehSpdThd
    connect CalRegn03Inin00GroupB.EotProtnSoftEndStopVehSpdThd -> EotProtn.EotProtnSoftEndStopVehSpdThd
    connect CalRegn03Inin00GroupB.EotProtnRackTrvlLimrRng -> EotProtnFwl.EotProtnRackTrvlLimrRng
    connect CalRegn03Inin00GroupB.WhlImbRejctnAdpvFac -> WhlImbRejctn.WhlImbRejctnAdpvFac
    connect CalRegn03Inin00GroupB.WhlImbRejctnCurrMgnSlewPerLoop -> WhlImbRejctn.WhlImbRejctnCurrMgnSlewPerLoop
    connect CalRegn03Inin00GroupB.WhlImbRejctnDcTrendTh2Tq -> WhlImbRejctn.WhlImbRejctnDcTrendTh2Tq
    connect CalRegn03Inin00GroupB.WhlImbRejctnDcTrendThTq -> WhlImbRejctn.WhlImbRejctnDcTrendThTq
    connect CalRegn03Inin00GroupB.WhlImbRejctnDcTrendTi2Sec -> WhlImbRejctn.WhlImbRejctnDcTrendTi2Sec
    connect CalRegn03Inin00GroupB.WhlImbRejctnDcTrendTiSec -> WhlImbRejctn.WhlImbRejctnDcTrendTiSec
    connect CalRegn03Inin00GroupB.WhlImbRejctnEnaSlewPerLoop -> WhlImbRejctn.WhlImbRejctnEnaSlewPerLoop
    connect CalRegn03Inin00GroupB.WhlImbRejctnFrqScaTblX -> WhlImbRejctn.WhlImbRejctnFrqScaTblX
    connect CalRegn03Inin00GroupB.WhlImbRejctnFrqScaTblY -> WhlImbRejctn.WhlImbRejctnFrqScaTblY
    connect CalRegn03Inin00GroupB.WhlImbRejctnMaxDurn -> WhlImbRejctn.WhlImbRejctnMaxDurn
    connect CalRegn03Inin00GroupB.WhlImbRejctnMaxMgn -> WhlImbRejctn.WhlImbRejctnMaxMgn
    connect CalRegn03Inin00GroupB.WhlImbRejctnMgnEstimnDeltaSca -> WhlImbRejctn.WhlImbRejctnMgnEstimnDeltaSca
    connect CalRegn03Inin00GroupB.WhlImbRejctnMgnEstimnDiThd -> WhlImbRejctn.WhlImbRejctnMgnEstimnDiThd
    connect CalRegn03Inin00GroupB.WhlImbRejctnMgnEstimnEnaThd -> WhlImbRejctn.WhlImbRejctnMgnEstimnEnaThd
    connect CalRegn03Inin00GroupB.WhlImbRejctnMgnEstimnFrq -> WhlImbRejctn.WhlImbRejctnMgnEstimnFrq
    connect CalRegn03Inin00GroupB.WhlImbRejctnMgnEstimnFrqDelta -> WhlImbRejctn.WhlImbRejctnMgnEstimnFrqDelta
    connect CalRegn03Inin00GroupB.WhlImbRejctnMgnEstimnLeak -> WhlImbRejctn.WhlImbRejctnMgnEstimnLeak
    connect CalRegn03Inin00GroupB.WhlImbRejctnPhaAdjX -> WhlImbRejctn.WhlImbRejctnPhaAdjX
    connect CalRegn03Inin00GroupB.WhlImbRejctnPhaAdjY -> WhlImbRejctn.WhlImbRejctnPhaAdjY
    connect CalRegn03Inin00GroupB.WhlImbRejctnWhlSpdCorrlnThd -> WhlImbRejctn.WhlImbRejctnWhlSpdCorrlnThd
    connect CalRegn03Inin00GroupB.WhlImbRejctnWhlSpdCorrlnTi -> WhlImbRejctn.WhlImbRejctnWhlSpdCorrlnTi
    connect CalRegn03Inin00GroupC.HwAgTrakgServoDampgTqX -> HwAgTrakgServo.HwAgTrakgServoDampgTqX
    connect CalRegn03Inin00GroupC.HwAgTrakgServoDampgTqY -> HwAgTrakgServo.HwAgTrakgServoDampgTqY
    connect CalRegn03Inin00GroupC.HwAgTrakgServoDftlGainY -> HwAgTrakgServo.HwAgTrakgServoDftlGainY
    connect CalRegn03Inin00GroupC.HwAgTrakgServoIntglGainY -> HwAgTrakgServo.HwAgTrakgServoIntglGainY
    connect CalRegn03Inin00GroupC.HwAgTrakgServoIntglTermAntiWdupLimY -> HwAgTrakgServo.HwAgTrakgServoIntglTermAntiWdupLimY
    connect CalRegn03Inin00GroupC.HwAgTrakgServoPropGainX -> HwAgTrakgServo.HwAgTrakgServoPropGainX
    connect CalRegn03Inin00GroupC.HwAgTrakgServoPropGainY -> HwAgTrakgServo.HwAgTrakgServoPropGainY
    connect CalRegn03Inin00GroupC.HwAgTrakgServoSmotngX -> HwAgTrakgServo.HwAgTrakgServoSmotngX
    connect CalRegn03Rt00.InertiaCmpVelDampgFilFrq -> AAACalRegn03Rt01_Dummy.InertiaCmpVelDampgFilFrq
    connect CalRegn03Rt00.InertiaCmpVelDampgFilFrqWhlImbRejctnOn -> AAACalRegn03Rt01_Dummy.InertiaCmpVelDampgFilFrqWhlImbRejctnOn
    connect CalRegn03Rt00.InertiaCmpVelDampgFilFrq -> InertiaCmpVel.InertiaCmpVelDampgFilFrq
    connect CalRegn03Rt00.InertiaCmpVelDampgFilFrqWhlImbRejctnOn -> InertiaCmpVel.InertiaCmpVelDampgFilFrqWhlImbRejctnOn
    connect CalRegn03Rt00GroupA.AssiHiFrqGainY -> AAACalRegn03Rt01GroupA_Dummy_4.AssiHiFrqGainY
    connect CalRegn03Rt00GroupA.AssiHiFrqTqX -> AAACalRegn03Rt01GroupA_Dummy_4.AssiHiFrqTqX
    connect CalRegn03Rt00GroupA.AssiMotTqWhlImbRejctnMinX -> AAACalRegn03Rt01GroupA_Dummy_4.AssiMotTqWhlImbRejctnMinX
    connect CalRegn03Rt00GroupA.AssiMotTqWhlImbRejctnMinY -> AAACalRegn03Rt01GroupA_Dummy_4.AssiMotTqWhlImbRejctnMinY
    connect CalRegn03Rt00GroupA.DampgHydCoeff{1..4}ScaY -> AAACalRegn03Rt01GroupA_Dummy_4.DampgHydCoeff{1..4}ScaY
    connect CalRegn03Rt00GroupA.DampgMotVelX -> AAACalRegn03Rt01GroupA_Dummy_4.DampgMotVelX
    connect CalRegn03Rt00GroupA.DampgMotVelY -> AAACalRegn03Rt01GroupA_Dummy_4.DampgMotVelY
    connect CalRegn03Rt00GroupA.HysCmpFricWhlImbRejctnBlndX -> AAACalRegn03Rt01GroupA_Dummy_4.HysCmpFricWhlImbRejctnBlndX
    connect CalRegn03Rt00GroupA.HysCmpFricWhlImbRejctnBlndY -> AAACalRegn03Rt01GroupA_Dummy_4.HysCmpFricWhlImbRejctnBlndY
    connect CalRegn03Rt00GroupA.HysCmpFricWhlImbRejctnOffY -> AAACalRegn03Rt01GroupA_Dummy_4.HysCmpFricWhlImbRejctnOffY
    connect CalRegn03Rt00GroupA.HysCmpFricWhlImbRejctnOnY -> AAACalRegn03Rt01GroupA_Dummy_4.HysCmpFricWhlImbRejctnOnY
    connect CalRegn03Rt00GroupA.InertiaCmpVelAssiBasdDampgCoeffX -> AAACalRegn03Rt01GroupA_Dummy_4.InertiaCmpVelAssiBasdDampgCoeffX
    connect CalRegn03Rt00GroupA.InertiaCmpVelAssiBasdDampgRollgY -> AAACalRegn03Rt01GroupA_Dummy_4.InertiaCmpVelAssiBasdDampgRollgY
    connect CalRegn03Rt00GroupA.InertiaCmpVelAssiBasdDampgStatY -> AAACalRegn03Rt01GroupA_Dummy_4.InertiaCmpVelAssiBasdDampgStatY
    connect CalRegn03Rt00GroupA.InertiaCmpVelDampgSpdBlndY -> AAACalRegn03Rt01GroupA_Dummy_4.InertiaCmpVelDampgSpdBlndY
    connect CalRegn03Rt00GroupA.InertiaCmpVelNotchBlndY -> AAACalRegn03Rt01GroupA_Dummy_4.InertiaCmpVelNotchBlndY
    connect CalRegn03Rt00GroupA.RtnHwAgOffsCalcdX -> AAACalRegn03Rt01GroupA_Dummy_4.RtnHwAgOffsCalcdX
    connect CalRegn03Rt00GroupA.RtnHwAgOffsCalcdY -> AAACalRegn03Rt01GroupA_Dummy_4.RtnHwAgOffsCalcdY
    connect CalRegn03Rt00GroupA.RtnScaTqX -> AAACalRegn03Rt01GroupA_Dummy_4.RtnScaTqX
    connect CalRegn03Rt00GroupA.RtnScaTqY -> AAACalRegn03Rt01GroupA_Dummy_4.RtnScaTqY
    connect CalRegn03Rt00GroupA.RtnScaVelX -> AAACalRegn03Rt01GroupA_Dummy_4.RtnScaVelX
    connect CalRegn03Rt00GroupA.RtnScaVelY -> AAACalRegn03Rt01GroupA_Dummy_4.RtnScaVelY
    connect CalRegn03Rt00GroupA.AssiMotTqWhlImbRejctnMinX -> Assi.AssiMotTqWhlImbRejctnMinX
    connect CalRegn03Rt00GroupA.AssiMotTqWhlImbRejctnMinY -> Assi.AssiMotTqWhlImbRejctnMinY
    connect CalRegn03Rt00GroupA.AssiHiFrqGainY -> AssiHiFrq.AssiHiFrqGainY
    connect CalRegn03Rt00GroupA.AssiHiFrqTqX -> AssiHiFrq.AssiHiFrqTqX
    connect CalRegn03Rt00GroupA.DampgHydCoeff{1..4}ScaY -> Dampg.DampgHydCoeff{1..4}ScaY
    connect CalRegn03Rt00GroupA.DampgMotVelX -> Dampg.DampgMotVelX
    connect CalRegn03Rt00GroupA.DampgMotVelY -> Dampg.DampgMotVelY
    connect CalRegn03Rt00GroupA.HysCmpFricWhlImbRejctnBlndX -> HysCmp.HysCmpFricWhlImbRejctnBlndX
