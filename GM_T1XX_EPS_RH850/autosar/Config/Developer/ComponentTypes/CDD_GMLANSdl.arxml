AUTOSAR XML (schema 4-0-3)
package /ComponentTypes
  complex device driver sw component type CDD_GMLANSdl
    behavior CDD_GMLANSdl_InternalBehavior
      timing event TMT_GMLANSdlPer1: start-on-event=GMLANSdlPer1, period=0.01
      timing event TMT_GMLANSdlPer2: start-on-event=GMLANSdlPer2, period=0.01
      runnable GMLANSdlPer1
      runnable GMLANSdlPer2
  swc implementation CDD_GMLANSdl_Implementation: behavior=CDD_GMLANSdl_InternalBehavior
    code-descriptors:
      code Default: artifact-descriptors=autosar-engineering-object={short-label=Default, category=SWSRC}
