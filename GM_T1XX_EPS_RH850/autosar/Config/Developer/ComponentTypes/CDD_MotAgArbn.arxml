AUTOSAR XML (schema 4-0-3)
package /ComponentTypes
  complex device driver sw component type CDD_MotAgArbn
    behavior CDD_MotAgArbn_InternalBehavior
      ar-typed-per-instance-memorys:
        5 x data, all with sw-calibration-access=READ-ONLY:
          MotAgARollgCntPrev: type=uint8
          MotAgAStallCntPrev: type=uint8
          MotAgBRollgCntPrev: type=uint8
          MotAgBStallCntPrev: type=uint8
          MotAgMeclPrev: type=u0p16
      timing event CDD_MotAgArbn_InitEvent: start-on-event=CDD_MotAgArbnInit1, period=0
      runnable CDD_MotAgArbnInit1
  swc implementation CDD_MotAgArbn_Implementation: behavior=CDD_MotAgArbn_InternalBehavior
    code-descriptors:
      code Default: artifact-descriptors=autosar-engineering-object={short-label=Default, category=SWSRC}
