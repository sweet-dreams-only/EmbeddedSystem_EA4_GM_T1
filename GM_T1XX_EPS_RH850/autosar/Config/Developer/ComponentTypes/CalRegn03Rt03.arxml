AUTOSAR XML (schema 4-0-3)
package /ComponentTypes
  parameter sw component type CalRegn03Rt03
    provide port InertiaCmpVelDampgFilFrq: parameter-provide-com-spec{init-value=12 x 8192, parameter=Ary1D}, provided-interface=Ary1D_u7p9_12_CalPortIf1
    provide port InertiaCmpVelDampgFilFrqWhlImbRejctnOn: parameter-provide-com-spec{init-value=12 x 8192, parameter=Ary1D}, provided-interface=Ary1D_u7p9_12_CalPortIf1
